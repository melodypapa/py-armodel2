AUTOSAR XML (schema 4.0)
arpackage AUTOSAR_Platform
  4 x arpackage, all with category=STANDARD:
    BaseTypes
      15 x packageableelement, all with category=FIXED_LENGTH:
        float32
        float64
        sint16
        sint16_least
        sint32
        sint32_least
        sint8
        sint8_least
        uint16
        uint16_least
        uint32
        uint32_least
        uint8
        uint8_least
        void
    CompuMethods
      packageableelement boolean_Literals: category=TEXTTABLE
    DataConstrs
      12 x packageableelement:
        sint16
        sint16_least
        sint32
        sint32_least
        sint8
        sint8_least
        uint16
        uint16_least
        uint32
        uint32_least
        uint8
        uint8_least
    ImplementationDataTypes
      15 x packageableelement:
        boolean: category=TYPE_REFERENCE
        float32: category=VALUE
        float64: category=VALUE
        sint16: category=VALUE
        sint16_least: category=VALUE
        sint32: category=VALUE
        sint32_least: category=VALUE
        sint8: category=VALUE
        sint8_least: category=VALUE
        uint16: category=VALUE
        uint16_least: category=VALUE
        uint32: category=VALUE
        uint32_least: category=VALUE
        uint8: category=VALUE
        uint8_least: category=VALUE
