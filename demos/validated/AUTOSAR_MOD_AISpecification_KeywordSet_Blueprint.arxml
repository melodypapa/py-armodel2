AUTOSAR XML (schema 00050)
package /AUTOSAR/AISpecification/KeywordSets_Blueprint
  keyword set KeywordList  # AUTOSAR Keywords and Keywords Abbreviations
    1714 x keyword:
      A: abbr-name=A, classifications=Action-PhysicalType  # Acceleration | This keyword is used to give the physical value of acceleration. It is the value of gaining speed.
      Abnorm: abbr-name=Abnorm, classifications=Condition-Qualifier  # Abnormal
      Abort: abbr-name=Abort, classifications=Action-PhysicalType
      Abs: abbr-name=Abs, classifications=Mean-Environment-Device  # ABS | Antilock Braking System
      Abslt: abbr-name=Abslt, classifications=Condition-Qualifier  # Absolute | Absolute value
      Absnt: abbr-name=Absnt, classifications=Condition-Qualifier  # Absent
      Abv: abbr-name=Abv, classifications=Preposition  # Above
      Ac: abbr-name=Ac, classifications=Condition-Qualifier  # AC | Alternating Current / Voltage
      Ac1: abbr-name=Ac, classifications=Mean-Environment-Device  # AC | Air Conditioner or Air Conditioning (A/C).
      Acc: abbr-name=Acc, classifications=Mean-Environment-Device  # ACC | Adaptive Cruise Control
      Acco: abbr-name=Acco, classifications=Condition-Qualifier  # Accommodation
      Accr: abbr-name=Accr, classifications=Mean-Environment-Device  # Accelerator
      Accy: abbr-name=Accy, classifications=Condition-Qualifier  # Accuracy | The accuracy of a measurement method respectively the quality of signals are defined in ISO 5725: The "accuracy" (Genauigkeit) is described by the two terms "trueness" (Richtigkeit) and "precision" (Präzision).With the condition, that the "Precision" is homogenously spread over it's whole range, the fomula "Accuracy = Trueness + 0,5 Precision" decribes the accuracy.
      Ack: abbr-name=Ack, classifications=Action-PhysicalType  # Acknowledge
      Ackd: abbr-name=Ackd, classifications=Condition-Qualifier  # Acknowledged
      Acoust: abbr-name=Acoust, classifications=Condition-Qualifier  # Acoustic
      Acpt: abbr-name=Acpt, classifications=Action-PhysicalType  # Accept
      Acptd: abbr-name=Acptd, classifications=Condition-Qualifier  # Accepted
      Acq: abbr-name=Acq, classifications=Action-PhysicalType  # Acquire
      Acqd: abbr-name=Acqd, classifications=Condition-Qualifier  # Acquired
      Acqn: abbr-name=Acqn, classifications=Condition-Qualifier  # Acquisition | e.g. signal acquisition
      Acrt: abbr-name=Acrt, classifications=Condition-Qualifier  # Accurate
      Acry: abbr-name=Acry, classifications=Condition-Qualifier  # Accuracy
      Acs: abbr-name=Acs, classifications=Action-PhysicalType  # Access
      Acsy: abbr-name=Acsy, classifications=Mean-Environment-Device  # Accessory
      Act: abbr-name=Act, classifications=Condition-Qualifier  # Actual
      Actn: abbr-name=Actn, classifications=Condition-Qualifier  # Action
      Actr: abbr-name=Actr, classifications=Mean-Environment-Device  # Actuator
      Acttn: abbr-name=Acttn, classifications=Action-PhysicalType  # Actuation
      Actv: abbr-name=Actv, classifications=Condition-Qualifier  # Active
      Actvd: abbr-name=Actvd, classifications=Condition-Qualifier  # Activated
      Actvn: abbr-name=Actvn, classifications=Action-PhysicalType  # Activation
      Actvt: abbr-name=Actvt, classifications=Action-PhysicalType  # Activate
      Adas: abbr-name=Adas, classifications=Mean-Environment-Device  # Advanced driver assistance systems (ADAS) are systems developed to automate/adapt/enhance vehicle systems for safety and better driving.
      Adbtc: abbr-name=Adbtc, classifications=Condition-Qualifier  # Adiabatic
      Adc: abbr-name=Adc, classifications=Mean-Environment-Device  # ADC | Analog Digital Converter
      Add: abbr-name=Add, classifications=Condition-Qualifier  # Additive
      Addl: abbr-name=Addl, classifications=Condition-Qualifier  # Additional
      Adh: abbr-name=Adh, classifications=Action-PhysicalType  # Adhesion
      Adj: abbr-name=Adj, classifications=Action-PhysicalType  # Adjust
      Adjmt: abbr-name=Adjmt, classifications=Action-PhysicalType  # Adjustment
      Admin: abbr-name=Admin, classifications=Condition-Qualifier  # Administration
      Adpd: abbr-name=Adpd, classifications=Condition-Qualifier  # Adapted
      Adpn: abbr-name=Adpn, classifications=Condition-Qualifier  # Adaptation
      Adpr: abbr-name=Adpr, classifications=Mean-Environment-Device  # Adapter
      Adpv: abbr-name=Adpv, classifications=Condition-Qualifier  # Adaptive
      Adr: abbr-name=Adr, classifications=Condition-Qualifier  # Address
      Adsorb: abbr-name=Adsorb, classifications=Action-PhysicalType
      Adsorpn: abbr-name=Adsorpn, classifications=Condition-Qualifier  # Adsorption
      Adv: abbr-name=Adv, classifications=Condition-Qualifier  # Advance
      Aft: abbr-name=Aft, classifications=Preposition  # After
      Ag: abbr-name=Ag, classifications=Action-PhysicalType  # Angle
      Age: abbr-name=Age, classifications=Condition-Qualifier
      Aged: abbr-name=Aged, classifications=Condition-Qualifier
      Aggrvd: abbr-name=Aggrvd, classifications=Condition-Qualifier  # Aggravated
      Agi: abbr-name=Agi, classifications=Condition-Qualifier  # Aging
      Agr: abbr-name=Agr, classifications=Condition-Qualifier  # Angular
      Agt: abbr-name=Agt, classifications=Mean-Environment-Device  # Agent | E.g. Reducing Agent, Cooling Agent
      Ahd: abbr-name=Ahd, classifications=Condition-Qualifier  # Ahead
      Ai: abbr-name=Ai, classifications=Mean-Environment-Device  # AI | Application Interfaces
      Aid: abbr-name=Aid, classifications=Action-PhysicalType
      Air: abbr-name=Air, classifications=Mean-Environment-Device  # Also used as definition of "fresh gas"
      Airb: abbr-name=Airb, classifications=Mean-Environment-Device  # Airbag | airbag
      Ajar: abbr-name=Ajar, classifications=Condition-Qualifier
      Alg: abbr-name=Alg, classifications=Condition-Qualifier  # Algorithm
      Algn: abbr-name=Algn, classifications=Action-PhysicalType  # Align
      Algnd: abbr-name=Algnd, classifications=Condition-Qualifier  # Aligned
      All: abbr-name=All, classifications=Condition-Qualifier
      Allw: abbr-name=Allw, classifications=Action-PhysicalType  # Allow
      Allwbl: abbr-name=Allwbl, classifications=Condition-Qualifier  # Allowable
      Allwd: abbr-name=Allwd, classifications=Condition-Qualifier  # Allowed
      Alpha: abbr-name=Alpha, classifications=Condition-Qualifier
      Alrm: abbr-name=Alrm, classifications=Condition-Qualifier  # Alarm
      Alrmd: abbr-name=Alrmd, classifications=Condition-Qualifier  # Alarmed
      Alt: abbr-name=Alt, classifications=Mean-Environment-Device  # Alternator | alternator
      Alti: abbr-name=Alti, classifications=Action-PhysicalType  # Altitude
      Altv: abbr-name=Altv, classifications=Mean-Environment-Device  # Alternative
      Alv: abbr-name=Alv, classifications=Condition-Qualifier  # Alive
      Amb: abbr-name=Amb, classifications=Mean-Environment-Device  # Ambient
      Amnt: abbr-name=Amnt, classifications=Action-PhysicalType  # Amount | a total number or quantity, e.g. amount of substance.
      Amp: abbr-name=Amp, classifications=Condition-Qualifier  # Amplitude
      Amplfr: abbr-name=Amplfr, classifications=Mean-Environment-Device  # Amplifier
      Ampr: abbr-name=Ampr, classifications=Mean-Environment-Device  # Ampere
      Amt: abbr-name=Amt, classifications=Mean-Environment-Device  # AMT | Automated Manual Transmission
      An: abbr-name=An, classifications=Condition-Qualifier  # Analog
      Anchrfitg: abbr-name=Anchrfitg, classifications=Mean-Environment-Device  # Anchorfitting
      Ancllry: abbr-name=Ancllry, classifications=Mean-Environment-Device  # Ancillary
      And: abbr-name=And, classifications=Preposition  # Preposition
      Antcpt: abbr-name=Antcpt, classifications=Action-PhysicalType  # Anticipate
      Antcptd: abbr-name=Antcptd, classifications=Condition-Qualifier  # Anticipated
      Antcptn: abbr-name=Antcptn, classifications=Condition-Qualifier  # Anticipation
      Anti: abbr-name=Anti, classifications=Condition-Qualifier
      Antisub: abbr-name=Antisub, classifications=Mean-Environment-Device  # Antisubmarine | Term used in restraint systems for automotive applications related to an Airbag that upon deployment prevents a front row passenger from diving below the dashboard by lifting the person's lower body. Thus, the person is brougth into a better position relative to the main Front Airbag.
      Antithft: abbr-name=Antithft, classifications=Mean-Environment-Device  # Antitheft
      Any: abbr-name=Any, classifications=Condition-Qualifier
      Apil: abbr-name=Apil, classifications=Mean-Environment-Device  # A-Pillar of a car
      Appch: abbr-name=Appch, classifications=Action-PhysicalType  # Approach
      Appl: abbr-name=Appl, classifications=Mean-Environment-Device  # Application
      Appld: abbr-name=Appld, classifications=Condition-Qualifier  # Applied
      Apply: abbr-name=Apply, classifications=Action-PhysicalType
      Approx: abbr-name=Approx, classifications=Condition-Qualifier  # Approximate
      Approxn: abbr-name=Approxn, classifications=Action-PhysicalType  # Approximation | A number, amount, etc. that is not exact, but almost correct.
      Aprvd: abbr-name=Aprvd, classifications=Condition-Qualifier  # Approved
      Ar: abbr-name=Ar, classifications=Action-PhysicalType  # Area
      Ar1: abbr-name=Ar, classifications=Mean-Environment-Device  # AUTOSAR
      Arbd: abbr-name=Arbd, classifications=Condition-Qualifier  # Arbitrated
      Arbn: abbr-name=Arbn, classifications=Action-PhysicalType  # Arbitration
      Area: abbr-name=Area, classifications=Action-PhysicalType
      Arg: abbr-name=Arg, classifications=Condition-Qualifier  # Argument
      Arm: abbr-name=Arm, classifications=Action-PhysicalType  # Intended as the action of arming some device
      Armed: abbr-name=Armed, classifications=Condition-Qualifier
      Arming: abbr-name=Arming, classifications=Action-PhysicalType  # Intended as the action of arming some device
      Armtr: abbr-name=Armtr, classifications=Mean-Environment-Device  # Armature | This keyword described the constructional element of an armature. It should be used e.g. for calculations of the armature movement of a coil actuator.
      Arthm: abbr-name=Arthm, classifications=Condition-Qualifier  # Arithmetic
      Ary: abbr-name=Ary, classifications=Condition-Qualifier  # Array
      Asc: abbr-name=Asc, classifications=Mean-Environment-Device  # ASC | Acceleration Slip Control
      Asgn: abbr-name=Asgn, classifications=Action-PhysicalType  # Assign
      Ash: abbr-name=Ash, classifications=Mean-Environment-Device  # e.g. in Ash Soot Factor
      Ashtray: abbr-name=Ashtray, classifications=Mean-Environment-Device
      Asr: abbr-name=Asr, classifications=Mean-Environment-Device  # ASR | Anti Slip Regulation
      Assc: abbr-name=Assc, classifications=Mean-Environment-Device  # Assistance | assistance. this keyword expresses the availability of an electronic assistance for a component or system
      Assi: abbr-name=Assi, classifications=Action-PhysicalType  # Assist
      Assid: abbr-name=Assid, classifications=Condition-Qualifier  # Assisted
      Asst: abbr-name=Asst, classifications=Mean-Environment-Device  # Assistant | assistant. For example: the electronic brake assistant.
      Asw: abbr-name=Asw, classifications=Mean-Environment-Device  # ASW | Application Software
      Asymc: abbr-name=Asymc, classifications=Condition-Qualifier  # Asymmetrical
      Asymtry: abbr-name=Asymtry, classifications=Condition-Qualifier  # Asymmetry
      Async: abbr-name=Async, classifications=Condition-Qualifier  # Asynchronous
      At: abbr-name=At, classifications=Preposition  # Preposition for location, time, presence
      At1: abbr-name=At, classifications=Mean-Environment-Device  # AT | Automatic Transmission
      Ata: abbr-name=Ata, classifications=Condition-Qualifier  # American Trucking Associations Diagnostics Bus
      Atch: abbr-name=Atch, classifications=Action-PhysicalType  # Attach
      Atm: abbr-name=Atm, classifications=Mean-Environment-Device  # Atmosphere
      Atmpt: abbr-name=Atmpt, classifications=Condition-Qualifier  # Attempt
      Attn: abbr-name=Attn, classifications=Condition-Qualifier  # Attenuator | The attenuator switch is a part of the power stage which drives the piezo injectors.
      Audio: abbr-name=Audio, classifications=Action-PhysicalType
      Australia: abbr-name=Australia, classifications=Condition-Qualifier
      Aut: abbr-name=Aut, classifications=Condition-Qualifier  # Automatic
      Auth: abbr-name=Auth, classifications=Action-PhysicalType  # Authorize
      Authent: abbr-name=Authent, classifications=Condition-Qualifier  # Authentication
      Authn: abbr-name=Authn, classifications=Action-PhysicalType  # Authorization
      Autrk: abbr-name=Autrk, classifications=Condition-Qualifier  # Autarkic | self-sustaining
      Aux: abbr-name=Aux, classifications=Condition-Qualifier  # Auxiliary
      Avd: abbr-name=Avd, classifications=Action-PhysicalType  # Avoid
      Avdbl: abbr-name=Avdbl, classifications=Condition-Qualifier  # Avoidable
      Avl: abbr-name=Avl, classifications=Condition-Qualifier  # Available
      Avrg: abbr-name=Avrg, classifications=Condition-Qualifier  # Average
      Avs: abbr-name=Avs, classifications=Condition-Qualifier  # AVS | Adjustment Value Service
      Awd: abbr-name=Awd, classifications=Mean-Environment-Device  # AWD | All Wheel Drive
      Axis: abbr-name=Axis, classifications=Mean-Environment-Device  # E. g. might be used in Axis1st, Axis2nd, Axis3rd
      Axle: abbr-name=Axle, classifications=Mean-Environment-Device
      Axles: abbr-name=Axles, classifications=Mean-Environment-Device  # Front and rear axle
      Back: abbr-name=Back, classifications=Mean-Environment-Device  # anatomic human back
      Backed: abbr-name=Backed, classifications=Condition-Qualifier
      Backlite: abbr-name=Backlite, classifications=Mean-Environment-Device
      Backlt: abbr-name=Backlt, classifications=Condition-Qualifier  # Backlit
      Backw: abbr-name=Backw, classifications=Condition-Qualifier  # Backward
      Bal: abbr-name=Bal, classifications=Action-PhysicalType  # Balance
      Ballstc: abbr-name=Ballstc, classifications=Condition-Qualifier  # Ballistic
      Band: abbr-name=Band, classifications=Condition-Qualifier
      Bar: abbr-name=Bar, classifications=Mean-Environment-Device  # As unit of measure
      Baro: abbr-name=Baro, classifications=Condition-Qualifier  # Barometric
      Bas: abbr-name=Bas, classifications=Condition-Qualifier  # Base | Pre-processed sensor data, model free, abstraction of the sensor hardware.
      Basc: abbr-name=Basc, classifications=Condition-Qualifier  # Basic
      Batt: abbr-name=Batt, classifications=Mean-Environment-Device  # Battery
      Bcu: abbr-name=Bcu, classifications=Mean-Environment-Device  # BCU | (High Voltage) Battery Control Unit
      Bd: abbr-name=Bd, classifications=Mean-Environment-Device  # Board
      Bdc: abbr-name=Bdc, classifications=Condition-Qualifier  # BDC | Bottom Dead Center
      Beam: abbr-name=Beam, classifications=Action-PhysicalType
      Bel: abbr-name=Bel, classifications=Condition-Qualifier  # bel (decibel)
      Belgium: abbr-name=Belgium, classifications=Condition-Qualifier
      Bench: abbr-name=Bench, classifications=Mean-Environment-Device  # bench mode. During OBD I / OBD II diagnoses and error management validation and tuning, the bench mode has to be used so as to force some failures.
      Bfr: abbr-name=Bfr, classifications=Preposition  # Before
      Bgn: abbr-name=Bgn, classifications=Action-PhysicalType  # Begin
      Bhv: abbr-name=Bhv, classifications=Action-PhysicalType  # Behave
      Bhvr: abbr-name=Bhvr, classifications=Condition-Qualifier  # Behaviour
      Bicycle: abbr-name=Bicycle, classifications=Mean-Environment-Device
      Bif: abbr-name=Bif, classifications=Mean-Environment-Device  # Bi-fuel
      Bilnr: abbr-name=Bilnr, classifications=Condition-Qualifier  # Bilinear | e.g. in bilinear interpolation
      Bio: abbr-name=Bio, classifications=Condition-Qualifier  # Biological
      Bkt: abbr-name=Bkt, classifications=Mean-Environment-Device  # Bucket | E.g. for excavator or wheel loader applications
      Bkup: abbr-name=Bkup, classifications=Condition-Qualifier  # Backup
      Blb: abbr-name=Blb, classifications=Mean-Environment-Device  # Bulb
      Bli: abbr-name=Bli, classifications=Condition-Qualifier  # Blind
      Blink: abbr-name=Blink, classifications=Action-PhysicalType
      Blk: abbr-name=Blk, classifications=Condition-Qualifier  # Block
      Blkd: abbr-name=Blkd, classifications=Condition-Qualifier  # Blocked
      Blnk: abbr-name=Blnk, classifications=Condition-Qualifier  # Blank | e.g. blank out engine fuel injection, for specifying a gap
      Blow: abbr-name=Blow, classifications=Action-PhysicalType
      Blowr: abbr-name=Blowr, classifications=Mean-Environment-Device  # Blower
      Bls: abbr-name=Bls, classifications=Mean-Environment-Device  # BLS | Brake Light Switch
      Blstr: abbr-name=Blstr, classifications=Mean-Environment-Device  # Bolster
      Blt: abbr-name=Blt, classifications=Mean-Environment-Device  # Belt | seat belt. this keyword is used to express the seat belt, which is a kind of security rope to keep the passenger in the seat in case of an accident.
      Blueprint: abbr-name=Blueprint, classifications=Condition-Qualifier
      Bmp: abbr-name=Bmp, classifications=Mean-Environment-Device  # Bumper
      Bms: abbr-name=Bms, classifications=Mean-Environment-Device  # BMS | Battery Management System
      Bnce: abbr-name=Bnce, classifications=Mean-Environment-Device  # Bounce
      Bncg: abbr-name=Bncg, classifications=Condition-Qualifier  # Bouncing
      Bnd: abbr-name=Bnd, classifications=Condition-Qualifier  # Bound
      Bndls: abbr-name=Bndls, classifications=Condition-Qualifier  # Boundless
      Bnk: abbr-name=Bnk, classifications=Mean-Environment-Device  # Bank
      Body: abbr-name=Body, classifications=Mean-Environment-Device
      Bolt: abbr-name=Bolt, classifications=Mean-Environment-Device  # e. g. as in Lock Bolt
      Boost: abbr-name=Boost, classifications=Action-PhysicalType  # A general expression to increase performance for a short period of time or to give a higher output. e.g. to give high voltage output or to support the combustion engine with additional torque (e.g. with a Integrated Starter Generator) for acceleration
      Boot: abbr-name=Boot, classifications=Condition-Qualifier
      Botm: abbr-name=Botm, classifications=Mean-Environment-Device  # Bottom
      Box: abbr-name=Box, classifications=Mean-Environment-Device
      Bp: abbr-name=Bp, classifications=Condition-Qualifier  # Bandpass
      Bpil: abbr-name=Bpil, classifications=Mean-Environment-Device  # B-Pillar of a car
      Brazil: abbr-name=Brazil, classifications=Condition-Qualifier
      Brdg: abbr-name=Brdg, classifications=Condition-Qualifier  # Bridge | bridge contact
      Break: abbr-name=Break, classifications=Action-PhysicalType
      Brg: abbr-name=Brg, classifications=Mean-Environment-Device  # Bearing | e.g. in compressor bearing, engine bearing
      Bri: abbr-name=Bri, classifications=Action-PhysicalType  # Brightness
      Brk: abbr-name=Brk, classifications=Mean-Environment-Device  # Brake
      Brkg: abbr-name=Brkg, classifications=Action-PhysicalType  # Braking
      Brkn: abbr-name=Brkn, classifications=Condition-Qualifier  # Broken
      Brkt: abbr-name=Brkt, classifications=Mean-Environment-Device  # Bracket
      Brn: abbr-name=Brn, classifications=Action-PhysicalType  # Burn
      Brng: abbr-name=Brng, classifications=Action-PhysicalType  # Burning
      Brnr: abbr-name=Brnr, classifications=Mean-Environment-Device  # Burner
      Bsw: abbr-name=Bsw, classifications=Mean-Environment-Device  # BSW | Basic Software
      Btn: abbr-name=Btn, classifications=Mean-Environment-Device  # Button
      Buc: abbr-name=Buc, classifications=Mean-Environment-Device  # Buckle | Part of supplement restraint system to protect occupant in case of crash
      Bucd: abbr-name=Bucd, classifications=Condition-Qualifier  # Buckled | Buckling of occupant
      Buf: abbr-name=Buf, classifications=Condition-Qualifier  # Buffer
      Bus: abbr-name=Bus, classifications=Mean-Environment-Device  # used for the vehicle and not as a data bus
      Busy: abbr-name=Busy, classifications=Condition-Qualifier
      Buz: abbr-name=Buz, classifications=Condition-Qualifier  # Buzzer
      Bw: abbr-name=Bw, classifications=Condition-Qualifier  # Bandwidth
      By: abbr-name=By, classifications=Preposition  # Preposition
      Byp: abbr-name=Byp, classifications=Action-PhysicalType  # Bypass
      Byp1: abbr-name=Byp, classifications=Mean-Environment-Device  # Bypass
      Cal: abbr-name=Cal, classifications=Condition-Qualifier  # Calibration
      Calc: abbr-name=Calc, classifications=Action-PhysicalType  # Calculate
      Calcd: abbr-name=Calcd, classifications=Condition-Qualifier  # Calculated
      Calcn: abbr-name=Calcn, classifications=Action-PhysicalType  # Calculation
      Call: abbr-name=Call, classifications=Condition-Qualifier
      Calrc: abbr-name=Calrc, classifications=Condition-Qualifier  # Caloric
      Camsft: abbr-name=Camsft, classifications=Mean-Environment-Device  # Camshaft
      Can: abbr-name=Can, classifications=Mean-Environment-Device  # CAN | Controller Area Network
      Canada: abbr-name=Canada, classifications=Condition-Qualifier
      Canng: abbr-name=Canng, classifications=Mean-Environment-Device  # Canning | e.g: Catalyst Canning
      Car: abbr-name=Car, classifications=Mean-Environment-Device
      Carb: abbr-name=Carb, classifications=Condition-Qualifier  # CARB | Californian Air Resource Board
      Carbon: abbr-name=Carbon, classifications=Mean-Environment-Device
      Case: abbr-name=Case, classifications=Mean-Environment-Device
      Cat: abbr-name=Cat, classifications=Mean-Environment-Device  # Catalyst
      Cavtn: abbr-name=Cavtn, classifications=Mean-Environment-Device  # Cavitation
      Cbn: abbr-name=Cbn, classifications=Mean-Environment-Device  # Cabin
      Ccp: abbr-name=Ccp, classifications=Mean-Environment-Device  # CCP | CAN Calibration Protocol
      Cd: abbr-name=Cd, classifications=Mean-Environment-Device  # Candela | Unit of measure of luminous intensity
      Cdn: abbr-name=Cdn, classifications=Condition-Qualifier  # Condition
      Cdng: abbr-name=Cdng, classifications=Action-PhysicalType  # Conditioning
      Cdnr: abbr-name=Cdnr, classifications=Mean-Environment-Device  # Conditioner
      Cell: abbr-name=Cell, classifications=Mean-Environment-Device
      Cen: abbr-name=Cen, classifications=Condition-Qualifier  # Central
      Centi: abbr-name=Centi, classifications=Mean-Environment-Device
      Centr: abbr-name=Centr, classifications=Condition-Qualifier  # Center
      Centrfgl: abbr-name=Centrfgl, classifications=Condition-Qualifier  # Centrifugal
      Ceramic: abbr-name=Ceramic, classifications=Mean-Environment-Device
      Cfg: abbr-name=Cfg, classifications=Condition-Qualifier  # Configuration
      Cfgd: abbr-name=Cfgd, classifications=Condition-Qualifier  # Configured
      Cfm: abbr-name=Cfm, classifications=Condition-Qualifier  # Confirmation
      Cfmd: abbr-name=Cfmd, classifications=Condition-Qualifier  # Confirmed
      Cgrd: abbr-name=Cgrd, classifications=Mean-Environment-Device  # Centigrade
      Ch: abbr-name=Ch, classifications=Condition-Qualifier  # Channel | This keyword is used to express a channel. A channel is a defined port (of a bundle of ports) of a data line.
      Chain: abbr-name=Chain, classifications=Mean-Environment-Device
      Chartc: abbr-name=Chartc, classifications=Condition-Qualifier  # Characteristic
      Chassis: abbr-name=Chassis, classifications=Mean-Environment-Device
      Chd: abbr-name=Chd, classifications=Mean-Environment-Device  # Child
      Chemcl: abbr-name=Chem, classifications=Condition-Qualifier  # Chemical | Chemical in "chemical catalyst heating"
      Chg: abbr-name=Chg, classifications=Action-PhysicalType  # Change
      Chill: abbr-name=Chill, classifications=Condition-Qualifier
      Chillr: abbr-name=Chillr, classifications=Mean-Environment-Device  # Chiller
      Chimer: abbr-name=Chimer, classifications=Mean-Environment-Device
      China: abbr-name=China, classifications=Condition-Qualifier
      Chirp: abbr-name=Chirp, classifications=Action-PhysicalType
      Chk: abbr-name=Chk, classifications=Condition-Qualifier  # Check
      Chks: abbr-name=Chks, classifications=Condition-Qualifier  # Checksum
      Chmb: abbr-name=Chmb, classifications=Mean-Environment-Device  # Chamber
      Choke: abbr-name=Choke, classifications=Mean-Environment-Device  # Choking, choke line. this keyword is used to describe the appearance of choking effects in an (air-)stream, e.g. at the choke line of a turbocharger (which is a characteristic parameter)
      Chrg: abbr-name=Chrg, classifications=Condition-Qualifier  # Charge
      Chrgn: abbr-name=Chrgn, classifications=Action-PhysicalType  # Charging
      Chrgr: abbr-name=Chrgr, classifications=Mean-Environment-Device  # Charger
      Cigarette: abbr-name=Cigarette, classifications=Mean-Environment-Device
      Circ: abbr-name=Circ, classifications=Mean-Environment-Device  # Circuit
      Circum: abbr-name=Circum, classifications=Mean-Environment-Device  # Circumference | Used in the meaning of the wheel circumference
      Circuml: abbr-name=Circuml, classifications=Condition-Qualifier  # Circumferential
      City: abbr-name=City, classifications=Condition-Qualifier
      Class: abbr-name=Class, classifications=Condition-Qualifier
      Classn: abbr-name=Classn, classifications=Action-PhysicalType  # Classification
      Claw: abbr-name=Claw, classifications=Mean-Environment-Device  # e.g. claw couplings are used within automated transmission instead of clutches
      Clima: abbr-name=Clima, classifications=Action-PhysicalType  # Climatisation
      Climb: abbr-name=Climb, classifications=Condition-Qualifier  # e.g. climb mode
      Clk: abbr-name=Clk, classifications=Condition-Qualifier  # Clock
      Cllsn: abbr-name=Cllsn, classifications=Action-PhysicalType  # Collision
      Clmp: abbr-name=Clmp, classifications=Action-PhysicalType  # Clamp
      Clmpd: abbr-name=Clmpd, classifications=Condition-Qualifier  # Clamped
      Cln: abbr-name=Cln, classifications=Condition-Qualifier  # Clean
      Clng: abbr-name=Clng, classifications=Condition-Qualifier  # Cleaning
      Clnr: abbr-name=Clnr, classifications=Mean-Environment-Device  # Cleaner
      Clog: abbr-name=Clog, classifications=Condition-Qualifier  # Similar to dirty, e.g. clog filter.
      Clr: abbr-name=Clr, classifications=Action-PhysicalType  # Clear
      Clrd: abbr-name=Clrd, classifications=Condition-Qualifier  # Cleared
      Cls: abbr-name=Cls, classifications=Action-PhysicalType  # Close
      Clsd: abbr-name=Clsd, classifications=Condition-Qualifier  # Closed
      Clstr: abbr-name=Clstr, classifications=Mean-Environment-Device  # Cluster
      Clu: abbr-name=Clu, classifications=Mean-Environment-Device  # Clutch
      Cmb: abbr-name=Cmb, classifications=Mean-Environment-Device  # Combustion
      Cmd: abbr-name=Cmd, classifications=Condition-Qualifier  # Command
      Cmft: abbr-name=Cmft, classifications=Condition-Qualifier  # Comfort | comfort. this keyword is used to express something as comfortable or convenient
      Cmn: abbr-name=Cmn, classifications=Condition-Qualifier  # Common | common. for common environmental data (stored with all failures of one project).
      Cmng: abbr-name=Cmng, classifications=Action-PhysicalType  # Coming
      Cmp: abbr-name=Cmp, classifications=Action-PhysicalType  # Compensation
      Cmpbl: abbr-name=Cmpbl, classifications=Condition-Qualifier  # Compatible
      Cmpblty: abbr-name=Cmpblty, classifications=Condition-Qualifier  # Compatibility
      Cmpl: abbr-name=Cmpl, classifications=Condition-Qualifier  # Complete
      Cmplx: abbr-name=Cmplx, classifications=Condition-Qualifier  # Complex
      Cmpn: abbr-name=Cmpn, classifications=Condition-Qualifier  # Compression
      Cmpr: abbr-name=Cmpr, classifications=Mean-Environment-Device  # Compressor | This keyword is used to express a component producing a compressed (= with raised pressure) working medium, e.g. air, refrigerant.
      Cmptmt: abbr-name=Cmptmt, classifications=Mean-Environment-Device  # Compartment
      Cmu: abbr-name=Cmu, classifications=Condition-Qualifier  # Commutation
      Cncl: abbr-name=Cncl, classifications=Action-PhysicalType  # Cancel
      Cncld: abbr-name=Cncld, classifications=Condition-Qualifier  # Cancelled
      Cnct: abbr-name=Cnct, classifications=Action-PhysicalType  # Connect
      Cnctn: abbr-name=Cnctn, classifications=Condition-Qualifier  # Connection
      Cnctr: abbr-name=Cnctr, classifications=Mean-Environment-Device  # Connector
      Cndctvty: abbr-name=Cndctvty, classifications=Action-PhysicalType  # Conductivity
      Cng: abbr-name=Cng, classifications=Mean-Environment-Device  # CNG | Compressed Natural Gas
      Cns: abbr-name=Cns, classifications=Condition-Qualifier  # Consumption
      Cnse: abbr-name=Cnse, classifications=Action-PhysicalType  # Consume
      Cnsr: abbr-name=Cnsr, classifications=Mean-Environment-Device  # Consumer
      Cnt: abbr-name=Cnt, classifications=Action-PhysicalType  # Count
      Cntct: abbr-name=Cntct, classifications=Mean-Environment-Device  # Contact | used in the sense of contact or contactor e.g. in "close contact", "contactor open", "contact defect" or "high-voltage contactors"
      Cntnr: abbr-name=Cntnr, classifications=Mean-Environment-Device  # Container
      Cntr: abbr-name=Cntr, classifications=Condition-Qualifier  # Counter | Also applicable to running indexes.
      Cntxt: abbr-name=Cntxt, classifications=Condition-Qualifier  # Context | e.g. CAN frame context
      Cnv: abbr-name=Cnv, classifications=Action-PhysicalType  # Convert
      Cnvc: abbr-name=Cnvc, classifications=Condition-Qualifier  # Convection
      Cnvn: abbr-name=Cnvn, classifications=Action-PhysicalType  # Conversion
      Cnvr: abbr-name=Cnvr, classifications=Condition-Qualifier  # Converter
      Cnvtb: abbr-name=Cnvtb, classifications=Condition-Qualifier  # Convertible
      Cnvtn: abbr-name=Cnvtn, classifications=Condition-Qualifier  # Convention
      Co: abbr-name=Co, classifications=Mean-Environment-Device  # CO | Carbon Monoxide
      Coach: abbr-name=Coach, classifications=Mean-Environment-Device  # motor coach, often simply called a bus
      Coast: abbr-name=Coast, classifications=Action-PhysicalType  # Coasting | situation of vehicle, where the clutch is kept open and the vehicle is moving by its own inertia, e.g. rolling downhill (coast driving state of a vehicle is a typical transmission / clutch function).
      Cod: abbr-name=Cod, classifications=Condition-Qualifier  # Code
      Coeff: abbr-name=Coeff, classifications=Condition-Qualifier  # Coefficient
      Cog: abbr-name=Cog, classifications=Mean-Environment-Device  # COG | Center of Gravity
      Cohrncy: abbr-name=Cohrncy, classifications=Action-PhysicalType  # Coherency
      Cohrnt: abbr-name=Cohrnt, classifications=Condition-Qualifier  # Coherent
      Coil: abbr-name=Coil, classifications=Mean-Environment-Device
      Col: abbr-name=Col, classifications=Condition-Qualifier  # Column
      Cold: abbr-name=Cold, classifications=Condition-Qualifier
      Coll: abbr-name=Coll, classifications=Mean-Environment-Device  # Collector
      Collct: abbr-name=Collct, classifications=Action-PhysicalType  # Collect
      Collctd: abbr-name=Collctd, classifications=Condition-Qualifier  # Collected
      Collctn: abbr-name=Collctn, classifications=Condition-Qualifier  # Collection
      Com: abbr-name=Com, classifications=Condition-Qualifier  # Communication
      Comp: abbr-name=Comp, classifications=Condition-Qualifier  # Comparison
      Compu: abbr-name=Compu, classifications=Condition-Qualifier  # Computation
      Con: abbr-name=Con, classifications=Condition-Qualifier  # Constant
      Conc: abbr-name=Conc, classifications=Action-PhysicalType  # Concentration
      Conds: abbr-name=Conds, classifications=Action-PhysicalType  # Condense
      Consctv: abbr-name=Consctv, classifications=Condition-Qualifier  # Consecutive
      Consist: abbr-name=Consist, classifications=Action-PhysicalType
      Consistnc: abbr-name=Consistnc, classifications=Condition-Qualifier  # Consistence
      Consold: abbr-name=Consol, classifications=Action-PhysicalType  # Consolidated | A consolidated physical value is either the measured physical value or an estimated one.
      Constr: abbr-name=Constr, classifications=Condition-Qualifier  # Constraint
      Contns: abbr-name=Contns, classifications=Condition-Qualifier  # Continuous
      Contrb: abbr-name=Contrb, classifications=Action-PhysicalType  # Contribute
      Contrbn: abbr-name=Contrbn, classifications=Condition-Qualifier  # Contribution
      Cool: abbr-name=Cool, classifications=Mean-Environment-Device
      Coolg: abbr-name=Coolg, classifications=Action-PhysicalType  # Cooling | This keyword is used to describe the cooling system e.g. of the engine. A cooling request can be fulfilled by air, coolant, or other cooling systems or refrigerants.
      Coolr: abbr-name=Coolr, classifications=Mean-Environment-Device  # Cooler
      Coolt: abbr-name=Coolt, classifications=Mean-Environment-Device  # Coolant
      Coor: abbr-name=Coor, classifications=Condition-Qualifier  # Coordinate
      Coord: abbr-name=Coord, classifications=Condition-Qualifier  # Coordinated
      Coorn: abbr-name=Coorn, classifications=Condition-Qualifier  # Coordination
      Coorr: abbr-name=Coorr, classifications=Condition-Qualifier  # Coordinator
      Copy: abbr-name=Copy, classifications=Condition-Qualifier
      Core: abbr-name=Core, classifications=Condition-Qualifier
      Cornr: abbr-name=Cornr, classifications=Mean-Environment-Device  # Corner
      Cornrg: abbr-name=Cornrg, classifications=Action-PhysicalType  # Cornering
      Corr: abbr-name=Corr, classifications=Condition-Qualifier  # Correct
      Corrd: abbr-name=Corrd, classifications=Condition-Qualifier  # Corrected
      Corrl: abbr-name=Corrl, classifications=Action-PhysicalType  # Correlate
      Corrln: abbr-name=Corrln, classifications=Condition-Qualifier  # Correlation
      Corrn: abbr-name=Corrn, classifications=Condition-Qualifier  # Correction
      Cot: abbr-name=Cot, classifications=Condition-Qualifier  # Coated
      Coulomb: abbr-name=Coulomb, classifications=Mean-Environment-Device  # Unit of measure for Electric charge
      Coupl: abbr-name=Coupl, classifications=Condition-Qualifier  # Coupling | It is the keyword for any linkage of software modules or functionalities or to express a kind of strict connection between two otherwise not linked parts.
      Coupld: abbr-name=Coupld, classifications=Condition-Qualifier  # Coupled
      Couplr: abbr-name=Couplr, classifications=Mean-Environment-Device  # Coupler
      Course: abbr-name=Course, classifications=Mean-Environment-Device
      Cover: abbr-name=Cover, classifications=Mean-Environment-Device
      Cp: abbr-name=Cp, classifications=Action-PhysicalType  # Capacity | this keyword is used to express the Physical Meaning of a capacity (e.g. thermal capacity of oil)
      Cpby: abbr-name=Cpby, classifications=Condition-Qualifier  # Capability
      Cpil: abbr-name=Cpil, classifications=Mean-Environment-Device  # C-Pillar of a car
      Cpl: abbr-name=Cpl, classifications=Condition-Qualifier  # Complement
      Cpt: abbr-name=Cpt, classifications=Condition-Qualifier  # Component
      Cpv: abbr-name=Cpv, classifications=Mean-Environment-Device  # CPV | Canister Purge Valve
      Crash: abbr-name=Crash, classifications=Mean-Environment-Device
      Crawl: abbr-name=Crawl, classifications=Action-PhysicalType
      Crc: abbr-name=Crc, classifications=Condition-Qualifier  # CRC | Cyclic Redundancy Check
      Creat: abbr-name=Creat, classifications=Action-PhysicalType  # Create
      Crit: abbr-name=Crit, classifications=Condition-Qualifier  # Critical
      Crk: abbr-name=Crk, classifications=Action-PhysicalType  # Crank
      Crkcs: abbr-name=Crkcs, classifications=Mean-Environment-Device  # Crankcase
      Crksft: abbr-name=Crksft, classifications=Mean-Environment-Device  # Crankshaft
      Crp: abbr-name=Crp, classifications=Action-PhysicalType  # Creep | example: creep mode of automatic transmission
      Crs: abbr-name=Crs, classifications=Mean-Environment-Device  # Cruise
      Crv: abbr-name=Crv, classifications=Mean-Environment-Device  # Curve
      Crvt: abbr-name=Crvt, classifications=Action-PhysicalType  # Curvature
      Crypto: abbr-name=Crypto, classifications=Mean-Environment-Device  # Cryptography
      Cstr: abbr-name=Cstr, classifications=Mean-Environment-Device  # Canister
      Cta: abbr-name=Cta, classifications=Condition-Qualifier  # Criteria
      Ctrl: abbr-name=Ctrl, classifications=Condition-Qualifier  # Control
      Ctrld: abbr-name=Ctrld, classifications=Condition-Qualifier  # Controlled
      Ctrlr: abbr-name=Ctrlr, classifications=Mean-Environment-Device  # Controller
      Ctrsft: abbr-name=Ctrsft, classifications=Mean-Environment-Device  # Countershaft
      Ctry: abbr-name=Ctry, classifications=Mean-Environment-Device  # Country
      Cub: abbr-name=Cub, classifications=Condition-Qualifier  # Cubic
      Cubd: abbr-name=Cubd, classifications=Condition-Qualifier  # Cubed
      Cur: abbr-name=Cur, classifications=Condition-Qualifier  # Current
      Curb: abbr-name=Curb, classifications=Mean-Environment-Device  # American English for Kerb
      Curt: abbr-name=Curt, classifications=Mean-Environment-Device  # Curtain
      Cush: abbr-name=Cush, classifications=Mean-Environment-Device  # Cushion
      Cust: abbr-name=Cust, classifications=Mean-Environment-Device  # Customer
      Cut: abbr-name=Cut, classifications=Action-PhysicalType
      Cvt: abbr-name=Cvt, classifications=Mean-Environment-Device  # CVT | Continuous Variable Transmission
      Cyc: abbr-name=Cyc, classifications=Condition-Qualifier  # Cycle
      Cyl: abbr-name=Cyl, classifications=Mean-Environment-Device  # Cylinder
      D: abbr-name=D, classifications=Condition-Qualifier  # Differential part of a control structure
      Dampg: abbr-name=Dampg, classifications=Condition-Qualifier  # Damping
      Dampr: abbr-name=Dampr, classifications=Mean-Environment-Device  # Damper
      Das: abbr-name=Das, classifications=Mean-Environment-Device  # DAS | Driver Assistance System
      Dash: abbr-name=Dash, classifications=Condition-Qualifier  # Dashpot
      Data: abbr-name=Data, classifications=Action-PhysicalType
      Date: abbr-name=Date, classifications=Action-PhysicalType  # date, point of time. This keyword is used to refer to a precise moment or a specific date. This can be a "time stamp" or a calendar date as well.
      Day: abbr-name=Day, classifications=Mean-Environment-Device
      Dayti: abbr-name=Dayti, classifications=Mean-Environment-Device  # Daytime
      Dbg: abbr-name=Dbg, classifications=Condition-Qualifier  # Debug
      Dbl: abbr-name=Dbl, classifications=Condition-Qualifier  # Double
      Dbnd: abbr-name=Dbnd, classifications=Action-PhysicalType  # Deadband
      Dc: abbr-name=Dc, classifications=Condition-Qualifier  # DC | Direct Current/Voltage
      Dcc: abbr-name=Dcc, classifications=Mean-Environment-Device  # DCC | Distance Cruise Control. In case of cruise control on, the distance to the vehicle ahead is measured. If the distance falls below a defined limit, the vehicle speed is reduced automatically.
      Dcha: abbr-name=Dcha, classifications=Condition-Qualifier  # Discharge
      Dcm: abbr-name=Dcm, classifications=Mean-Environment-Device  # DCM | Diagnostic Communication Manager
      Dct: abbr-name=Dct, classifications=Mean-Environment-Device  # DCT | Dual Clutch Transmission
      De: abbr-name=De, classifications=Condition-Qualifier  # Deviation
      Deactvd: abbr-name=Deactvd, classifications=Condition-Qualifier  # Deactivated
      Deactvn: abbr-name=Deactvn, classifications=Condition-Qualifier  # Deactivation
      Deactvt: abbr-name=Deactvt, classifications=Action-PhysicalType  # Deactivate
      Dead: abbr-name=Dead, classifications=Condition-Qualifier
      Deb: abbr-name=Deb, classifications=Action-PhysicalType  # Debounce
      Dec: abbr-name=Dec, classifications=Action-PhysicalType  # Decrease | decrease, decrementation. this keyword is used to express the stepwise descent of a value or counter.
      Decel: abbr-name=Decel, classifications=Condition-Qualifier  # Deceleration
      Deci: abbr-name=Deci, classifications=Condition-Qualifier  # Unit extension use: decibel (DeciBel, display name dB)
      Decod: abbr-name=Decod, classifications=Action-PhysicalType  # Decode
      Deep: abbr-name=Deep, classifications=Condition-Qualifier
      Def: abbr-name=Def, classifications=Action-PhysicalType  # Define
      Defd: abbr-name=Defd, classifications=Condition-Qualifier  # Defined
      Definite: abbr-name=Definite, classifications=Condition-Qualifier  # e.g. definite path from navigation system
      Defn: abbr-name=Defn, classifications=Condition-Qualifier  # Definition
      Defrst: abbr-name=Defrst, classifications=Action-PhysicalType  # Defrost
      Defu: abbr-name=Defu, classifications=Condition-Qualifier  # Defueling | defueling. It shall be used to describe the action of taking fuel out of the tank.
      Deg: abbr-name=Deg, classifications=Mean-Environment-Device  # Degree
      Degraded: abbr-name=Degraded, classifications=Condition-Qualifier
      Del: abbr-name=Del, classifications=Action-PhysicalType  # Delete
      Delta: abbr-name=Delta, classifications=Condition-Qualifier
      Dem: abbr-name=Dem, classifications=Mean-Environment-Device  # DEM | Diagnostic Event Manager
      Dens: abbr-name=Dens, classifications=Action-PhysicalType  # Density
      Dep: abbr-name=Dep, classifications=Condition-Qualifier  # Depression
      Deploy: abbr-name=Deploy, classifications=Action-PhysicalType
      Deploymt: abbr-name=Deploymt, classifications=Condition-Qualifier  # Deployment
      Deriv: abbr-name=Deriv, classifications=Action-PhysicalType  # Derive
      Des: abbr-name=Des, classifications=Condition-Qualifier  # Desired
      Descr: abbr-name=Descr, classifications=Condition-Qualifier  # Description
      Desorpn: abbr-name=Desorpn, classifications=Condition-Qualifier  # Desorption
      Desox: abbr-name=Desox, classifications=Mean-Environment-Device  # Desulphurization
      Dest: abbr-name=Dest, classifications=Condition-Qualifier  # Destination
      Detd: abbr-name=Detd, classifications=Condition-Qualifier  # Detected
      Detn: abbr-name=Detn, classifications=Action-PhysicalType  # Detection
      Detrm: abbr-name=Detrm, classifications=Condition-Qualifier  # Determined
      Dev: abbr-name=Dev, classifications=Mean-Environment-Device  # Device
      Devlp: abbr-name=Devlp, classifications=Action-PhysicalType  # Develop
      Dew: abbr-name=Dew, classifications=Mean-Environment-Device  # Dew Point
      Dfct: abbr-name=Dfct, classifications=Condition-Qualifier  # Defect
      Dft: abbr-name=Dft, classifications=Condition-Qualifier  # Default | default
      Dftl: abbr-name=Dftl, classifications=Mean-Environment-Device  # Differential | drive train context
      Di: abbr-name=Di, classifications=Condition-Qualifier  # Disable
      Diag: abbr-name=Diag, classifications=Action-PhysicalType  # Diagnosis
      Diagc: abbr-name=Diagc, classifications=Mean-Environment-Device  # Diagnostic
      Diam: abbr-name=Diam, classifications=Condition-Qualifier  # Diameter | This name describes the component size, e.g. of driving wheels
      Dif: abbr-name=Dif, classifications=Condition-Qualifier  # Difference
      Difsn: abbr-name=Difsn, classifications=Condition-Qualifier  # Diffusion
      Dig: abbr-name=Dig, classifications=Condition-Qualifier  # Digital
      Dil: abbr-name=Dil, classifications=Condition-Qualifier  # Dilution
      Dim: abbr-name=Dim, classifications=Action-PhysicalType  # used as compound with Light
      Dimension: abbr-name=Dimension, classifications=Action-PhysicalType
      Dio: abbr-name=Dio, classifications=Mean-Environment-Device  # DIO | Digital Input/Output
      Dir: abbr-name=Dir, classifications=Condition-Qualifier  # Direction
      Dire: abbr-name=Dire, classifications=Condition-Qualifier  # Directory
      Dis: abbr-name=Dis, classifications=Condition-Qualifier  # Discrete
      Disa: abbr-name=Disa, classifications=Action-PhysicalType  # Disappear | disappear. used, in order to define a state of failure: "disappeared failure"
      Disad: abbr-name=Disad, classifications=Action-PhysicalType  # Disabled
      Disarm: abbr-name=Disarm, classifications=Action-PhysicalType
      Disarmed: abbr-name=Disarmed, classifications=Condition-Qualifier
      Discnct: abbr-name=Discnct, classifications=Action-PhysicalType  # Disconnect
      Disengmt: abbr-name=Disengmt, classifications=Condition-Qualifier  # Disengagement
      Disp: abbr-name=Disp, classifications=Mean-Environment-Device  # Display | In both meanings, the display (Component) and to display (Characteristic)
      Dispd: abbr-name=Dispd, classifications=Condition-Qualifier  # Displayed
      Distbn: abbr-name=Distbn, classifications=Condition-Qualifier  # Distribution
      Div: abbr-name=Div, classifications=Condition-Qualifier  # Division
      Dly: abbr-name=Dly, classifications=Condition-Qualifier  # Delay
      Dmd: abbr-name=Dmd, classifications=Condition-Qualifier  # Demand
      Done: abbr-name=Done, classifications=Condition-Qualifier  # e.g. plausibility check done
      Door: abbr-name=Door, classifications=Mean-Environment-Device
      Dpl: abbr-name=Dpl, classifications=Condition-Qualifier  # Displacement
      Drain: abbr-name=Drn, classifications=Condition-Qualifier  # To draw off liquid gradually or completely
      Drg: abbr-name=Drg, classifications=Condition-Qualifier  # Drag | resistance, caused by mechanical, aerodynamical of topographical influences, being effective against a movement
      Drift: abbr-name=Drift, classifications=Condition-Qualifier
      Droop: abbr-name=Droop, classifications=Condition-Qualifier
      Drp: abbr-name=Drp, classifications=Condition-Qualifier  # Drop
      Drv: abbr-name=Drv, classifications=Condition-Qualifier  # Drive | drive (gear engaged)
      Drvg: abbr-name=Drvg, classifications=Action-PhysicalType  # Driving | Action of driving the vehicle.
      Drvn: abbr-name=Drvn, classifications=Condition-Qualifier  # Driven
      Drvr: abbr-name=Drvr, classifications=Mean-Environment-Device  # Driver | Driver of the vehicle.
      Drvr1: abbr-name=Drvr, classifications=Mean-Environment-Device  # Driver | Example: as in device driver.
      Dry: abbr-name=Dry, classifications=Condition-Qualifier  # dry. dry is the opposite of lubricated in case of friction
      Ds: abbr-name=Ds, classifications=Condition-Qualifier  # Down-stream | down-stream or down stream or downstream
      Dsgn: abbr-name=Dsgn, classifications=Action-PhysicalType  # Designate
      Dshb: abbr-name=Dshb, classifications=Mean-Environment-Device  # Dashboard | can also be used in the sense of instrument cluster, instrument panel
      Dsk: abbr-name=Dsk, classifications=Mean-Environment-Device  # Disk
      Dsl: abbr-name=Dsl, classifications=Mean-Environment-Device  # Diesel
      Dst: abbr-name=Dst, classifications=Action-PhysicalType  # Distance
      Dstbc: abbr-name=Dstbc, classifications=Condition-Qualifier  # Disturbance
      Dstr: abbr-name=Dstr, classifications=Action-PhysicalType  # Destruct
      Dstrn: abbr-name=Dstrn, classifications=Condition-Qualifier  # Destruction
      Dt: abbr-name=Dt, classifications=Mean-Environment-Device  # Drivetrain
      Dtc: abbr-name=Dtc, classifications=Condition-Qualifier  # DTC | Diagnostic Trouble Code
      Dtd: abbr-name=Dtd, classifications=Mean-Environment-Device  # DTD | Drivetrain Torque Distribution
      Dthr: abbr-name=Dthr, classifications=Action-PhysicalType  # Dither | Dither used in control and signal processing
      Dual: abbr-name=Dual, classifications=Condition-Qualifier
      Dummy: abbr-name=Dummy, classifications=Condition-Qualifier
      Dump: abbr-name=Dump, classifications=Action-PhysicalType
      Durg: abbr-name=Durg, classifications=Preposition  # During
      Durn: abbr-name=Durn, classifications=Condition-Qualifier  # Duration
      Duty: abbr-name=Duty, classifications=Condition-Qualifier
      Dwn: abbr-name=Dwn, classifications=Condition-Qualifier  # Down
      Dyn: abbr-name=Dyn, classifications=Condition-Qualifier  # Dynamic
      Dyno: abbr-name=Dyno, classifications=Mean-Environment-Device  # Dynamometer
      Easy: abbr-name=Easy, classifications=Condition-Qualifier
      Ec: abbr-name=Ec, classifications=Condition-Qualifier  # EC | European Community
      Eco: abbr-name=Eco, classifications=Condition-Qualifier  # Economy | economy. related to the detection of driver type either an economy/comfort oriented or a sportive/power requesting driver can be distinguished.
      Ecu: abbr-name=Ecu, classifications=Mean-Environment-Device  # ECU | Electronic Control Unit
      Edge: abbr-name=Edge, classifications=Condition-Qualifier
      Edit: abbr-name=Edit, classifications=Action-PhysicalType
      Eep: abbr-name=Eep, classifications=Mean-Environment-Device  # EEPROM | Electrically Erasable Programmable Read-Only Memory
      Efc: abbr-name=Efc, classifications=Condition-Qualifier  # Effective
      Eff: abbr-name=Eff, classifications=Action-PhysicalType  # Efficiency
      Effort: abbr-name=Effort, classifications=Condition-Qualifier
      Egr: abbr-name=Egr, classifications=Mean-Environment-Device  # EGR | Exhaust Gas Recirculation
      Egy: abbr-name=Egy, classifications=Action-PhysicalType  # Energy
      Egypt: abbr-name=Egypt, classifications=Condition-Qualifier
      Ehb: abbr-name=Ehb, classifications=Mean-Environment-Device  # EHB | Electro Hydraulic Brake
      Elec: abbr-name=Elec, classifications=Condition-Qualifier  # Electric | Used in the sense of electric or electrical
      Electc: abbr-name=Electc, classifications=Condition-Qualifier  # Electronic
      Elevn: abbr-name=Elevn, classifications=Action-PhysicalType  # Elevation | Measured angle from horizon
      Elm: abbr-name=Elm, classifications=Mean-Environment-Device  # Element
      Elpd: abbr-name=Elpd, classifications=Condition-Qualifier  # Elapsed
      Eltpnm: abbr-name=Eltpnm, classifications=Condition-Qualifier  # Electropneumatic
      Em: abbr-name=Em, classifications=Mean-Environment-Device  # EM | Electrical Machine
      Emf: abbr-name=Emf, classifications=Action-PhysicalType  # EMF | Electromotive "force" is not a force (measured in newtons) but a potential, or energy per unit of charge, measured in volts.
      Emgy: abbr-name=Emgy, classifications=Mean-Environment-Device  # Emergency
      Emi: abbr-name=Emi, classifications=Mean-Environment-Device  # Emission
      Empty: abbr-name=Empty, classifications=Condition-Qualifier
      Emul: abbr-name=Emul, classifications=Action-PhysicalType  # Emulate
      Emuld: abbr-name=Emuld, classifications=Condition-Qualifier  # Emulated
      Emuln: abbr-name=Emuln, classifications=Condition-Qualifier  # Emulation
      Ena: abbr-name=Ena, classifications=Condition-Qualifier  # Enable
      Enad: abbr-name=Enad, classifications=Condition-Qualifier  # Enabled
      Enag: abbr-name=Enag, classifications=Condition-Qualifier  # Enabling
      Enchmt: abbr-name=Enchmt, classifications=Condition-Qualifier  # Enrichment
      End: abbr-name=End, classifications=Condition-Qualifier
      Eng: abbr-name=Eng, classifications=Mean-Environment-Device  # Engine
      Engd: abbr-name=Engd, classifications=Condition-Qualifier  # Engaged
      Engh: abbr-name=Engh, classifications=Condition-Qualifier  # Enough
      England: abbr-name=England, classifications=Condition-Qualifier
      Engmt: abbr-name=Engmt, classifications=Mean-Environment-Device  # Engagement | engagement. to express the situation of engaging e.g. a gear from neutral position / transmission gutter until synchronisation performed.
      Enhd: abbr-name=Enhd, classifications=Condition-Qualifier  # Enhanced
      Enhmt: abbr-name=Enhmt, classifications=Condition-Qualifier  # Enhancement
      Enthpy: abbr-name=Enthpy, classifications=Action-PhysicalType  # Enthalpy
      Entr: abbr-name=Entr, classifications=Action-PhysicalType  # Enter
      Entrc: abbr-name=Entrc, classifications=Mean-Environment-Device  # Entrance
      Entry: abbr-name=Entry, classifications=Action-PhysicalType
      Env: abbr-name=Env, classifications=Mean-Environment-Device  # Environment
      Envtl: abbr-name=Envtl, classifications=Condition-Qualifier  # Environmental
      Eoi: abbr-name=Eoi, classifications=Condition-Qualifier  # EOI | End of Injection
      Eol: abbr-name=Eol, classifications=Condition-Qualifier  # EOL | End of Line
      Epb: abbr-name=Epb, classifications=Mean-Environment-Device  # EPB | Electric Parking Brake
      Equ: abbr-name=Equ, classifications=Condition-Qualifier  # Equal
      Equid: abbr-name=Equid, classifications=Condition-Qualifier  # Equipped
      Equip: abbr-name=Equip, classifications=Mean-Environment-Device  # Equipment
      Equiv: abbr-name=Equiv, classifications=Condition-Qualifier  # Equivalent
      Erase: abbr-name=Erase, classifications=Action-PhysicalType
      Err: abbr-name=Err, classifications=Condition-Qualifier  # Error | information of a defect
      Esc: abbr-name=Esc, classifications=Mean-Environment-Device  # ESC | Electronic Stability Control
      Estim: abbr-name=Estim, classifications=Action-PhysicalType  # Estimate
      Estimd: abbr-name=Estimd, classifications=Condition-Qualifier  # Estimated
      Estimn: abbr-name=Estimn, classifications=Condition-Qualifier  # Estimation
      Estimr: abbr-name=Estimr, classifications=Condition-Qualifier  # Estimator
      Eta: abbr-name=Eta, classifications=Action-PhysicalType  # Typically used for eta factor, efficiency, factor depending on viscosity
      Etc: abbr-name=Etc, classifications=Mean-Environment-Device  # ETC | Electronic Throttle Control
      Eth: abbr-name=Eth, classifications=Mean-Environment-Device  # Ethernet
      Ev: abbr-name=Ev, classifications=Mean-Environment-Device  # EV | Electric Vehicle
      Evap: abbr-name=Evap, classifications=Condition-Qualifier  # Evaporative
      Evapr: abbr-name=Evapr, classifications=Mean-Environment-Device  # Evaporator
      Eve: abbr-name=Eve, classifications=Condition-Qualifier  # Event
      Even: abbr-name=Even, classifications=Condition-Qualifier
      Ever: abbr-name=Ever, classifications=Condition-Qualifier
      Evl: abbr-name=Evl, classifications=Action-PhysicalType  # Evaluate
      Evln: abbr-name=Evln, classifications=Action-PhysicalType  # Evaluation
      Evlr: abbr-name=Evlr, classifications=Mean-Environment-Device  # Evaluator
      Exact: abbr-name=Exact, classifications=Condition-Qualifier
      Excd: abbr-name=Excd, classifications=Action-PhysicalType  # Exceed
      Excdd: abbr-name=Excdd, classifications=Condition-Qualifier  # Exceeded
      Excl: abbr-name=Excl, classifications=Action-PhysicalType  # Exclude
      Exclsn: abbr-name=Exclsn, classifications=Action-PhysicalType  # Exclusion
      Excpn: abbr-name=Excpn, classifications=Condition-Qualifier  # Exception
      Excr: abbr-name=Excr, classifications=Condition-Qualifier  # Excenter
      Exct: abbr-name=Exct, classifications=Action-PhysicalType  # Excitation | the keyword is used to express the technical effect of excitation, e.g. in connection with a current or a voltage in a generator
      Exh: abbr-name=Exh, classifications=Condition-Qualifier  # Exhaust | The escape of used gas or vapor from an engine, or the escaped gas.
      Exist: abbr-name=Exist, classifications=Action-PhysicalType
      Exotherm: abbr-name=Exotherm, classifications=Condition-Qualifier  # Exothermal
      Exp: abbr-name=Exp, classifications=Condition-Qualifier  # Expansion | This keyword can be used for the expansion phase of the engine cycle.
      Exprt: abbr-name=Exprt, classifications=Action-PhysicalType  # Export
      Expt: abbr-name=Expt, classifications=Condition-Qualifier  # Experiment | experiment. In contrast to the keyword Test, it is not used to check an existing functionality, but to try something new.
      Ext: abbr-name=Ext, classifications=Condition-Qualifier  # External
      Extd: abbr-name=Extd, classifications=Condition-Qualifier  # Extended
      Extn: abbr-name=Extn, classifications=Action-PhysicalType  # Extend
      Extr: abbr-name=Extr, classifications=Mean-Environment-Device  # Exterior
      Extrpn: abbr-name=Extrpn, classifications=Action-PhysicalType  # Extrapolation
      F: abbr-name=F, classifications=Action-PhysicalType  # Force | describes the physical parameter 'force'
      Fac: abbr-name=Fac, classifications=Action-PhysicalType  # Factor | factor, coefficient
      Facd: abbr-name=Facd, classifications=Condition-Qualifier  # Faced
      Factry: abbr-name=Factry, classifications=Condition-Qualifier  # Factory
      Fade: abbr-name=Fade, classifications=Action-PhysicalType
      Fail: abbr-name=Fail, classifications=Condition-Qualifier
      Faild: abbr-name=Faild, classifications=Condition-Qualifier  # Failed
      Failr: abbr-name=Failr, classifications=Condition-Qualifier  # Failure
      Fall: abbr-name=Fall, classifications=Condition-Qualifier  # Falling
      Fan: abbr-name=Fan, classifications=Mean-Environment-Device
      Fast: abbr-name=Fast, classifications=Condition-Qualifier
      Fav: abbr-name=Fav, classifications=Condition-Qualifier  # Favourable
      Fb: abbr-name=Fb, classifications=Action-PhysicalType  # Feedback
      Fct: abbr-name=Fct, classifications=Condition-Qualifier  # Function | Purpose
      Fid: abbr-name=Fid, classifications=Condition-Qualifier  # FID | Functional Identifier
      Fie: abbr-name=Fie, classifications=Condition-Qualifier  # Field
      Fil: abbr-name=Fil, classifications=Condition-Qualifier  # Filter
      Fild: abbr-name=Fild, classifications=Condition-Qualifier  # Filtered
      File: abbr-name=File, classifications=Mean-Environment-Device
      Fillg: abbr-name=Fillg, classifications=Action-PhysicalType  # Filling
      Film: abbr-name=Film, classifications=Mean-Environment-Device
      Fim: abbr-name=Fim, classifications=Mean-Environment-Device  # FIM | Function Inhibition Manager
      Final: abbr-name=Final, classifications=Condition-Qualifier
      Findr: abbr-name=Findr, classifications=Mean-Environment-Device  # Finder
      Fine: abbr-name=Fine, classifications=Condition-Qualifier
      Finshd: abbr-name=Finshd, classifications=Condition-Qualifier  # Finished
      First: abbr-name=First, classifications=Condition-Qualifier
      Fixa: abbr-name=Fixa, classifications=Action-PhysicalType  # Fixation
      Fixd: abbr-name=Fixd, classifications=Condition-Qualifier  # Fixed
      Flank: abbr-name=Flank, classifications=Mean-Environment-Device
      Flap: abbr-name=Flap, classifications=Mean-Environment-Device
      Flash: abbr-name=Flash, classifications=Action-PhysicalType  # Flash used as verb in the sense of blinking e.g. of an indicator
      Fld: abbr-name=Fld, classifications=Mean-Environment-Device  # Fluid
      Flexfu: abbr-name=Flexfu, classifications=Condition-Qualifier  # Flex-Fuel | flexible fuel vehicle, flex-fuel engines etc., sometimes also Flex Fuel or FlexFuel
      Flg: abbr-name=Flg, classifications=Condition-Qualifier  # Flag | Flag is a binary value.
      Flood: abbr-name=Flood, classifications=Condition-Qualifier
      Flow: abbr-name=Flow, classifications=Condition-Qualifier
      Flpr: abbr-name=Flpr, classifications=Mean-Environment-Device  # Flipper
      Fls: abbr-name=Fls, classifications=Mean-Environment-Device  # Flash | Flash as device used for flash programming
      Flsg: abbr-name=Flsg, classifications=Condition-Qualifier  # Flashing
      Flt: abbr-name=Flt, classifications=Mean-Environment-Device  # Fault
      Fluc: abbr-name=Fluc, classifications=Condition-Qualifier  # Fluctuation
      Flx: abbr-name=Flx, classifications=Action-PhysicalType  # Flux | Flux like e.g. in physical quantity "magnetic flux"
      Fly: abbr-name=Fly, classifications=Condition-Qualifier
      Flywh: abbr-name=Flywh, classifications=Mean-Environment-Device  # Flywheel
      Fm: abbr-name=Fm, classifications=Mean-Environment-Device  # FM | Frequency Modulation
      Fmale: abbr-name=Fmale, classifications=Condition-Qualifier  # Female
      Fmt: abbr-name=Fmt, classifications=Condition-Qualifier  # Format
      Fob: abbr-name=Fob, classifications=Mean-Environment-Device  # Transponder device in the Key
      Fog: abbr-name=Fog, classifications=Mean-Environment-Device
      Fol: abbr-name=Fol, classifications=Condition-Qualifier  # Follower
      Fold: abbr-name=Fold, classifications=Action-PhysicalType
      Folw: abbr-name=Folw, classifications=Action-PhysicalType  # Follow
      Footwell: abbr-name=Footwell, classifications=Mean-Environment-Device  # Space for vehicle occupants legs
      For: abbr-name=For, classifications=Preposition  # Preposition
      Foulg: abbr-name=Foulg, classifications=Condition-Qualifier  # Fouling | e.g. used in detection of the fouling of the exhaust gas recirculation (EGR) line
      Fr: abbr-name=Fr, classifications=Mean-Environment-Device  # Flexray
      Frd: abbr-name=Frd, classifications=Mean-Environment-Device  # Farad | Unit of measure for Electric capacitance
      Free: abbr-name=Free, classifications=Condition-Qualifier
      Fric: abbr-name=Fric, classifications=Condition-Qualifier  # Friction | Resistance against a movement
      Frm: abbr-name=Frm, classifications=Condition-Qualifier  # Frame
      Frnt: abbr-name=Frnt, classifications=Condition-Qualifier  # Front
      From: abbr-name=From, classifications=Preposition  # Preposition
      Frq: abbr-name=Frq, classifications=Action-PhysicalType  # Frequency
      Frsh: abbr-name=Frsh, classifications=Condition-Qualifier  # Fresh
      Frz: abbr-name=Frz, classifications=Action-PhysicalType  # Freeze
      Frzn: abbr-name=Frzn, classifications=Condition-Qualifier  # Frozen
      Fu: abbr-name=Fu, classifications=Mean-Environment-Device  # Fuel
      Full: abbr-name=Full, classifications=Condition-Qualifier
      Fuse: abbr-name=Fuse, classifications=Mean-Environment-Device
      Fusn: abbr-name=Fusn, classifications=Condition-Qualifier  # Fusion
      Fw: abbr-name=Fw, classifications=Condition-Qualifier  # Freewheeling
      Fwd: abbr-name=Fwd, classifications=Condition-Qualifier  # Forward
      Gain: abbr-name=Gain, classifications=Condition-Qualifier
      Gap: abbr-name=Gap, classifications=Action-PhysicalType
      Gas: abbr-name=Gas, classifications=Mean-Environment-Device
      Gate: abbr-name=Gate, classifications=Mean-Environment-Device
      Gatewy: abbr-name=Gatewy, classifications=Mean-Environment-Device  # Gateway
      Gbx: abbr-name=Gbx, classifications=Mean-Environment-Device  # Gearbox
      Gdi: abbr-name=Gdi, classifications=Mean-Environment-Device  # GDI | Gasoline Direct Injection
      Gear: abbr-name=Gear, classifications=Mean-Environment-Device
      Gen: abbr-name=Gen, classifications=Condition-Qualifier  # Generic
      Gen1: abbr-name=Gen, classifications=Action-PhysicalType  # Generate
      Gend: abbr-name=Gend, classifications=Condition-Qualifier  # Generated
      Generic: abbr-name=Generic, classifications=Condition-Qualifier
      Genn: abbr-name=Genn, classifications=Condition-Qualifier  # Generation
      Genr: abbr-name=Genr, classifications=Mean-Environment-Device  # Generator
      Germany: abbr-name=Germany, classifications=Condition-Qualifier
      Get: abbr-name=Get, classifications=Action-PhysicalType
      Giga: abbr-name=Giga, classifications=Mean-Environment-Device
      Glass: abbr-name=Glass, classifications=Mean-Environment-Device
      Glb: abbr-name=Glb, classifications=Condition-Qualifier  # Global
      Glv: abbr-name=Glv, classifications=Mean-Environment-Device  # Glove
      Glw: abbr-name=Glw, classifications=Mean-Environment-Device  # Glow
      Gnd: abbr-name=Gnd, classifications=Mean-Environment-Device  # Ground
      Govr: abbr-name=Govr, classifications=Mean-Environment-Device  # Governor
      Gpt: abbr-name=Gpt, classifications=Mean-Environment-Device  # GPT | General Purpose Timer
      Gr: abbr-name=Gr, classifications=Mean-Environment-Device  # Gram | Unit of measure for mass
      Grd: abbr-name=Grd, classifications=Mean-Environment-Device  # Grade
      Grdt: abbr-name=Grdt, classifications=Action-PhysicalType  # Gradient | gradient/slope
      Grid: abbr-name=Grid, classifications=Mean-Environment-Device
      Grip: abbr-name=Grip, classifications=Action-PhysicalType  # example: Maximum desired engine torque for grip adaptation
      Group: abbr-name=Group, classifications=Condition-Qualifier
      Grvy: abbr-name=Grvy, classifications=Mean-Environment-Device  # Gravity | This keyword describes the force of attraction between to masses, well known as gravity.
      Gsl: abbr-name=Gsl, classifications=Mean-Environment-Device  # Gasoline | This keyword is used to express the fuel type "gasoline".
      Gsm: abbr-name=Gsm, classifications=Mean-Environment-Device  # GSM | Global System for Mobile Communications
      Gulf: abbr-name=Gulf, classifications=Condition-Qualifier
      HC: abbr-name=HC, classifications=Preposition  # Hydrocarbon
      HEV: abbr-name=HEV, classifications=Mean-Environment-Device  # Hev | Hybrid Electric Vehicle
      Half: abbr-name=Half, classifications=Condition-Qualifier  # half, semi-. This keyword is used to characterize something for being only one part of two that make a whole item. Example: the time for a half engine segment.
      Hall: abbr-name=Hall, classifications=Mean-Environment-Device  # as used in Hall Sensor
      Halt: abbr-name=Halt, classifications=Condition-Qualifier
      Hard: abbr-name=Hard, classifications=Condition-Qualifier
      Hbrnt: abbr-name=Hbrnt, classifications=Action-PhysicalType  # Hibernate
      Hc: abbr-name=Hc, classifications=Mean-Environment-Device  # Hydrocarbon
      Hd: abbr-name=Hd, classifications=Mean-Environment-Device  # Head
      Hdlamp: abbr-name=Hdlamp, classifications=Mean-Environment-Device  # Headlamp
      Hdphn: abbr-name=Hdphn, classifications=Mean-Environment-Device  # Headphone
      Hdr: abbr-name=Hdr, classifications=Condition-Qualifier  # Header
      Hdrest: abbr-name=Hdrest, classifications=Mean-Environment-Device  # Headrest | Headrest of seats
      Heal: abbr-name=Heal, classifications=Action-PhysicalType  # This keyword is needed for functions that try to heal a failure. E.g. an actuator or a control valve is blocked due to a dirt particle. A free-shaking control signal can lead to releasing the particle from the actuator.
      Heat: abbr-name=Heat, classifications=Mean-Environment-Device
      Heatd: abbr-name=Heatd, classifications=Condition-Qualifier  # Heated
      Heatg: abbr-name=Heatg, classifications=Action-PhysicalType  # Heating
      Heatr: abbr-name=Heatr, classifications=Mean-Environment-Device  # Heater
      Hecto: abbr-name=Hecto, classifications=Mean-Environment-Device  # Unit of measure for pressure
      Hei: abbr-name=Hei, classifications=Action-PhysicalType  # Height
      Hev: abbr-name=Hev, classifications=Mean-Environment-Device  # HEV | Hybrid Electric Vehicle
      Hi: abbr-name=Hi, classifications=Condition-Qualifier  # High
      Hill: abbr-name=Hill, classifications=Mean-Environment-Device
      Hist: abbr-name=Hist, classifications=Condition-Qualifier  # History | for data stored in history memory
      Hitch: abbr-name=Hitch, classifications=Action-PhysicalType
      Hld: abbr-name=Hld, classifications=Action-PhysicalType  # Hold
      Hmi: abbr-name=Hmi, classifications=Mean-Environment-Device  # HMI | Human-Machine Interface
      Hndbrk: abbr-name=Hndbrk, classifications=Mean-Environment-Device  # Handbrake
      Hndl: abbr-name=Hndl, classifications=Mean-Environment-Device  # Handle | The physical device for opening a door
      Hndlg: abbr-name=Hndlg, classifications=Mean-Environment-Device  # Handling
      Hom: abbr-name=Hom, classifications=Condition-Qualifier  # Homogeneous | e. g. used in homogeneous injection
      Home: abbr-name=Home, classifications=Mean-Environment-Device
      Hood: abbr-name=Hood, classifications=Mean-Environment-Device  # e. g. engine hood
      Hoop: abbr-name=Hoop, classifications=Mean-Environment-Device
      Horn: abbr-name=Horn, classifications=Mean-Environment-Device
      Hot: abbr-name=Hot, classifications=Condition-Qualifier
      Hozl: abbr-name=Hozl, classifications=Condition-Qualifier  # Horizontal
      Hp: abbr-name=Hp, classifications=Condition-Qualifier  # Highpass
      Hr: abbr-name=Hr, classifications=Mean-Environment-Device  # Hour | Unit of measure for time
      Htl: abbr-name=Htl, classifications=Mean-Environment-Device  # Hotel
      Hud: abbr-name=Hud, classifications=Mean-Environment-Device  # HUD | Head Up Display. This keyword is used to express the feature of show information right in the field of view of the driver, e.g. by mirroring it onto the wind screen.
      Hum: abbr-name=Hum, classifications=Condition-Qualifier  # Humidity | the keyword is used to assign the amount of water in a gas or a gaseous mixture. Example: the humidity in the exhaust gas.
      Hvac: abbr-name=Hvac, classifications=Mean-Environment-Device  # HVAC | Heating Ventilation and Air Conditioning
      Hvy: abbr-name=Hvy, classifications=Condition-Qualifier  # Heavy
      Hw: abbr-name=Hw, classifications=Mean-Environment-Device  # Hardware | This keyword is used to express a relationship to Hardware within a functionality or an environmental tools, e.g. Labcar.
      Hyb: abbr-name=Hyb, classifications=Condition-Qualifier  # Hybrid | Any vehicle that combines two or more sources of power that can directly or indirectly provide propulsion power is a hybrid
      Hyd: abbr-name=Hyd, classifications=Condition-Qualifier  # Hydraulic | used to characterize hydraulic components
      Hyddyn: abbr-name=Hyddyn, classifications=Condition-Qualifier  # Hydrodynamic
      Hys: abbr-name=Hys, classifications=Condition-Qualifier  # Hysteresis
      Hz: abbr-name=Hz, classifications=Mean-Environment-Device  # Hertz | Unit of measure for frequency
      Hzrd: abbr-name=Hzrd, classifications=Mean-Environment-Device  # Hazard
      I: abbr-name=I, classifications=Action-PhysicalType  # Electric current
      Ice: abbr-name=Ice, classifications=Mean-Environment-Device  # This keyword expresses an interrelation with ice or with an icy environment, e.g. a functionality to improve the drivability on frosted streets.
      Ico: abbr-name=Ico, classifications=Mean-Environment-Device  # Intercooler
      Icu: abbr-name=Icu, classifications=Mean-Environment-Device  # ICU | Input Capture Unit
      Id: abbr-name=Id, classifications=Mean-Environment-Device  # Identifier
      Ideal: abbr-name=Ideal, classifications=Condition-Qualifier  # e.g. ideal computed vehicle speed for curve
      Identcl: abbr-name=Identcl, classifications=Condition-Qualifier  # Identical
      Idle: abbr-name=Idle, classifications=Condition-Qualifier
      Idn: abbr-name=Idn, classifications=Condition-Qualifier  # Identification
      Idx: abbr-name=Idx, classifications=Condition-Qualifier  # Index
      Idx0: abbr-name=0, classifications=Index  # 0 | Index 0. This keyword is used to express the number zero in form of an index
      Idx0th: abbr-name=0th, classifications=Index  # 0th | This keyword is used to express the order in form of an index.
      Idx1: abbr-name=1, classifications=Index  # 1 | Index 1. This keyword is used to express the number one in form of an index
      Idx1d: abbr-name=1d, classifications=Index  # 1d | index 1D. used for location of oxygen sensors (4 banks and 2 sensors) - Parameter Identification 1D according with ISO15031-5. 2 banks and 4 sensors are identified by the index 13
      Idx1st: abbr-name=1st, classifications=Index  # 1st | This keyword is used to express the order in form of an index.
      Idx2: abbr-name=2, classifications=Index  # 2 | Index 2. This keyword is used to express the number two in form of an index
      Idx2nd: abbr-name=2nd, classifications=Index  # 2nd | Second. This keyword is used to express the order in form of an index.
      Idx3: abbr-name=3, classifications=Index  # 3 | Index 3. This keyword is used to express the number three in form of an index
      Idx3rd: abbr-name=3rd, classifications=Index  # 3rd | This keyword is used to express the order in form of an index.
      Idx4: abbr-name=4, classifications=Index  # 4 | Index 4. This keyword is used to express the number four in form of an index
      Idx4th: abbr-name=4th, classifications=Index  # 4th | This keyword is used to express the order in form of an index.
      Idx5: abbr-name=5, classifications=Index  # 5 | Index 5. This keyword is used to express the number five in form of an index
      Idx5th: abbr-name=5th, classifications=Index  # 5th | This keyword is used to express the order in form of an index.
      Idx6: abbr-name=6, classifications=Index  # 6 | Index 6. This keyword is used to express the number six in form of an index
      Idx6th: abbr-name=6th, classifications=Index  # 6th | This keyword is used to express the order in form of an index.
      Idx7: abbr-name=7, classifications=Index  # 7 | Index 7. This keyword is used to express the number seven in form of an index
      Idx7th: abbr-name=7th, classifications=Index  # 7th | This keyword is used to express the order in form of an index.
      Idx8: abbr-name=8, classifications=Index  # 8 | Index 8. This keyword is used to express the number eight in form of an index
      Idx8th: abbr-name=8th, classifications=Index  # 8th | This keyword is used to express the order in form of an index.
      Idx9: abbr-name=9, classifications=Index  # 9 | Index 9. This keyword is used to express the number nine in form of an index
      Idx9th: abbr-name=9th, classifications=Index  # 9th | This keyword is used to express the order in form of an index.
      If: abbr-name=If, classifications=Condition-Qualifier  # Interface
      Ign: abbr-name=Ign, classifications=Mean-Environment-Device  # Ignition
      Illmn: abbr-name=Illmn, classifications=Action-PhysicalType  # Illumination
      Imdt: abbr-name=Imdt, classifications=Condition-Qualifier  # Immediate | this keyword is used to assign a requirement of minimum delay time or the need to take action as soon as possible.
      Img: abbr-name=Img, classifications=Mean-Environment-Device  # Image
      Imob: abbr-name=Imob, classifications=Mean-Environment-Device  # Immobilizer
      Imobn: abbr-name=Imobn, classifications=Action-PhysicalType  # Immobilisation
      Imp: abbr-name=Imp, classifications=Mean-Environment-Device  # Impulse
      Impct: abbr-name=Impct, classifications=Action-PhysicalType  # Impact
      Impo: abbr-name=Impo, classifications=Condition-Qualifier  # Impossible
      Imprt: abbr-name=Imprt, classifications=Action-PhysicalType  # Import
      Imps: abbr-name=Imps, classifications=Condition-Qualifier  # Implausible
      Impy: abbr-name=Impy, classifications=Condition-Qualifier  # Implausibility
      In: abbr-name=In, classifications=Preposition  # Preposition for location or condition
      Inacrt: abbr-name=Inacrt, classifications=Condition-Qualifier  # Inaccurate
      Inc: abbr-name=Inc, classifications=Action-PhysicalType  # Increase | This keyword is used to express a stepwise accretion of a value or counter
      Incl: abbr-name=Incl, classifications=Action-PhysicalType  # Incline
      Inclg: abbr-name=Inclg, classifications=Action-PhysicalType  # Including
      Incln: abbr-name=Incln, classifications=Action-PhysicalType  # Inclination
      Inct: abbr-name=Inct, classifications=Condition-Qualifier  # Increment | This keyword is used to express a stepwise accretion of a value or counter
      Ind: abbr-name=Ind, classifications=Condition-Qualifier  # Individual
      Indcd: abbr-name=Indcd, classifications=Condition-Qualifier  # Indicated
      Indcn: abbr-name=Indcn, classifications=Condition-Qualifier  # Indication
      Indcr: abbr-name=Indcr, classifications=Mean-Environment-Device  # Indicator
      India: abbr-name=India, classifications=Condition-Qualifier
      Indonesia: abbr-name=Indonesia, classifications=Condition-Qualifier
      Indu: abbr-name=Indu, classifications=Condition-Qualifier  # Inductive
      Inert: abbr-name=Inert, classifications=Condition-Qualifier
      Info: abbr-name=Info, classifications=Condition-Qualifier  # Information
      Infra: abbr-name=Infra, classifications=Condition-Qualifier  # e.g. in infra-red, infra-structure, infra-sound, infrasonic sound
      Inhb: abbr-name=Inhb, classifications=Action-PhysicalType  # Inhibit
      Inhbn: abbr-name=Inhbn, classifications=Action-PhysicalType  # Inhibition
      Ini: abbr-name=Ini, classifications=Condition-Qualifier  # Initial
      Inin: abbr-name=Inin, classifications=Condition-Qualifier  # Initialization
      Inj: abbr-name=Inj, classifications=Action-PhysicalType  # Injection
      Injr: abbr-name=Injr, classifications=Mean-Environment-Device  # Injector
      Innr: abbr-name=Innr, classifications=Condition-Qualifier  # Inner
      Inp: abbr-name=Inp, classifications=Condition-Qualifier  # Input
      Insd: abbr-name=Insd, classifications=Mean-Environment-Device  # Inside
      Insert: abbr-name=Insert, classifications=Action-PhysicalType
      Inst: abbr-name=Inst, classifications=Condition-Qualifier  # Instance | This keyword is used for the characterisation e.g. of a diagnosis, instance of the intake air temperature diagnosis
      Int: abbr-name=Int, classifications=Condition-Qualifier  # Internal
      Intd: abbr-name=Intd, classifications=Condition-Qualifier  # Intended
      Inten: abbr-name=Inten, classifications=Action-PhysicalType  # Intensity
      Inter: abbr-name=Inter, classifications=Condition-Qualifier  # Intermediate
      Interdom: abbr-name=Interdom, classifications=Mean-Environment-Device  # Interdomain
      Intery: abbr-name=Intery, classifications=Condition-Qualifier  # Intermediary
      Intgl: abbr-name=Intgl, classifications=Condition-Qualifier  # Integral
      Intgr: abbr-name=Intgr, classifications=Condition-Qualifier  # Integer
      Intk: abbr-name=Intk, classifications=Mean-Environment-Device  # Intake | Keyword Intake will also be used in the sense of Inlet
      Intl: abbr-name=Intl, classifications=Condition-Qualifier  # Interval
      Intm: abbr-name=Intm, classifications=Condition-Qualifier  # Intermittent
      Intr: abbr-name=Intr, classifications=Mean-Environment-Device  # Interior
      Intrpn: abbr-name=Intrpn, classifications=Action-PhysicalType  # Interpolation
      Intrpt: abbr-name=Intrpt, classifications=Action-PhysicalType  # Interrupt
      Intv: abbr-name=Intv, classifications=Action-PhysicalType  # Intervention
      Intvg: abbr-name=Intvg, classifications=Condition-Qualifier  # Intervening
      Intxcn: abbr-name=Intxcn, classifications=Condition-Qualifier  # Intoxication | User under influence of drugs (e.g. alcohol)
      Invld: abbr-name=Invld, classifications=Condition-Qualifier  # Invalid
      Io: abbr-name=Io, classifications=Mean-Environment-Device  # IO | Input/Output
      Ion: abbr-name=Ion, classifications=Mean-Environment-Device  # as used in Lithium Ion Battery
      Irrv: abbr-name=Irrv, classifications=Condition-Qualifier  # Irreversible | this keyword is used to express that something can not return to a previous status, e.g. in Cruise Control deactivation it means in this case that cruise can not be activated again in the same driving cycle once a deactivation occurred
      Italy: abbr-name=Italy, classifications=Condition-Qualifier
      Itp: abbr-name=Itp, classifications=Condition-Qualifier  # Interpreter | For the network layer of KWP2000
      Ivs: abbr-name=Ivs, classifications=Condition-Qualifier  # Inverse
      Ivt: abbr-name=Ivt, classifications=Action-PhysicalType  # Invert
      Ivtr: abbr-name=Ivtr, classifications=Mean-Environment-Device  # Inverter | e.g. inverter in electric cars
      J: abbr-name=J, classifications=Action-PhysicalType  # Inertia | this keyword is used to express the physical effect that the mass of a body is interacting against its acceleration
      Jam: abbr-name=Jam, classifications=Action-PhysicalType
      Japan: abbr-name=Japan, classifications=Condition-Qualifier
      Jerk: abbr-name=Jerk, classifications=Mean-Environment-Device
      Jmp: abbr-name=Jmp, classifications=Action-PhysicalType  # Jump
      Jou: abbr-name=Jou, classifications=Mean-Environment-Device  # Joule | Unit of measure for energy, work
      Kd: abbr-name=Kd, classifications=Mean-Environment-Device  # Kickdown
      Keep: abbr-name=Keep, classifications=Action-PhysicalType  # e.g. for active Safety Systems like Lane Keep Aid
      Kelvin: abbr-name=Kelvin, classifications=Mean-Environment-Device  # Unit of measure for temperature
      Key: abbr-name=Key, classifications=Mean-Environment-Device
      Keyls: abbr-name=Keyls, classifications=Condition-Qualifier  # Keyless
      Keyword: abbr-name=Keyword, classifications=Mean-Environment-Device
      Ki: abbr-name=Ki, classifications=Action-PhysicalType  # integral gain, Integral amplification, used in software control loops e.g. damper control or lambda control
      Kilo: abbr-name=Kilo, classifications=Mean-Environment-Device
      Knee: abbr-name=Knee, classifications=Mean-Environment-Device  # knee of human body
      Knk: abbr-name=Knk, classifications=Mean-Environment-Device  # Knock
      Knob: abbr-name=Knob, classifications=Mean-Environment-Device
      Korea: abbr-name=Korea, classifications=Condition-Qualifier
      Kp: abbr-name=Kp, classifications=Action-PhysicalType  # proportional gain, proportional amplification, used in software control loops e.g. damper control or lambda control
      L: abbr-name=L, classifications=Mean-Environment-Device  # Liter | unit of measure for volume
      Lam: abbr-name=Lam, classifications=Action-PhysicalType  # Lambda | Air/Fuel Ratio
      Lamp: abbr-name=Lamp, classifications=Mean-Environment-Device  # this keyword is used do describe the component of a lamp, e.g. in the display of the instrument panel
      Lane: abbr-name=Lane, classifications=Mean-Environment-Device
      Language: abbr-name=Language, classifications=Mean-Environment-Device
      Lat: abbr-name=Lat, classifications=Condition-Qualifier  # Lateral
      Lati: abbr-name=Lati, classifications=Condition-Qualifier  # Latitude | e.g. position from navigation system
      Ldn: abbr-name=Ldn, classifications=Action-PhysicalType  # Loudness
      Le: abbr-name=Le, classifications=Condition-Qualifier  # Left
      Lead: abbr-name=Lead, classifications=Mean-Environment-Device  # e.g. lead cylinder
      Leak: abbr-name=Leak, classifications=Condition-Qualifier  # The power stage for the piezo injectors has a special hardware (leakage compensation) to avoid discharging of capacities.
      Lean: abbr-name=Lean, classifications=Condition-Qualifier
      Led: abbr-name=Led, classifications=Mean-Environment-Device  # LED | Light Emitting Diode
      Len: abbr-name=Len, classifications=Action-PhysicalType  # Length
      Lft: abbr-name=Lft, classifications=Condition-Qualifier  # Lift | Movement from a lower to a higher position, or the distance of the movement.
      Lgt: abbr-name=Lgt, classifications=Condition-Qualifier  # Longitudinal | longitudinal
      Li: abbr-name=Li, classifications=Mean-Environment-Device  # Light
      Lib: abbr-name=Lib, classifications=Condition-Qualifier  # Library
      Lid: abbr-name=Lid, classifications=Mean-Environment-Device
      Lighter: abbr-name=Lighter, classifications=Mean-Environment-Device
      Lim: abbr-name=Lim, classifications=Condition-Qualifier  # Limit
      Limd: abbr-name=Limd, classifications=Condition-Qualifier  # Limited
      Limn: abbr-name=Limn, classifications=Action-PhysicalType  # Limitation
      Limp: abbr-name=Limp, classifications=Action-PhysicalType  # example: Timeout camshaft sensor limp home
      Limr: abbr-name=Limr, classifications=Mean-Environment-Device  # Limiter
      Lin: abbr-name=Lin, classifications=Mean-Environment-Device  # LIN | Local Interconnect Network
      Line: abbr-name=Line, classifications=Mean-Environment-Device
      List: abbr-name=List, classifications=Mean-Environment-Device
      Lnch: abbr-name=Lnch, classifications=Action-PhysicalType  # Launch
      Lnr: abbr-name=Lnr, classifications=Condition-Qualifier  # Linear | used for description of linear qualities
      Lo: abbr-name=Lo, classifications=Condition-Qualifier  # Low
      Load: abbr-name=Load, classifications=Action-PhysicalType  # Unit must be percent
      Lobe: abbr-name=Lobe, classifications=Mean-Environment-Device  # as used in the case of single lobe cam
      Lock: abbr-name=Lock, classifications=Action-PhysicalType
      Lockd: abbr-name=Lockd, classifications=Condition-Qualifier  # Locked
      Lockg: abbr-name=Lockg, classifications=Action-PhysicalType  # Locking
      Locn: abbr-name=Locn, classifications=Action-PhysicalType  # Location | Position
      Logl: abbr-name=Logl, classifications=Condition-Qualifier  # Logical
      Long: abbr-name=Long, classifications=Condition-Qualifier
      Longi: abbr-name=Longi, classifications=Condition-Qualifier  # Longitude | e.g. position from navigation system
      Loop: abbr-name=Loop, classifications=Mean-Environment-Device
      Loss: abbr-name=Loss, classifications=Condition-Qualifier
      Lost: abbr-name=Lost, classifications=Condition-Qualifier
      Lowr: abbr-name=Lowr, classifications=Condition-Qualifier  # Lower
      Lp: abbr-name=Lp, classifications=Condition-Qualifier  # Lowpass
      Lpg: abbr-name=Lpg, classifications=Mean-Environment-Device  # LPG | Liquified Petroleum Gas
      Lrg: abbr-name=Lrg, classifications=Condition-Qualifier  # Large
      Lrn: abbr-name=Lrn, classifications=Action-PhysicalType  # Learn
      Lrng: abbr-name=Lrng, classifications=Condition-Qualifier  # Learning
      Lst: abbr-name=Lst, classifications=Condition-Qualifier  # Last
      Ltch: abbr-name=Ltch, classifications=Mean-Environment-Device  # Latch
      Ltcy: abbr-name=Ltcy, classifications=Condition-Qualifier  # Latency
      Ltg: abbr-name=Ltg, classifications=Condition-Qualifier  # Lighting
      Lum: abbr-name=Lum, classifications=Mean-Environment-Device  # Lumbar
      Lumi: abbr-name=Lumi, classifications=Action-PhysicalType  # Luminous Intensity, used for measuring luminous Intensity
      Lvl: abbr-name=Lvl, classifications=Action-PhysicalType  # Level
      Lvlg: abbr-name=Lvlg, classifications=Action-PhysicalType  # Leveling
      Lvng: abbr-name=Lvng, classifications=Action-PhysicalType  # Leaving
      Lvr: abbr-name=Lvr, classifications=Mean-Environment-Device  # Lever
      M: abbr-name=M, classifications=Action-PhysicalType  # Mass
      Mac: abbr-name=Mac, classifications=Mean-Environment-Device  # Machine
      Mag: abbr-name=Mag, classifications=Condition-Qualifier  # Magnetic
      Mai: abbr-name=Mai, classifications=Condition-Qualifier  # Main
      Malaysia: abbr-name=Malaysia, classifications=Condition-Qualifier
      Male: abbr-name=Male, classifications=Condition-Qualifier
      Man: abbr-name=Man, classifications=Condition-Qualifier  # Manual
      Map: abbr-name=Map, classifications=Mean-Environment-Device
      Mask: abbr-name=Mask, classifications=Condition-Qualifier  # this keyword is used to characterize a masking of a certain value to separate it from the non-masked one.
      Massg: abbr-name=Massg, classifications=Action-PhysicalType  # Massage
      Mat: abbr-name=Mat, classifications=Condition-Qualifier  # Mathematical
      Max: abbr-name=Max, classifications=Condition-Qualifier  # Maximum
      Mcu: abbr-name=Mcu, classifications=Mean-Environment-Device  # MCU | Microcontroller Unit
      Mdl: abbr-name=Mdl, classifications=Mean-Environment-Device  # Model
      Meas: abbr-name=Meas, classifications=Condition-Qualifier  # Measure
      Measd: abbr-name=Measd, classifications=Condition-Qualifier  # Measured
      Mec: abbr-name=Mec, classifications=Condition-Qualifier  # Mechanic
      Mecl: abbr-name=Mecl, classifications=Condition-Qualifier  # Mechanical
      Med: abbr-name=Med, classifications=Condition-Qualifier  # Medium
      Mega: abbr-name=Mega, classifications=Mean-Environment-Device
      Mem: abbr-name=Mem, classifications=Mean-Environment-Device  # Memory
      Memd: abbr-name=Memd, classifications=Condition-Qualifier  # Memorized
      Memr: abbr-name=Memr, classifications=Action-PhysicalType  # Memorise
      Method: abbr-name=Method, classifications=Condition-Qualifier
      Mexico: abbr-name=Mexico, classifications=Condition-Qualifier
      Mgn: abbr-name=Mgn, classifications=Condition-Qualifier  # Magnitude
      Mgr: abbr-name=Mgr, classifications=Condition-Qualifier  # Manager
      Micro: abbr-name=Micro, classifications=Mean-Environment-Device
      Micro1: abbr-name=Micro, classifications=Condition-Qualifier
      Mid: abbr-name=Mid, classifications=Condition-Qualifier  # Middle
      Mil: abbr-name=Mil, classifications=Mean-Environment-Device  # MIL | Malfunction Indication Lamp
      Milg: abbr-name=Milg, classifications=Action-PhysicalType  # Mileage
      Milli: abbr-name=Milli, classifications=Mean-Environment-Device
      Min: abbr-name=Min, classifications=Condition-Qualifier  # Minimum
      Mins: abbr-name=Mins, classifications=Mean-Environment-Device  # Minute | Unit of measure for time
      Mirr: abbr-name=Mirr, classifications=Mean-Environment-Device  # Mirror
      Misc: abbr-name=Misc, classifications=Condition-Qualifier  # Miscellaneous
      Misf: abbr-name=Misf, classifications=Action-PhysicalType  # Misfire
      Misfg: abbr-name=Misfg, classifications=Condition-Qualifier  # Misfiring
      Miss: abbr-name=Miss, classifications=Condition-Qualifier  # Missing
      Mkr: abbr-name=Mkr, classifications=Condition-Qualifier  # Marker
      Mkt: abbr-name=Mkt, classifications=Mean-Environment-Device  # Market | This keyword is used to express market in the meaning of delivery areas, e.g. to characterize deviances in a component or function due to different customer market requirements.
      Mmed: abbr-name=Mmed, classifications=Mean-Environment-Device  # Multimedia
      Mnfld: abbr-name=Mnfld, classifications=Mean-Environment-Device  # Manifold
      Mng: abbr-name=Mng, classifications=Action-PhysicalType  # Manage
      Mngt: abbr-name=Mngt, classifications=Condition-Qualifier  # Management
      Mntd: abbr-name=Mntd, classifications=Condition-Qualifier  # Mounted
      Mntg: abbr-name=Mntg, classifications=Action-PhysicalType  # Mounting
      Mntn: abbr-name=Mntn, classifications=Condition-Qualifier  # Maintenance
      Mod: abbr-name=Mod, classifications=Condition-Qualifier  # Mode
      Modln: abbr-name=Modln, classifications=Action-PhysicalType  # Modulation
      Mol: abbr-name=Mol, classifications=Mean-Environment-Device  # Mole | is used as unit for the amount of substance
      Mom: abbr-name=Mom, classifications=Mean-Environment-Device  # Moment
      Momtm: abbr-name=Momtm, classifications=Action-PhysicalType  # Momentum
      Mon: abbr-name=Mon, classifications=Action-PhysicalType  # Monitoring
      Monr: abbr-name=Monr, classifications=Mean-Environment-Device  # Monitor
      Mot: abbr-name=Mot, classifications=Mean-Environment-Device  # Motor
      Motorcycle: abbr-name=Motorcycle, classifications=Mean-Environment-Device
      Move: abbr-name=Move, classifications=Action-PhysicalType
      Movg: abbr-name=Movg, classifications=Action-PhysicalType  # Moving
      Movmt: abbr-name=Movmt, classifications=Condition-Qualifier  # Movement
      Mpg: abbr-name=Mpg, classifications=Action-PhysicalType  # Mapping
      Mpl: abbr-name=Mpl, classifications=Condition-Qualifier  # Multiple
      Msg: abbr-name=Msg, classifications=Condition-Qualifier  # Message
      Msr: abbr-name=Msr, classifications=Condition-Qualifier  # MSR | Engine drag torque control (also known in german language as "Motorschleppmomentregelung" from which the acronym is derived).
      Mst: abbr-name=Mst, classifications=Condition-Qualifier  # Master
      Mt: abbr-name=Mt, classifications=Mean-Environment-Device  # MT | Manual shifted Transmission
      Mtgtn: abbr-name=Mtgtn, classifications=Condition-Qualifier  # Mitigation
      Mth: abbr-name=Mth, classifications=Mean-Environment-Device  # Month
      Mtn: abbr-name=Mtn, classifications=Action-PhysicalType  # Motion
      Mtr: abbr-name=Mtr, classifications=Mean-Environment-Device  # Meter
      Mtrc: abbr-name=Mtrc, classifications=Condition-Qualifier  # Metric
      Mtrx: abbr-name=Mtrx, classifications=Condition-Qualifier  # Matrix
      Multi: abbr-name=Multi, classifications=Condition-Qualifier
      Mux: abbr-name=Mux, classifications=Mean-Environment-Device  # Multiplexer
      N: abbr-name=N, classifications=Action-PhysicalType  # Speed | Rotatory speed, also referred to as speed of rotation measured in rad/s, rpm or equivalents. Examples: EngN = Engine speed [rpm], WhlN = Wheel speed [rpm]
      Nano: abbr-name=Nano, classifications=Mean-Environment-Device
      Nat: abbr-name=Nat, classifications=Condition-Qualifier  # Natural
      Nav: abbr-name=Nav, classifications=Mean-Environment-Device  # Navigation
      Near: abbr-name=Near, classifications=Condition-Qualifier
      Neg: abbr-name=Neg, classifications=Condition-Qualifier  # Negative
      Negn: abbr-name=Negn, classifications=Condition-Qualifier  # Negation
      Net: abbr-name=Net, classifications=Mean-Environment-Device  # Network | describes all kind of networks in general, e. g. an electric network consisting of any type of consumers and generators
      Neut: abbr-name=Neut, classifications=Condition-Qualifier  # Neutral
      New: abbr-name=New, classifications=Condition-Qualifier
      Night: abbr-name=Night, classifications=Mean-Environment-Device
      Nlnr: abbr-name=Nlnr, classifications=Condition-Qualifier  # Nonlinear | nonlinear. used for description of non linear characteristics (e.g. for an optional additional nonlinear correction)
      Nm: abbr-name=Nm, classifications=Mean-Environment-Device  # NM | Network Management
      No: abbr-name=No, classifications=Preposition  # Opposite of "yes"
      Nod: abbr-name=Nod, classifications=Mean-Environment-Device  # Node | keyword for a junction or joining of lines or ways
      Noise: abbr-name=Noise, classifications=Condition-Qualifier
      Nom: abbr-name=Nom, classifications=Condition-Qualifier  # Nominal
      Norm: abbr-name=Norm, classifications=Condition-Qualifier  # Normal | this keyword is used to describe something as being in the most common mode, e.g. a state machine has a state normal when running properly without disturbance. Do not mix it with Basic for description of fulfilling a basic or minimum requirement.
      Not: abbr-name=Not, classifications=Preposition
      Notif: abbr-name=Notif, classifications=Condition-Qualifier  # Notification
      Now: abbr-name=Now, classifications=Condition-Qualifier  # in this moment
      Nox: abbr-name=Nox, classifications=Mean-Environment-Device  # NOx | Nitrogen oxides, part of the emissions of a combustion engine.
      Noz: abbr-name=Noz, classifications=Mean-Environment-Device  # Nozzle
      Nr: abbr-name=Nr, classifications=Action-PhysicalType  # Number | this keyword is used to express a numbering in physical meaning
      Nrdc: abbr-name=Nrdc, classifications=Condition-Qualifier  # Nordic
      Nv: abbr-name=Nv, classifications=Condition-Qualifier  # Non volatile
      Nvm: abbr-name=Nvm, classifications=Mean-Environment-Device  # NVM | Non Volatile Memory
      Nwt: abbr-name=Nwt, classifications=Mean-Environment-Device  # Newton
      Obd: abbr-name=Obd, classifications=Mean-Environment-Device  # OBD | On Board Diagnosis
      Obj: abbr-name=Obj, classifications=Mean-Environment-Device  # Object
      Obs: abbr-name=Obs, classifications=Action-PhysicalType  # Observe
      Obslt: abbr-name=Obslt, classifications=Condition-Qualifier  # Obsolete
      Obstcl: abbr-name=Obstcl, classifications=Mean-Environment-Device  # Obstacle
      Obstrcn: abbr-name=Obstrcn, classifications=Condition-Qualifier  # Obstruction
      Obsvr: abbr-name=Obsvr, classifications=Mean-Environment-Device  # Observer
      Occpt: abbr-name=Occpt, classifications=Mean-Environment-Device  # Occupant
      Odd: abbr-name=Odd, classifications=Condition-Qualifier
      Of: abbr-name=Of, classifications=Preposition  # Preposition
      Off: abbr-name=Off, classifications=Condition-Qualifier
      Offroad: abbr-name=Offroad, classifications=Condition-Qualifier
      Offs: abbr-name=Offs, classifications=Action-PhysicalType  # Offset
      Ohm: abbr-name=Ohm, classifications=Mean-Environment-Device  # Unit of measure for electric resistance
      Oil: abbr-name=Oil, classifications=Mean-Environment-Device
      Ok: abbr-name=Ok, classifications=Condition-Qualifier  # OK
      Old: abbr-name=Old, classifications=Condition-Qualifier  # in the calculation period n, the keyword OLD assigns a value from the period (n-1).
      On: abbr-name=On, classifications=Preposition
      On1: abbr-name=On, classifications=Condition-Qualifier
      Only: abbr-name=Only, classifications=Preposition
      Open: abbr-name=Open, classifications=Action-PhysicalType
      Opend: abbr-name=Opend, classifications=Condition-Qualifier  # Opened
      Opener: abbr-name=Opener, classifications=Mean-Environment-Device
      Oper: abbr-name=Oper, classifications=Condition-Qualifier  # Operation
      Opt: abbr-name=Opt, classifications=Condition-Qualifier  # Optional
      Optic: abbr-name=Optic, classifications=Condition-Qualifier  # Optical
      Optm: abbr-name=Optm, classifications=Condition-Qualifier  # Optimum
      Optn: abbr-name=Optn, classifications=Condition-Qualifier  # Option
      Or: abbr-name=Or, classifications=Preposition
      Orntn: abbr-name=Orntn, classifications=Action-PhysicalType  # Orientation
      Os: abbr-name=Os, classifications=Mean-Environment-Device  # OS | Operating System
      Osc: abbr-name=Osc, classifications=Action-PhysicalType  # Oscillate
      Oscn: abbr-name=Oscn, classifications=Condition-Qualifier  # Oscillation | This keyword is used to describe occurrences of pulsation or oscillation
      Out: abbr-name=Out, classifications=Preposition
      Outd: abbr-name=Outd, classifications=Mean-Environment-Device  # Outside | Used for outdoor and outside
      Outl: abbr-name=Outl, classifications=Condition-Qualifier  # Outlet | Outlet (e.g. camshaft)
      Outp: abbr-name=Outp, classifications=Condition-Qualifier  # Output
      Outr: abbr-name=Outr, classifications=Condition-Qualifier  # Outer
      Over: abbr-name=Over, classifications=Condition-Qualifier
      Ovf: abbr-name=Ovf, classifications=Condition-Qualifier  # Overflow
      Ovld: abbr-name=Ovld, classifications=Condition-Qualifier  # Overload | The keyword is used for an electrical actuator, if the requested power exceeds the allowed long-time power limit. The overload must be possible for a certain time.
      Ovrd: abbr-name=Ovrd, classifications=Action-PhysicalType  # Override
      Ovrdn: abbr-name=Ovrdn, classifications=Condition-Qualifier  # Overridden
      Ovrheatd: abbr-name=Ovrheatd, classifications=Condition-Qualifier  # Overheated
      Ovrheatg: abbr-name=Ovrheatg, classifications=Action-PhysicalType  # Overheating
      Own: abbr-name=Own, classifications=Condition-Qualifier
      Oxd: abbr-name=Oxd, classifications=Condition-Qualifier  # Oxidation
      P: abbr-name=P, classifications=Action-PhysicalType  # Pressure
      Pa: abbr-name=Pa, classifications=Mean-Environment-Device  # Pascal | Unit of measure for pressure
      Pad: abbr-name=Pad, classifications=Mean-Environment-Device
      Paddl: abbr-name=Paddl, classifications=Mean-Environment-Device  # Paddle
      Page: abbr-name=Page, classifications=Condition-Qualifier
      Pah: abbr-name=Pah, classifications=Mean-Environment-Device  # Path
      Pan: abbr-name=Pan, classifications=Mean-Environment-Device  # Panel
      Panic: abbr-name=Panic, classifications=Action-PhysicalType
      Par: abbr-name=Par, classifications=Condition-Qualifier  # Parity
      Parent: abbr-name=Parent, classifications=Condition-Qualifier  # e.g. "Parent street segment" used in context of route guidance from navigation system
      Park: abbr-name=Park, classifications=Action-PhysicalType
      Part: abbr-name=Part, classifications=Condition-Qualifier
      Pas: abbr-name=Pas, classifications=Condition-Qualifier  # Passive
      Pase: abbr-name=Pase, classifications=Mean-Environment-Device  # PASE | Passive Start and Entry (PASE), keyless access.
      Pass: abbr-name=Pass, classifications=Mean-Environment-Device  # Passenger
      Passd: abbr-name=Passd, classifications=Condition-Qualifier  # Passed
      Pat: abbr-name=Pat, classifications=Condition-Qualifier  # Pattern
      Pck: classifications=Condition-Qualifier  # package, pack | Hierarchical element, representing a collection of coherent entities/functionalities/instances.
      Pdu: abbr-name=Pdu, classifications=Mean-Environment-Device  # PDU | Protocol Data Unit
      Peak: abbr-name=Peak, classifications=Condition-Qualifier
      Ped: abbr-name=Ped, classifications=Mean-Environment-Device  # Pedestrian
      Pedl: abbr-name=Pedl, classifications=Mean-Environment-Device  # Pedal
      Pelv: abbr-name=Pelv, classifications=Mean-Environment-Device  # Pelvis | pelvis of human body
      Pen: abbr-name=Pen, classifications=Condition-Qualifier  # Personalization
      Per: abbr-name=Per, classifications=Preposition  # Preposition
      Perc: abbr-name=Perc, classifications=Action-PhysicalType  # Percent
      Perd: abbr-name=Perd, classifications=Condition-Qualifier  # Period
      Perml: abbr-name=Perml, classifications=Condition-Qualifier  # Permille
      Permtn: abbr-name=Permtn, classifications=Condition-Qualifier  # Permutation
      Perox: abbr-name=Perox, classifications=Mean-Environment-Device  # Peroxide
      Pfi: abbr-name=Pfi, classifications=Mean-Environment-Device  # PFI | Port Fuel Injection
      Pha: abbr-name=Pha, classifications=Condition-Qualifier  # Phase
      Phev: abbr-name=Phev, classifications=Mean-Environment-Device  # PHEV | Plug-in Hybrid Electric Vehicle
      Philippine: abbr-name=Philippine, classifications=Condition-Qualifier
      Phy: abbr-name=Phy, classifications=Condition-Qualifier  # Physical
      Pi: abbr-name=Pi, classifications=Condition-Qualifier
      Pico: abbr-name=Pico, classifications=Mean-Environment-Device
      Pid: abbr-name=Pid, classifications=Condition-Qualifier  # PID | Proportional Integral Derivative, as widely used in "PID Controller".
      Pin: abbr-name=Pin, classifications=Mean-Environment-Device
      Pinion: abbr-name=Pinion, classifications=Mean-Environment-Device
      Pipe: abbr-name=Pipe, classifications=Mean-Environment-Device
      Pist: abbr-name=Pist, classifications=Mean-Environment-Device  # Piston | central component in a combustion engine. It serves to transform the gas pressure within the cylinder into a movement. The keyword is used e.g. to express the name for piston temperature
      Pitch: abbr-name=Pitch, classifications=Action-PhysicalType
      Pitchovr: abbr-name=Pitchovr, classifications=Action-PhysicalType  # Pitchover
      Pla: abbr-name=Pla, classifications=Mean-Environment-Device  # Plant
      Plate: abbr-name=Plate, classifications=Mean-Environment-Device
      Plaus: abbr-name=Plaus, classifications=Condition-Qualifier  # Plausible
      Pll: abbr-name=Pll, classifications=Mean-Environment-Device  # PLL | Phase Locked Loop
      Plow: abbr-name=Plow, classifications=Mean-Environment-Device  # for example for snow plow, etc.
      Pls: abbr-name=Pls, classifications=Mean-Environment-Device  # Pulse | a pulse is a simple electrical signal with a defined shape
      Pmp: abbr-name=Pmp, classifications=Mean-Environment-Device  # Pump
      Pnd: abbr-name=Pnd, classifications=Condition-Qualifier  # Pending | This keyword is used to build the "pending" fault used in the error management aggregate defined by the ISO 15031-5.5 service $07.
      Pnm: abbr-name=Pnm, classifications=Condition-Qualifier  # Pneumatic | used e.g. for description of pneumatic actuators (such as recirculation valve actuator or waste gate actuator)
      Polarity: abbr-name=Polarity, classifications=Condition-Qualifier
      Pole: abbr-name=Pole, classifications=Condition-Qualifier  # e.g. magnetic pole
      Polling: abbr-name=Polling, classifications=Action-PhysicalType
      Pool: abbr-name=Pool, classifications=Mean-Environment-Device
      Port: abbr-name=Port, classifications=Condition-Qualifier
      Pos: abbr-name=Pos, classifications=Condition-Qualifier  # Positive
      Posn: abbr-name=Posn, classifications=Action-PhysicalType  # Position
      Posng: abbr-name=Posng, classifications=Action-PhysicalType  # Positioning
      Post: abbr-name=Post, classifications=Preposition
      Poti: abbr-name=Poti, classifications=Mean-Environment-Device  # Potentiometer
      Ppty: abbr-name=Ppty, classifications=Condition-Qualifier  # Property
      Pr: abbr-name=Pr, classifications=Action-PhysicalType  # Prandtl number
      Pre: abbr-name=Pre, classifications=Preposition  # used to express any kind of pre-processing like e.g. for pre-injection
      Prec: abbr-name=Prec, classifications=Condition-Qualifier  # Precharge
      Pred: abbr-name=Pred, classifications=Condition-Qualifier  # Predicted
      Prel: abbr-name=Prel, classifications=Condition-Qualifier  # Preliminary
      Prem: abbr-name=Prem, classifications=Condition-Qualifier  # Premature
      Prep: abbr-name=Prep, classifications=Action-PhysicalType  # Prepare
      Prepn: abbr-name=Prepn, classifications=Condition-Qualifier  # Preparation | this characteristic is used to express a general status of preparation, e.g. processing of certain tasks before an activation of a certain component or functionality
      Pres: abbr-name=Pres, classifications=Condition-Qualifier  # Presence
      Prev: abbr-name=Prev, classifications=Condition-Qualifier  # Previous
      Prevn: abbr-name=Prevn, classifications=Condition-Qualifier  # Prevention
      Prfmnc: abbr-name=Prfmnc, classifications=Condition-Qualifier  # Performance
      Prim: abbr-name=Prim, classifications=Condition-Qualifier  # Primary
      Prio: abbr-name=Prio, classifications=Condition-Qualifier  # Priority
      Prj: abbr-name=Prj, classifications=Condition-Qualifier  # Project
      Prjn: abbr-name=Prjn, classifications=Condition-Qualifier  # Projection
      Prkg: abbr-name=Prkg, classifications=Mean-Environment-Device  # Parking
      Prm: abbr-name=Prm, classifications=Condition-Qualifier  # Parameter
      Prmnt: abbr-name=Prmnt, classifications=Condition-Qualifier  # Permanent
      Probl: abbr-name=Probl, classifications=Condition-Qualifier  # Probable | e.g. probable path from nagivation system
      Problty: abbr-name=Problty, classifications=Condition-Qualifier  # Probability
      Proc: abbr-name=Proc, classifications=Action-PhysicalType  # Process
      Prof: abbr-name=Prof, classifications=Action-PhysicalType  # Profile
      Prog: abbr-name=Prog, classifications=Condition-Qualifier  # Program
      Progd: abbr-name=Progd, classifications=Condition-Qualifier  # Programmed
      Progm: abbr-name=Progm, classifications=Condition-Qualifier  # Programming
      Progs: abbr-name=Progs, classifications=Condition-Qualifier  # Progress
      Progsn: abbr-name=Progsn, classifications=Condition-Qualifier  # Progression
      Prohb: abbr-name=Prohb, classifications=Action-PhysicalType  # prohibit
      Prop: abbr-name=Prop, classifications=Condition-Qualifier  # Proportional
      Prot: abbr-name=Prot, classifications=Action-PhysicalType  # Protect
      Protd: abbr-name=Protd, classifications=Condition-Qualifier  # Protected
      Protn: abbr-name=Protn, classifications=Action-PhysicalType  # Protection
      Prototype: abbr-name=Prototype, classifications=Condition-Qualifier
      Prp: abbr-name=Prp, classifications=Condition-Qualifier  # Propulsive | opposite of drag resistance. Notion of positive forces generated by a system. Example: for a car, we can list internal combustion engine + starter/generator + electrical engine
      Prpn: abbr-name=Prpn, classifications=Condition-Qualifier  # Propulsion
      Prsnl: abbr-name=Prsnl, classifications=Condition-Qualifier  # Personal
      Prsnt: abbr-name=Prsnt, classifications=Condition-Qualifier  # Present
      Psbl: abbr-name=Psbl, classifications=Condition-Qualifier  # Possible
      Psd: abbr-name=Psd, classifications=Condition-Qualifier  # Pressed
      Pt: abbr-name=Pt, classifications=Mean-Environment-Device  # Powertrain
      Ptc: abbr-name=Ptc, classifications=Mean-Environment-Device  # PTC | Power Train Controller
      Ptl: abbr-name=Ptl, classifications=Condition-Qualifier  # Partial | this keyword expresses the characterization of "only partly, not completely"
      Ptr: abbr-name=Ptr, classifications=Condition-Qualifier  # Pointer
      Puddle: abbr-name=Puddle, classifications=Mean-Environment-Device
      Pull: abbr-name=Pull, classifications=Action-PhysicalType
      Purg: abbr-name=Purg, classifications=Action-PhysicalType  # Purge
      Push: abbr-name=Push, classifications=Action-PhysicalType  # push (start), towing, power on driving, press. keyword for push or active towing (e.g. if a vehicle has to be started by towing, a button is pressed, if there is positive torque inside powertrain)
      Put: abbr-name=Put, classifications=Action-PhysicalType
      Pwd: abbr-name=Pwd, classifications=Condition-Qualifier  # Password
      Pwm: abbr-name=Pwm, classifications=Condition-Qualifier  # PWM | Pulse Width Modulation
      Pwr: abbr-name=Pwr, classifications=Action-PhysicalType  # Power
      Pwr1: abbr-name=Pwr, classifications=Mean-Environment-Device  # Power
      Pyro: abbr-name=Pyro, classifications=Mean-Environment-Device  # Pyrometer | this keyword is used to express a relationship to a pyrometer which is a contactless instrument to measure high temperatures
      Qlfr: abbr-name=Qlfr, classifications=Condition-Qualifier  # Qualifier
      Qly: abbr-name=Qly, classifications=Condition-Qualifier  # Quality | This keyword is used to express the word 'quality'
      Qnty: abbr-name=Qnty, classifications=Condition-Qualifier  # Quantity
      Query: abbr-name=Query, classifications=Condition-Qualifier
      Quick: abbr-name=Quick, classifications=Condition-Qualifier
      Quo: abbr-name=Quo, classifications=Condition-Qualifier  # Quotient
      R: abbr-name=R, classifications=Action-PhysicalType  # Resistance | Unit must be Ohm
      Rad: abbr-name=Rad, classifications=Mean-Environment-Device  # Radian | As unit of measure for angles
      Radio: abbr-name=Radio, classifications=Mean-Environment-Device
      Radr: abbr-name=Radr, classifications=Mean-Environment-Device  # Radiator | a radiator is a component, that senses out heat. It can be found e.g. in the cooling circuit of a car.
      Rail: abbr-name=Rail, classifications=Mean-Environment-Device  # Examples: Common Rail, Fuel Pressure Rail. The common rail is a core component in some fuel system configurations (esp. diesel). It is a high pressure fuel container mostly in form of a tube and located close to the engine.
      Rain: abbr-name=Rain, classifications=Mean-Environment-Device
      Ram: abbr-name=Ram, classifications=Mean-Environment-Device  # RAM | Random Access Memory
      Ramp: abbr-name=Ramp, classifications=Condition-Qualifier
      Rat: abbr-name=Rat, classifications=Action-PhysicalType  # Ratio | RATIO is used to describe a value gained from a proportion of other values. The unit of RATIO must be [-] (no unit).
      Rate: abbr-name=Rate, classifications=Action-PhysicalType  # this keyword is used to express a rate in physical meaning
      Raw: abbr-name=Raw, classifications=Condition-Qualifier  # Unprocessed sensor data.
      Rbd: abbr-name=Rbd, classifications=Condition-Qualifier  # Rebound
      Rcnd: abbr-name=Rcnd, classifications=Condition-Qualifier  # Recognized
      Rcrltn: abbr-name=Rcrltn, classifications=Condition-Qualifier  # Ricirculation
      Rd: abbr-name=Rd, classifications=Action-PhysicalType  # Radius
      Rdnt: abbr-name=Rdnt, classifications=Condition-Qualifier  # Redundant
      Rdr: abbr-name=Rdr, classifications=Mean-Environment-Device  # Radar
      Rdy: abbr-name=Rdy, classifications=Condition-Qualifier  # Ready | readiness identification
      Re: abbr-name=Re, classifications=Condition-Qualifier  # Rear
      Re1: abbr-name=Re, classifications=Mean-Environment-Device  # Reynolds Number
      Reactn: abbr-name=Reactn, classifications=Action-PhysicalType  # Reaction
      Reacvn: abbr-name=Reacvn, classifications=Condition-Qualifier  # Reactivation
      Read: abbr-name=Read, classifications=Action-PhysicalType
      Reading: abbr-name=Reading, classifications=Action-PhysicalType
      Real: abbr-name=Real, classifications=Condition-Qualifier  # Real part
      Rec: abbr-name=Rec, classifications=Condition-Qualifier  # Record
      Recalcn: abbr-name=Recalcn, classifications=Action-PhysicalType  # Recalculation
      Recall: abbr-name=Recall, classifications=Condition-Qualifier
      Recirc: abbr-name=Recirc, classifications=Action-PhysicalType  # Recirculation
      Recpr: abbr-name=Recpr, classifications=Condition-Qualifier  # Reciprocal
      Red: abbr-name=Red, classifications=Condition-Qualifier  # Reduce
      Redn: abbr-name=Redn, classifications=Condition-Qualifier  # Reduction
      Ref: abbr-name=Ref, classifications=Condition-Qualifier  # Reference
      Refgnt: abbr-name=Refgnt, classifications=Condition-Qualifier  # Refrigerant | A refrigerant is a substance or mixture, usually a fluid, used in a heat pump and refrigeration cycle.
      Refrsh: abbr-name=Refrsh, classifications=Action-PhysicalType  # Refresh
      Refu: abbr-name=Refu, classifications=Action-PhysicalType  # Refuel
      Regn: abbr-name=Regn, classifications=Condition-Qualifier  # Region
      Reinf: abbr-name=Reinf, classifications=Action-PhysicalType  # Reinforce
      Rejctd: abbr-name=Rejctd, classifications=Condition-Qualifier  # Rejected
      Rel: abbr-name=Rel, classifications=Condition-Qualifier  # Relative
      Reld: abbr-name=Reld, classifications=Condition-Qualifier  # Released
      Rels: abbr-name=Rels, classifications=Action-PhysicalType  # Release
      Relzd: abbr-name=Relzd, classifications=Condition-Qualifier  # Realized
      Rem: abbr-name=Rem, classifications=Condition-Qualifier  # Remote
      Rep: abbr-name=Rep, classifications=Action-PhysicalType  # Repeat
      Replcmt: abbr-name=Replcmt, classifications=Condition-Qualifier  # Replacement
      Repn: abbr-name=Repn, classifications=Condition-Qualifier  # Repetition
      Req: abbr-name=Req, classifications=Condition-Qualifier  # Request
      Reqd: abbr-name=Reqd, classifications=Condition-Qualifier  # Requested
      Res: abbr-name=Res, classifications=Condition-Qualifier  # Result
      Resd: abbr-name=Resd, classifications=Condition-Qualifier  # Reserved
      Resi: abbr-name=Resi, classifications=Condition-Qualifier  # Residual
      Resl: abbr-name=Resl, classifications=Condition-Qualifier  # Resolution
      Resp: abbr-name=Resp, classifications=Condition-Qualifier  # Response
      Rest: abbr-name=Rest, classifications=Condition-Qualifier
      Restore: abbr-name=Restore, classifications=Action-PhysicalType
      Restrctn: abbr-name=Restrctn, classifications=Action-PhysicalType  # Restriction
      Restrnt: abbr-name=Restrnt, classifications=Mean-Environment-Device  # Restraint
      Resu: abbr-name=Resu, classifications=Condition-Qualifier  # Resume
      Resv: abbr-name=Resv, classifications=Condition-Qualifier  # Reserve
      Rev: abbr-name=Rev, classifications=Mean-Environment-Device  # Revolution | As unit of measure
      Rex: abbr-name=Rex, classifications=Mean-Environment-Device  # REX | Range Extender
      Rgl: abbr-name=Rgl, classifications=Condition-Qualifier  # Regular | this keyword is used to describe e.g. a process as being in a normal status in sense of correctness. It is behaving like wanted (it behaves like wanted to treat a disturbance), it is not out of order.
      Rgln: abbr-name=Rgln, classifications=Condition-Qualifier  # Regulation
      Rgn: abbr-name=Rgn, classifications=Condition-Qualifier  # Regeneration
      Rho: abbr-name=Rho, classifications=Action-PhysicalType  # density
      Ri: abbr-name=Ri, classifications=Condition-Qualifier  # Right | right
      Rich: abbr-name=Rich, classifications=Condition-Qualifier
      Ride: abbr-name=Ride, classifications=Action-PhysicalType
      Rise: abbr-name=Rise, classifications=Action-PhysicalType
      Risk: abbr-name=Risk, classifications=Condition-Qualifier
      Risng: abbr-name=Risng, classifications=Condition-Qualifier  # Rising
      Rke: abbr-name=Rke, classifications=Mean-Environment-Device  # RKE | Remote Keyless Entry
      Rlv: abbr-name=Rlv, classifications=Condition-Qualifier  # Relevant
      Rlvc: abbr-name=Rlvc, classifications=Condition-Qualifier  # Relevance
      Rly: abbr-name=Rly, classifications=Mean-Environment-Device  # Relay
      Rmn: abbr-name=Rmn, classifications=Mean-Environment-Device  # Reminder
      Rnd: abbr-name=Rnd, classifications=Condition-Qualifier  # Random
      Rng: abbr-name=Rng, classifications=Action-PhysicalType  # Range
      Road: abbr-name=Road, classifications=Mean-Environment-Device  # this keyword is used to express the conditions a street can apply to the vehicle
      Roll: abbr-name=Roll, classifications=Action-PhysicalType
      Rollbar: abbr-name=Rollbar, classifications=Mean-Environment-Device  # (Active) safety roll bar to protect passengers
      Rollg: abbr-name=Rollg, classifications=Action-PhysicalType  # Rolling
      Rollovr: abbr-name=Rollovr, classifications=Action-PhysicalType  # Rollover | Info from airbag control unit
      Rollr: abbr-name=Rollr, classifications=Mean-Environment-Device  # Roller
      Rom: abbr-name=Rom, classifications=Mean-Environment-Device  # ROM | Read Only Memory
      Ron: abbr-name=Ron, classifications=Action-PhysicalType  # RON | Research Octane Number
      Roof: abbr-name=Roof, classifications=Mean-Environment-Device
      Rot: abbr-name=Rot, classifications=Condition-Qualifier  # Rotation | This keyword is used to express circular motions.
      Rotl: abbr-name=Rotl, classifications=Condition-Qualifier  # Rotational
      Rotor: abbr-name=Rotor, classifications=Mean-Environment-Device
      Roty: abbr-name=Roty, classifications=Condition-Qualifier  # Rotary
      Roughns: abbr-name=Roughns, classifications=Action-PhysicalType  # Roughness
      Route: abbr-name=Route, classifications=Condition-Qualifier  # e.g. used in context of route guidance from navigation system
      Row: abbr-name=Row, classifications=Mean-Environment-Device
      Rpm: abbr-name=Rpm, classifications=Mean-Environment-Device  # RPM | Revolutions per Minute, used as unit of measure of frequency
      Rqrd: abbr-name=Rqrd, classifications=Condition-Qualifier  # Required
      Rsa: abbr-name=Rsa, classifications=Condition-Qualifier  # RSA | Republic of South Africa
      Rsc: abbr-name=Rsc, classifications=Mean-Environment-Device  # RSC | Roll Stability Control
      Rst: abbr-name=Rst, classifications=Condition-Qualifier  # Reset
      Rstrt: abbr-name=Rstrt, classifications=Condition-Qualifier  # Restart
      Rt: abbr-name=Rt, classifications=Condition-Qualifier  # Runtime
      Rtd: abbr-name=Rtd, classifications=Condition-Qualifier  # Retard
      Rtdr: abbr-name=Rtdr, classifications=Condition-Qualifier  # Retarder
      Rte: abbr-name=Rte, classifications=Mean-Environment-Device  # RTE | Run-Time Environment
      Rtrctr: abbr-name=Rtrctr, classifications=Mean-Environment-Device  # Retractor | Part of supplement restraint system to protect occupant in case of crash
      Rule: abbr-name=Rule, classifications=Condition-Qualifier
      Run: abbr-name=Run, classifications=Action-PhysicalType
      Runng: abbr-name=Runng, classifications=Condition-Qualifier  # Running
      Rvs: abbr-name=Rvs, classifications=Condition-Qualifier  # Reverse
      Rvsb: abbr-name=Rvsb, classifications=Condition-Qualifier  # Reversible | This keyword is used to express that something can return to a previous status, e.g. in Cruise Control deactivation: It means in this case that cruise can be activated again in the same driving cycle once a deactivation occurred.
      Rvsg: abbr-name=Rvsg, classifications=Action-PhysicalType  # Reversing
      Rx: abbr-name=Rx, classifications=Action-PhysicalType  # Receive
      Rxn: abbr-name=Rxn, classifications=Condition-Qualifier  # Reception
      Rxr: abbr-name=Rxr, classifications=Mean-Environment-Device  # Receiver
      S: abbr-name=S, classifications=Mean-Environment-Device  # Siemens | Unit of measure for conductance
      Safe: abbr-name=Safe, classifications=Condition-Qualifier
      Sail: abbr-name=Sail, classifications=Condition-Qualifier  # Sailing | Situation of vehicle, where the clutch is kept open and the vehicle is moving by its own inertia, e.g. rolling downhill (coast driving state of a vehicle is a typical transmission / clutch function). The engine might be shut of.
      Sale: abbr-name=Sale, classifications=Action-PhysicalType
      Sample: abbr-name=Sample, classifications=Condition-Qualifier
      Satn: abbr-name=Satn, classifications=Action-PhysicalType  # Saturation
      Save: abbr-name=Save, classifications=Action-PhysicalType
      Saved: abbr-name=Saved, classifications=Condition-Qualifier
      Sca: abbr-name=Sca, classifications=Condition-Qualifier  # Scale
      Scan: abbr-name=Scan, classifications=Action-PhysicalType
      Scanr: abbr-name=Scanr, classifications=Mean-Environment-Device  # Scanner
      Scav: abbr-name=Scav, classifications=Condition-Qualifier  # Scavenging | The process of pushing fresh gas from the inlet into the exhaust by having big overlap of opened inlet and outlet valve, especially at charged engines is called scavenging.
      Scr: abbr-name=Scr, classifications=Mean-Environment-Device  # SCR | Selective Catalytic Reduction (System)
      Scrn: abbr-name=Scrn, classifications=Mean-Environment-Device  # Screen
      Sdl: abbr-name=Sdl, classifications=Condition-Qualifier  # Scheduler
      Seat: abbr-name=Seat, classifications=Mean-Environment-Device
      Seatg: abbr-name=Seatg, classifications=Condition-Qualifier  # Seating
      Sec: abbr-name=Sec, classifications=Condition-Qualifier  # Second | Used as "2nd"
      Sec1: abbr-name=Sec, classifications=Mean-Environment-Device  # Second | Used as time unit
      Sector: abbr-name=Sector, classifications=Condition-Qualifier
      Secu: abbr-name=Secu, classifications=Condition-Qualifier  # Security
      Seed: abbr-name=Seed, classifications=Condition-Qualifier
      Seg: abbr-name=Seg, classifications=Mean-Environment-Device  # Segment
      Segd: abbr-name=Segd, classifications=Condition-Qualifier  # Segmented
      Sel: abbr-name=Sel, classifications=Action-PhysicalType  # Select
      Seld: abbr-name=Seld, classifications=Condition-Qualifier  # Selected
      Self: abbr-name=Self, classifications=Condition-Qualifier
      Seln: abbr-name=Seln, classifications=Condition-Qualifier  # Selection | Seln is used to assign e.g. the selection of a certain functionality (one out of several strategies) or component (one of several gears, sensors,..) as well as in simulation to select a single entry of an Array by putting Seln at the end of the name
      Sen: abbr-name=Sen, classifications=Action-PhysicalType  # Sensing
      Sent: abbr-name=Sent, classifications=Mean-Environment-Device  # SENT | Single Edge Nibble Transmission (Protocol)
      Seq: abbr-name=Seq, classifications=Condition-Qualifier  # Sequence
      Seql: abbr-name=Seql, classifications=Condition-Qualifier  # Sequential
      Ser: abbr-name=Ser, classifications=Mean-Environment-Device  # Serie
      Serl: abbr-name=Serl, classifications=Condition-Qualifier  # Serial
      Servo: abbr-name=Servo, classifications=Condition-Qualifier
      Session: abbr-name=Session, classifications=Condition-Qualifier
      Set: abbr-name=Set, classifications=Action-PhysicalType
      Sev: abbr-name=Sev, classifications=Action-PhysicalType  # Severity
      Sfty: abbr-name=Sfty, classifications=Mean-Environment-Device  # Safety
      Shaft: abbr-name=Shaft, classifications=Condition-Qualifier  # a shaft is a rotating rod, carrying out a certain task or transmitting a force in a powertrain. Example: outbox gearbox shaft.
      Shd: abbr-name=Shd, classifications=Condition-Qualifier  # Shield
      Shift: abbr-name=Shift, classifications=Action-PhysicalType  # Used e.g. in up shift (ShiftUp) or down shift (ShiftDwn) or gear shift (GearShift) (synonyms: upshift, downshift, gearshift, UpShift, DownShift etc.).
      Shiftr: abbr-name=Shiftr, classifications=Mean-Environment-Device  # Shifter
      Sho: abbr-name=Sho, classifications=Condition-Qualifier  # Short | short trip
      Shong: abbr-name=Shong, classifications=Action-PhysicalType  # Shortening
      Sht: abbr-name=Sht, classifications=Action-PhysicalType  # Shut | e.g. to shut down; do not introduce a special keyword for the noun "Shutdown" but the content can be expressed using the combination of "Sht" and "Dwn"
      Shttr: abbr-name=Shttr, classifications=Mean-Environment-Device  # Shutter
      Side: abbr-name=Side, classifications=Condition-Qualifier  # This keyword is intended for common consideration of inlet and exhaust side.
      Sig: abbr-name=Sig, classifications=Condition-Qualifier  # Signal
      Sill: abbr-name=Sill, classifications=Mean-Environment-Device
      Simd: abbr-name=Simd, classifications=Condition-Qualifier  # Simulated
      Simn: abbr-name=Simn, classifications=Condition-Qualifier  # Simulation
      Simple: abbr-name=Simple, classifications=Condition-Qualifier
      Sin: abbr-name=Sin, classifications=Condition-Qualifier  # Sinus
      Size: abbr-name=Size, classifications=Condition-Qualifier
      Skip: abbr-name=Skip, classifications=Action-PhysicalType
      Slave: abbr-name=Slave, classifications=Condition-Qualifier
      Sld: abbr-name=Sld, classifications=Action-PhysicalType  # Slide
      Sldg: abbr-name=Sldg, classifications=Action-PhysicalType  # Sliding
      Sleep: abbr-name=Sleep, classifications=Condition-Qualifier
      Slip: abbr-name=Slip, classifications=Action-PhysicalType
      Slop: abbr-name=Slop, classifications=Condition-Qualifier  # Slope
      Slow: abbr-name=Slow, classifications=Condition-Qualifier
      Small: abbr-name=Small, classifications=Condition-Qualifier
      Smk: abbr-name=Smk, classifications=Mean-Environment-Device  # Smoke
      Smotng: abbr-name=Smotng, classifications=Action-PhysicalType  # Smoothing
      Smt: abbr-name=Smt, classifications=Condition-Qualifier  # Smart | more and more electronic components take over tasks that had been done before by a central processing unit. Such components are seen as "intelligent" or "smart", whereas the second expression is the one used more generally.
      Snd: abbr-name=Snd, classifications=Action-PhysicalType  # Send
      Sng: abbr-name=Sng, classifications=Condition-Qualifier  # Single
      Snow: abbr-name=Snow, classifications=Condition-Qualifier  # for example for snow mode or snow plow, etc.
      Snsr: abbr-name=Snsr, classifications=Mean-Environment-Device  # Sensor
      Snvty: abbr-name=Snvty, classifications=Condition-Qualifier  # Sensitivity
      Soc: abbr-name=Soc, classifications=Condition-Qualifier  # SOC | State of Charge
      Soft: abbr-name=Soft, classifications=Condition-Qualifier
      Soi: abbr-name=Soi, classifications=Condition-Qualifier  # SOI | Start of Injection. Unit must be angle
      Soln: abbr-name=Soln, classifications=Mean-Environment-Device  # Solenoid
      Soon: abbr-name=Soon, classifications=Condition-Qualifier
      Soot: abbr-name=Soot, classifications=Mean-Environment-Device  # used in the sense of soot or smut
      Sound: abbr-name=Sound, classifications=Action-PhysicalType
      Soundr: abbr-name=Soundr, classifications=Mean-Environment-Device  # Sounder
      Sox: abbr-name=Sox, classifications=Mean-Environment-Device  # SOx | Sulphur Oxide
      Sp: abbr-name=Sp, classifications=Condition-Qualifier  # Setpoint
      Spare: abbr-name=Spare, classifications=Condition-Qualifier
      Spc: abbr-name=Spc, classifications=Condition-Qualifier  # Specific | for specific environmental data (stored individually with particular failures of one project).
      Spcl: abbr-name=Spcl, classifications=Condition-Qualifier  # Special
      Spd: abbr-name=Spd, classifications=Action-PhysicalType  # Speed | Use N for rotatory speeds, use V for translatory speeds and only if both of them are not appropriate use Spd. In Chassis currently both is used: Velocity and Spd, as well as „V“ and „Spd“ and combinations. „N“ is also used.
      Spi: abbr-name=Spi, classifications=Condition-Qualifier  # SPI | Serial Peripheral Interface
      Spkr: abbr-name=Spkr, classifications=Mean-Environment-Device  # Speaker | e.g. loudspeaker
      Split: abbr-name=Split, classifications=Condition-Qualifier
      Sply: abbr-name=Sply, classifications=Action-PhysicalType  # Supply
      Spo: abbr-name=Spo, classifications=Condition-Qualifier  # Spontaneous | this Keyword characterizes a sudden, unexpected occurrence. E.g. a not pre-arranged catalyst regeneration phase.
      Sppl: abbr-name=Sppl, classifications=Condition-Qualifier  # Supplementary
      Sprg: abbr-name=Sprg, classifications=Mean-Environment-Device  # Spring
      Sprk: abbr-name=Sprk, classifications=Action-PhysicalType  # Spark
      Spt: abbr-name=Spt, classifications=Condition-Qualifier  # Sport | Related to the (short- and long term) detection of driver type either an economic/comfort oriented or a sportive/ power requesting driver can be distinguished.
      Sq: abbr-name=Sq, classifications=Condition-Qualifier  # Square | the Keyword is used to describe the relationship of a Functional Data to the arithmetic procedure of multiplication of a value with itself.
      Sqd: abbr-name=Sqd, classifications=Condition-Qualifier  # Squared
      Sqrt: abbr-name=Sqrt, classifications=Condition-Qualifier  # square root
      Srad: abbr-name=Srad, classifications=Mean-Environment-Device  # Steradian | As a unit of measure for solid angle
      Src: abbr-name=Src, classifications=Condition-Qualifier  # Source
      Srv: abbr-name=Srv, classifications=Condition-Qualifier  # Service | a service is a processing routine within a certain functionality. This keyword is used to nominate such services.
      Ssm: abbr-name=Ssm, classifications=Mean-Environment-Device  # SSM | Stand Still Manager
      St: abbr-name=St, classifications=Condition-Qualifier  # State | Used for both, "state" and "status".
      Stab: abbr-name=Stab, classifications=Condition-Qualifier  # Stable
      Stabn: abbr-name=Stabn, classifications=Action-PhysicalType  # Stabilization
      Stabr: abbr-name=Stabr, classifications=Mean-Environment-Device  # Stabilizer
      Staby: abbr-name=Staby, classifications=Condition-Qualifier  # Stability
      Stall: abbr-name=Stall, classifications=Action-PhysicalType
      Stallg: abbr-name=Stallg, classifications=Condition-Qualifier  # Stalling
      Stamp: abbr-name=Stamp, classifications=Action-PhysicalType
      Stand: abbr-name=Stand, classifications=Action-PhysicalType
      Standg: abbr-name=Standg, classifications=Action-PhysicalType  # Standing
      Stat: abbr-name=Stat, classifications=Condition-Qualifier  # Static
      Stator: abbr-name=Stator, classifications=Mean-Environment-Device
      Staty: abbr-name=Staty, classifications=Condition-Qualifier  # Stationary | This keyword is used to describe a situation, where a movable part is at rest or a certain condition does not change
      Stb: abbr-name=Stb, classifications=Condition-Qualifier  # Standby
      Stc: abbr-name=Stc, classifications=Condition-Qualifier  # Statistic
      Stck: abbr-name=Stck, classifications=Mean-Environment-Device  # Stack | An orderly pile or heap
      Std: abbr-name=Std, classifications=Condition-Qualifier  # Standard | e.g. as in standard deviation
      Stdn: abbr-name=Stdn, classifications=Condition-Qualifier  # Standardization
      Steer: abbr-name=Steer, classifications=Mean-Environment-Device  # Steering | This keyword is used to express the steering of a car.
      Step: abbr-name=Step, classifications=Condition-Qualifier
      Stfn: abbr-name=Stfn, classifications=Action-PhysicalType  # Stiffness | stiffness is the grade of hardness of a material, e.g. in a damper: it is composed of a spring (stiffness part: force proportional to displacement) and a fluid friction (viscous part: force proportional to speed)
      Stg: abbr-name=Stg, classifications=Mean-Environment-Device  # Stage | Examples: Power Stage / Powerstage
      Stgy: abbr-name=Stgy, classifications=Condition-Qualifier  # Strategy
      Sti: abbr-name=Sti, classifications=Condition-Qualifier  # Stimulation | The stimulation describes the inputs for testing of functions.
      Still: abbr-name=Still, classifications=Condition-Qualifier
      Stk: abbr-name=Stk, classifications=Condition-Qualifier  # Stroke
      Stoi: abbr-name=Stoi, classifications=Condition-Qualifier  # Stoichiometric
      Stop: abbr-name=Stop, classifications=Action-PhysicalType
      Store: abbr-name=Store, classifications=Action-PhysicalType
      Storg: abbr-name=Storg, classifications=Action-PhysicalType  # Storage
      Strat: abbr-name=Strat, classifications=Condition-Qualifier  # Stratified | e. g. used in stratified injection
      Strike: abbr-name=Strike, classifications=Action-PhysicalType
      Strt: abbr-name=Strt, classifications=Action-PhysicalType  # Start
      Strtd: abbr-name=Strtd, classifications=Condition-Qualifier  # Started
      Strtg: abbr-name=Strtg, classifications=Condition-Qualifier  # Starting
      Strtr: abbr-name=Strtr, classifications=Mean-Environment-Device  # Starter
      Struct: abbr-name=Struct, classifications=Condition-Qualifier  # Structure
      Sts: abbr-name=Sts, classifications=Condition-Qualifier  # Status
      Stuck: abbr-name=Stuck, classifications=Condition-Qualifier  # the keyword STUCK is used to express e.g. a "stuck reading" coolant temperature sensor. This is an official expression of the CARB (Californian Air Resources Board) and is used in term of OBD II requirements.
      Su: abbr-name=Su, classifications=Mean-Environment-Device  # Sulphur
      Sub: abbr-name=Sub, classifications=Condition-Qualifier  # Substitute
      Subt: abbr-name=Subt, classifications=Condition-Qualifier  # Subtractive
      Subtyp: abbr-name=Subtyp, classifications=Condition-Qualifier  # Subtype
      Suctn: abbr-name=Suctn, classifications=Action-PhysicalType  # Suction
      Sum: abbr-name=Sum, classifications=Condition-Qualifier
      Sun: abbr-name=Sun, classifications=Mean-Environment-Device
      Sup: abbr-name=Sup, classifications=Preposition  # Super | example: super charger
      Supp: abbr-name=Supp, classifications=Action-PhysicalType  # Suppress
      Suppsn: abbr-name=Suppsn, classifications=Action-PhysicalType  # Superposition
      Supr: abbr-name=Supr, classifications=Condition-Qualifier  # Superior
      Surf: abbr-name=Surf, classifications=Mean-Environment-Device  # Surface | The exterior or upper boundary of an object, fluid or body.
      Surge: abbr-name=Surge, classifications=Condition-Qualifier  # surging, surge line. this keyword is used to describe the appearance of surging effects in an (air-)stream, e.g. at the surge line of a turbocharger (which is a characteristic parameter)
      Surrndgs: abbr-name=Surrndgs, classifications=Mean-Environment-Device  # Surroundings
      Susp: abbr-name=Susp, classifications=Mean-Environment-Device  # Suspension
      Suspc: abbr-name=Suspc, classifications=Condition-Qualifier  # Suspicion
      Suv: abbr-name=Suv, classifications=Mean-Environment-Device  # SUV | Sport Utility Vehicle
      Sw: abbr-name=Sw, classifications=Mean-Environment-Device  # Software
      Swil: abbr-name=Swil, classifications=Condition-Qualifier  # Switchable
      Swirl: abbr-name=Swirl, classifications=Mean-Environment-Device
      Switzerland: abbr-name=Switzerland, classifications=Condition-Qualifier
      Swt: abbr-name=Swt, classifications=Mean-Environment-Device  # Switch
      Sym: abbr-name=Sym, classifications=Condition-Qualifier  # Symptom
      Symc: abbr-name=Symc, classifications=Condition-Qualifier  # Symmetrical
      Symtry: abbr-name=Symtry, classifications=Condition-Qualifier  # Symmetry
      Sync: abbr-name=Sync, classifications=Action-PhysicalType  # Synchronize
      Syncd: abbr-name=Syncd, classifications=Condition-Qualifier  # Synchronized
      Syncn: abbr-name=Syncn, classifications=Condition-Qualifier  # Synchronization
      Sys: abbr-name=Sys, classifications=Mean-Environment-Device  # System
      T: abbr-name=T, classifications=Action-PhysicalType  # Temperature
      Taiwan: abbr-name=Taiwan, classifications=Condition-Qualifier
      Tank: abbr-name=Tank, classifications=Mean-Environment-Device
      Tar: abbr-name=Tar, classifications=Condition-Qualifier  # Target
      Tau: abbr-name=Tau, classifications=Condition-Qualifier  # Time constant of a control system (P, I, D).
      Tbl: abbr-name=Tbl, classifications=Condition-Qualifier  # Table
      Tcs: abbr-name=Tcs, classifications=Mean-Environment-Device  # TCS | Traction Control System
      Tdc: abbr-name=Tdc, classifications=Condition-Qualifier  # TDC | Top Dead Center
      Telgrm: abbr-name=Telgrm, classifications=Mean-Environment-Device  # Telegram
      Telltl: abbr-name=Telltl, classifications=Mean-Environment-Device  # Telltale
      Telm: abbr-name=Telm, classifications=Mean-Environment-Device  # Telematics
      Tensnr: abbr-name=Tensnr, classifications=Mean-Environment-Device  # Tensioner
      Term: abbr-name=Term, classifications=Condition-Qualifier
      Terminal: abbr-name=Terminal, classifications=Mean-Environment-Device
      Test: abbr-name=Test, classifications=Condition-Qualifier
      Tgtnss: abbr-name=Tgtnss, classifications=Action-PhysicalType  # Tightness
      Th: abbr-name=Th, classifications=Mean-Environment-Device  # Thermostat
      Thailand: abbr-name=Thailand, classifications=Condition-Qualifier
      Thd: abbr-name=Thd, classifications=Condition-Qualifier  # Threshold
      Theo: abbr-name=Theo, classifications=Condition-Qualifier  # Theoretical
      Therm: abbr-name=Therm, classifications=Condition-Qualifier  # Thermal
      Thermo: abbr-name=Thermo, classifications=Condition-Qualifier
      Thorax: abbr-name=Thorax, classifications=Mean-Environment-Device  # thorax of human body
      Thr: abbr-name=Thr, classifications=Mean-Environment-Device  # Throttle
      Thrd: abbr-name=Thrd, classifications=Condition-Qualifier  # Third
      Ti: abbr-name=Ti, classifications=Action-PhysicalType  # Time | Time, duration
      Tilt: abbr-name=Tilt, classifications=Action-PhysicalType
      Tintg: abbr-name=Tintg, classifications=Condition-Qualifier  # Tinting | Action of changing the color of an object
      Tip: abbr-name=Tip, classifications=Condition-Qualifier
      Tire: abbr-name=Tire, classifications=Mean-Environment-Device
      Tit: abbr-name=Tit, classifications=Mean-Environment-Device  # Titanium
      Tmp: abbr-name=Tmp, classifications=Condition-Qualifier  # Temporary
      Tmr: abbr-name=Tmr, classifications=Condition-Qualifier  # Timer | this keyword is used to express a timer. A timer is counter for a defined time span.
      Tn: abbr-name=Tn, classifications=Condition-Qualifier  # time constant for discrete control structures. This keyword is used in control engineering context as time constant for discrete control structures
      To: abbr-name=To, classifications=Preposition  # toward something,.....
      Tog: abbr-name=Tog, classifications=Condition-Qualifier  # Toggle
      Tolr: abbr-name=Tolr, classifications=Action-PhysicalType  # Tolerance
      Tooth: abbr-name=Tooth, classifications=Condition-Qualifier
      Top: abbr-name=Top, classifications=Mean-Environment-Device
      Tors: abbr-name=Tors, classifications=Condition-Qualifier  # Torsion
      Tot: abbr-name=Tot, classifications=Condition-Qualifier  # Total
      Touchd: abbr-name=Touchd, classifications=Condition-Qualifier  # Touched
      Tout: abbr-name=Tout, classifications=Condition-Qualifier  # time out
      Tow: abbr-name=Tow, classifications=Action-PhysicalType
      Tp: abbr-name=Tp, classifications=Mean-Environment-Device  # TP | Transport Protocol
      Tq: abbr-name=Tq, classifications=Action-PhysicalType  # Torque
      Tr: abbr-name=Tr, classifications=Mean-Environment-Device  # Trunk
      Tra: abbr-name=Tra, classifications=Condition-Qualifier  # Transient
      Trac: abbr-name=Trac, classifications=Action-PhysicalType  # Traction
      Tran: abbr-name=Tran, classifications=Condition-Qualifier  # Transition
      Transpt: abbr-name=Transpt, classifications=Condition-Qualifier  # Transport | e.g. to indicate a specific car/ecu mode (transport mode)
      Trap: abbr-name=Trap, classifications=Action-PhysicalType
      Trapg: abbr-name=Trapg, classifications=Condition-Qualifier  # Trapping | In case of scavenging the total fresh gas flowing into the cylinder is bigger than the mass air flow staying in the cylinder. The ratio of the mass air flow in the cylinder to the total mass air flow is called trapping efficiency
      Trb: abbr-name=Trb, classifications=Mean-Environment-Device  # Turbine | To describe a turbine (turbine wheel) in general, e.g. in a hydraulic torque converter or in a turbocharger
      Trbl: abbr-name=Trbl, classifications=Condition-Qualifier  # Turbulence | Flow regime characterized by chaotic stochastic property changes
      Trbo: abbr-name=Trbo, classifications=Mean-Environment-Device  # Turbo
      Trcv: abbr-name=Trcv, classifications=Mean-Environment-Device  # Transceiver
      Treat: abbr-name=Treat, classifications=Condition-Qualifier  # Treatment
      Trf: abbr-name=Trf, classifications=Condition-Qualifier  # Transfer
      Trig: abbr-name=Trig, classifications=Condition-Qualifier  # Trigger
      Trip: abbr-name=Trip, classifications=Condition-Qualifier
      Trlr: abbr-name=Trlr, classifications=Mean-Environment-Device  # Trailer | a wheeled but not motorized vehicle which can be pulled by a motorized vehicle
      Tro: abbr-name=Tro, classifications=Condition-Qualifier  # Trouble
      Trsm: abbr-name=Trsm, classifications=Mean-Environment-Device  # Transmission | In a mechanical context
      Truck: abbr-name=Truck, classifications=Mean-Environment-Device
      Trv: abbr-name=Trv, classifications=Condition-Qualifier  # Transversal | transversal in opposite to longitudinal. e.g. used for acceleration
      Trvl: abbr-name=Trvl, classifications=Action-PhysicalType  # Travel
      Trvld: abbr-name=Trvld, classifications=Condition-Qualifier  # Travelled
      Tube: abbr-name=Tube, classifications=Condition-Qualifier  # the keyword TUBE expresses any kind of a pipe, for instance the exhaust .
      Tumb: abbr-name=Tumb, classifications=Condition-Qualifier  # Tumble
      Tun: abbr-name=Tun, classifications=Condition-Qualifier  # Tuning
      Turn: abbr-name=Turn, classifications=Action-PhysicalType
      Twli: abbr-name=Twli, classifications=Mean-Environment-Device  # Twilight
      Tx: abbr-name=Tx, classifications=Action-PhysicalType  # Transmit | In a communication protocol context
      Txt: abbr-name=Txt, classifications=Condition-Qualifier  # Text
      Typ: abbr-name=Typ, classifications=Condition-Qualifier  # Type
      U: abbr-name=U, classifications=Action-PhysicalType  # Voltage
      Udp: abbr-name=Udp, classifications=Mean-Environment-Device  # UDP | User Datagram Protocol
      Uds: abbr-name=Uds, classifications=Mean-Environment-Device  # UDS | Unified Diagnostic Services. Unified Diagnostic Services is a standard for Diagnostics according to ISO14229-1
      Uego: abbr-name=Uego, classifications=Mean-Environment-Device  # UEGO | Universal Exhaust Gas Oxygen Sensor
      Ukwn: abbr-name=Ukwn, classifications=Condition-Qualifier  # Unknown
      Undefd: abbr-name=Undefd, classifications=Condition-Qualifier  # Undefined
      Under: abbr-name=Under, classifications=Condition-Qualifier
      Unfav: abbr-name=Unfav, classifications=Condition-Qualifier  # Unfavourable
      Unique: abbr-name=Unique, classifications=Condition-Qualifier
      Unit: abbr-name=Unit, classifications=Condition-Qualifier
      Unlck: abbr-name=Unlck, classifications=Action-PhysicalType  # Unlock
      Unlckd: abbr-name=Unlckd, classifications=Condition-Qualifier  # Unlocked
      Unlimd: abbr-name=Unlim, classifications=Condition-Qualifier  # Unlimited
      Up: abbr-name=Up, classifications=Action-PhysicalType
      Upd: abbr-name=Upd, classifications=Action-PhysicalType  # Update
      Uppr: abbr-name=Uppr, classifications=Condition-Qualifier  # Upper
      Upw: abbr-name=Upw, classifications=Condition-Qualifier  # Upward
      Urb: abbr-name=Urb, classifications=Condition-Qualifier  # Urban
      Urea: abbr-name=Urea, classifications=Mean-Environment-Device
      Urg: abbr-name=Urg, classifications=Condition-Qualifier  # Urgent | e.g. like in urgent or urgency signal
      Us: abbr-name=Us, classifications=Condition-Qualifier  # Up-stream | up-stream or up stream or upstream
      Usa: abbr-name=Usa, classifications=Condition-Qualifier  # USA | United States of America
      Use: abbr-name=Use, classifications=Action-PhysicalType
      Used: abbr-name=Used, classifications=Condition-Qualifier
      Usg: abbr-name=Usg, classifications=Condition-Qualifier  # Usage
      Usr: abbr-name=Usr, classifications=Mean-Environment-Device  # User
      V: abbr-name=V, classifications=Action-PhysicalType  # Velocity | Translatory speed, also referred to as speed of translation or translational speed. Value at this instant of time, no direction, measured in m/s, km/h or equivalents. Examples: VehV = Vehicle speed [km/h], WhlV = Wheel speed [km/h]
      Vac: abbr-name=Vac, classifications=Condition-Qualifier  # Vacuum
      Val: abbr-name=Val, classifications=Condition-Qualifier  # Value
      Van: abbr-name=Van, classifications=Mean-Environment-Device
      Vanity: abbr-name=Vanity, classifications=Mean-Environment-Device
      Vap: abbr-name=Vap, classifications=Condition-Qualifier  # Vapor
      Vari: abbr-name=Vari, classifications=Action-PhysicalType  # Variance
      Vcc: abbr-name=Vcc, classifications=Action-PhysicalType  # supply voltage
      Vcos: abbr-name=Vcos, classifications=Action-PhysicalType  # Viscosity | Viscosity describes the thickness of a fluid, e.g. in a damper: it is composed of a spring (stiffness part: force proportional to displacement) and a fluid friction (viscous part: force proportional to speed)
      Vcv: abbr-name=Vcv, classifications=Mean-Environment-Device  # VCV | Volume Control Valve, e.g. used in "high pressure pump volume control valve".
      Vect: abbr-name=Vect, classifications=Condition-Qualifier  # Vector
      Veh: abbr-name=Veh, classifications=Mean-Environment-Device  # Vehicle
      Vent: abbr-name=Vent, classifications=Mean-Environment-Device
      Ventn: abbr-name=Ventn, classifications=Action-PhysicalType  # Ventilation
      Vers: abbr-name=Vers, classifications=Condition-Qualifier  # Version
      Vert: abbr-name=Vert, classifications=Condition-Qualifier  # Vertical
      Vietnam: abbr-name=Vietnam, classifications=Condition-Qualifier
      Vin: abbr-name=Vin, classifications=Mean-Environment-Device  # VIN | Vehicle Identification Number. This keyword is used to describe the vehicle identification number. This is certain code which is unique for every vehicle and is used for its identification.
      Virt: abbr-name=Virt, classifications=Condition-Qualifier  # Virtual
      Vis: abbr-name=Vis, classifications=Condition-Qualifier  # Visual
      Visy: abbr-name=Visy, classifications=Condition-Qualifier  # Visibility
      Vlc: abbr-name=Vlc, classifications=Mean-Environment-Device  # VLC | Vehicle Longitudinal Control
      Vld: abbr-name=Vld, classifications=Condition-Qualifier  # Valid
      Vldt: abbr-name=Vldt, classifications=Action-PhysicalType  # Validate
      Vlv: abbr-name=Vlv, classifications=Condition-Qualifier  # Valve
      Vol: abbr-name=Vol, classifications=Action-PhysicalType  # Volume
      Volmc: abbr-name=Volmc, classifications=Condition-Qualifier  # Volumetric
      Volt: abbr-name=Volt, classifications=Mean-Environment-Device  # As unit of measure for voltage
      Vrnt: abbr-name=Vrnt, classifications=Condition-Qualifier  # Variant
      Vvt: abbr-name=Vvt, classifications=Mean-Environment-Device  # VVT | Variable Valve Timing
      W: abbr-name=W, classifications=Action-PhysicalType  # Work | Energy
      Wait: abbr-name=Wait, classifications=Action-PhysicalType
      Wall: abbr-name=Wall, classifications=Mean-Environment-Device
      Warn: abbr-name=Warn, classifications=Condition-Qualifier  # Warning
      Watt: abbr-name=Watt, classifications=Mean-Environment-Device  # As unit of measure for power
      Way: abbr-name=Way, classifications=Condition-Qualifier
      Wdg: abbr-name=Wdg, classifications=Mean-Environment-Device  # Watchdog
      Wear: abbr-name=Wear, classifications=Condition-Qualifier
      Wedge: abbr-name=Wedge, classifications=Mean-Environment-Device
      Wght: abbr-name=Wght, classifications=Mean-Environment-Device  # Weight
      Whl: abbr-name=Whl, classifications=Mean-Environment-Device  # Wheel
      Whls: abbr-name=Whls, classifications=Mean-Environment-Device  # Wheels
      Wide: abbr-name=Wide, classifications=Condition-Qualifier  # keyword is used to specify gear box type, which is distinguished via variant coding (wide ratio: long transmission ratio for lower rpm. closed ratio: sports transmission ratio)
      Width: abbr-name=Width, classifications=Condition-Qualifier  # Used in the sense of width or breadth, e.g. wheel width or wheel breadth
      Win: abbr-name=Win, classifications=Mean-Environment-Device  # Window
      Wind: abbr-name=Wind, classifications=Mean-Environment-Device  # Windscreen
      Wind1: abbr-name=Wind, classifications=Mean-Environment-Device  # wind in the sense of breeze
      Wipg: abbr-name=Wipg, classifications=Action-PhysicalType  # Wiping
      Wipr: abbr-name=Wipr, classifications=Mean-Environment-Device  # Wiper
      Wire: abbr-name=Wire, classifications=Mean-Environment-Device  # Electrical connection media
      Wirels: abbr-name=Wirels, classifications=Condition-Qualifier  # Wireless | Used for Wireless connection
      Wish: abbr-name=Wish, classifications=Action-PhysicalType
      Wishd: abbr-name=Wishd, classifications=Condition-Qualifier  # Wished
      With: abbr-name=With, classifications=Preposition  # preposition
      Within: abbr-name=Within, classifications=Preposition  # preposition
      Wntr: abbr-name=Wntr, classifications=Condition-Qualifier  # Winter
      Wo: abbr-name=Wo, classifications=Preposition  # Without | preposition
      Word: abbr-name=Word, classifications=Condition-Qualifier
      World: abbr-name=World, classifications=Condition-Qualifier
      Wr: abbr-name=Wr, classifications=Action-PhysicalType  # Write
      Wrg: abbr-name=Wrg, classifications=Condition-Qualifier  # Wrong | is used to express a mismatch which does not have to be treated by error management diagnosis
      Wrm: abbr-name=Wrm, classifications=Condition-Qualifier  # Warm
      Wrpr: abbr-name=Wrpr, classifications=Mean-Environment-Device  # Wrapper
      Wrst: abbr-name=Wrst, classifications=Condition-Qualifier  # Worst
      Wshng: abbr-name=Wshng, classifications=Action-PhysicalType  # Washing
      Wshr: abbr-name=Wshr, classifications=Mean-Environment-Device  # Washer
      Wthr: abbr-name=Wthr, classifications=Condition-Qualifier  # Weather
      Wtr: abbr-name=Wtr, classifications=Mean-Environment-Device  # Water
      Xcp: abbr-name=Xcp, classifications=Mean-Environment-Device  # XCP | Universal Measurement and Calibration Protocol XCP / extended universal calibration protocol (ASAM standard)
      Xpos: abbr-name=Xpos, classifications=Action-PhysicalType  # Xposition | X position
      Yaw: abbr-name=Yaw, classifications=Action-PhysicalType
      Yes: abbr-name=Yes, classifications=Condition-Qualifier
      Ypos: abbr-name=Ypos, classifications=Action-PhysicalType  # Yposition | Y position
      Yr: abbr-name=Yr, classifications=Mean-Environment-Device  # Year
