AUTOSAR XML (schema 00050)
package /AUTOSAR/AISpecification/DataConstrs_Blueprint
  range A1: phys -18..18 MtrPerSecSqd
  range A10: phys -20.48..20.48 MtrPerSecSqd
  range A11: phys -99..99 MtrPerSecSqd
  range A12: phys -981..981 MtrPerSecSqd
  range A13: phys -1962..1962 MtrPerSecSqd
  range A14: phys -7848..7848 MtrPerSecSqd
  range A2: phys -30..30 MtrPerSecSqd
  range A3: phys -8.5..8.5 MtrPerSecSqd
  range A4: phys -18..18 MtrPerSecSqd
  range A5: phys -200..200 MtrPerSecSqd
  range A7: phys 0..2.55 MtrPerSecSqd
  range A8: phys -1178..1178 MtrPerSecSqd
  range A9: phys -4710..4710 MtrPerSecSqd
  range AckSt1: raw 0..1
  range AckSts1: raw 0..1
  range Ag1: phys -0.5..0.5 Rad
  range Ag2: phys -1.5..1.5 Rad
  range Ag3: phys -1.571..1.571 Rad
  range Ag4: phys -14.5..14.5 Rad
  range Ag5: phys -870..870 Rad
  range Ag6: phys -1.57079632679489..1.57079632679489 Rad
  range AgA1: phys -1000..1000 RadPerSecSqd
  range AgA2: phys -75..75 RadPerSecSqd
  range AgSpd1: phys -50..50 RadPerSec
  range AgSpd2: phys -5..5 RadPerSec
  range AgSpd3: phys -5..5 RadPerSec
  range AgSpd4: phys -10..10 RadPerSec
  range AgSpd5: phys -628..628 RadPerSec
  range AgSpd6: phys 0..500 RadPerSec
  range AgSpd7: phys -1..1 RadPerSec
  range AgSpd8: phys -8..8 RadPerSec
  range AlrmSt1: raw 0..3
  range AlrmSts1: raw 0..3
  range ArmingTyp2: raw 0..3
  range ArmingTyp3: raw 0..1
  range AvlSt1: raw 0..3
  range AvlSts1: raw 0..3
  range AxisTyp1: raw 0..2
  range BltLockSt1: raw 0..1
  range BltLockSt2: raw 0..2
  range BodyLvlCtrl1: raw 0..2
  range BodyLvlMod1: raw 0..2
  range BrkActrMod1: raw 0..4
  range BrkActrSatn1: raw 0..1
  range BrkMod1: raw 0..1
  range BrkReqTyp1: raw 0..2
  range BrkReqTyp2: raw 0..2
  range BucdSt1: raw 0..3
  range CalSt1: raw 0..3
  range CalSts1: raw 0..3
  range ChdProtnCmd1: raw 0..2
  range ChgInfo1: raw 0..1
  range CluSt1: raw 0..3
  range CornrMkr1: raw 0..2
  range CptInfo1: raw 0..2
  range CrashSt1: raw 0..2
  range CrashSts1: raw 0..2
  range CrsCtrlAndAccSwtSt1: raw 0..2
  range CrsCtrlAndAccSwtSts1: raw 0..2
  range Crvt1: phys -0.1..0.1 PerMtr
  range CtrlSt1: raw 0..1
  range CtrlSts1: raw 0..1
  range DamprCoeff1: phys -10000..10000 NwtSecPerMtr
  range Day1: phys 1..31
  range DetnSt1: raw 0..1
  range DetnSts1: raw 0..1
  range DevErrSt1: raw 0..2
  range DevErrSt2: raw 0..1
  range DevErrSt3: raw 0..1
  range DevErrSt4: raw 0..2
  range DevErrSts1: raw 0..2
  range DevErrSts2: raw 0..1
  range DevErrSts3: raw 0..1
  range DevErrSts4: raw 0..2
  range DevSt4: raw 0..2
  range DevSt5: raw 0..2
  range DevSt6: raw 0..3
  range DevSt7: raw 0..4
  range DevSts4: raw 0..2
  range DevSts5: raw 0..2
  range DevSts6: raw 0..3
  range DevSts7: raw 0..4
  range DoorHndlSt1: raw 0..2
  range DoorHndlSts1: raw 0..2
  range DoorSt1: raw 0..4
  range DoorSts1: raw 0..4
  range DynPpty1: raw 0..5
  range EgyMngtSt1: raw 0..10
  range EgyMngtSts1: raw 0..10
  range EnagSt1: raw 0..1
  range EngRunngDir1: raw 0..3  # Engine Running Direction
  range EngStrtRemReq1: raw 0..1
  range EntryEasy1: raw 0..4
  range EpbBtnCtrlSt1: raw 0..4
  range EpbBtnCtrlSts1: raw 0..4
  range F1: phys -2500..2500 Nwt
  range F2: phys -20000..20000 Nwt
  range F3: phys -150000..150000 Nwt
  range Fac1: phys -32..31.9990234375
  range Fac3: phys 0.7..1.2
  range Fac4: phys 0..1
  range Fac5: phys 0..127.9921875
  range Fac7: phys 0..1
  range Fixa1: raw 0..1
  range Flg1: raw 0..1
  range FricCoeff1: phys 0..2
  range Frq1: phys 0..100 Hz
  range Frq2: phys 0.5..20 KiloHz
  range GearShiftPrevn1: raw 0..3
  range GearSt1: raw -2..27
  range HldOnDmdSt1: raw 0..2
  range HomeCmngAndHomeLvngReq1: raw 0..2
  range Hr1: phys 0..23
  range ImobSt1: raw 0..6
  range ImobSts1: raw 0..6
  range ImobnWirelsReq1: raw 0..3
  range ImpctSt1: raw 0..1
  range ImpctSts1: raw 0..1
  range InOut1: raw 0..1
  range IndcrForStop1: raw 0..2
  range IndcrSt1: raw 0..3
  range IndcrSts1: raw 0..3
  range IndcrTypExt1: raw 0..4
  range IntrLiReq1: raw 0..4
  range InvldVld1: raw 0..1
  range InvldVld2: raw 0..1
  range Jerk1: phys -30..30 MtrPerSecCubd
  range KeyCmd1: raw 0..2
  range KeyInsertSt1: raw 0..1
  range KeyInsertSts1: raw 0..1
  range KeySt1: raw 0..4
  range KeySts1: raw 0..4
  range LeRi1: raw 0..1
  range Len1: phys -0.2..0.2 Mtr
  range Len10: phys -125..125 Mtr
  range Len11: phys 0..40.96 Mtr
  range Len14: phys 0..6 Mtr
  range Len3: phys -0.3..0.3 Mtr
  range Len4: phys -0.3..0.3 Mtr
  range Len5: phys 0..4 Mtr
  range Len6: phys 0..1000000 KiloMtr
  range Len7: phys -500..500 Mtr
  range LiOnWarn1: raw 0..2
  range LockActvn1: raw 0..3
  range LockSt1: raw 0..4
  range LockSt2: raw 0..4
  range LockStOfSteerCol1: raw 0..3
  range LockSts1: raw 0..4
  range LockSts2: raw 0..4
  range LockStsOfSteerCol1: raw 0..3
  range LockTrigSrc1: raw 0..11
  range LockUnlckReq1: raw 0..2
  range LockgCenReq1: raw 0..6
  range LockgCenReqSrc1: raw 0..10
  range M1: phys 0..10000 KiloGr
  range M2: phys 0..250 KiloGr
  range MemBtn1: raw 0..5
  range Mins1: phys 0..59
  range MirrTyp1: raw 0..3
  range MoveSt1: raw 0..2
  range MoveSts1: raw 0..2
  range MovmtTyp1: raw 0..2
  range Mth1: phys 1..12
  range N1: phys 0..16383.5 Rpm
  range N2: phys -16384..16383.5 Rpm
  range NGrdt1: phys -30000..30000 RpmPerSec
  range Nr1: phys -16..15
  range Nr10: phys 0..512
  range Nr2: phys 0..255
  range Nr3: phys 0..65535
  range Nr4: phys -128..127
  range Nr5: phys 0..7
  range Nr6: phys 0..31
  range Nr7: phys 0..3
  range Nr8: phys 0..4294967295
  range Nr9: phys -8..7
  range ObjClassn1: raw 0..4
  range ObstclDstInPrkgSegSt1: raw 0..2
  range ObstclDstInPrkgSegSts1: raw 0..2
  range OccptClass1: raw 0..5
  range OccptOutOfPos1: raw 0..2
  range OccptPresSt1: raw 0..1
  range OnOff1: raw 0..1
  range OnOff2: raw 0..1
  range OpendClsd1: raw 0..1
  range Oper1: raw 0..2
  range OperModSt1: raw 0..15
  range OperModSts1: raw 0..15
  range OutdBriSt1: raw 0..7
  range OutdBriSts1: raw 0..7
  range OvrdnSt1: raw 0..1
  range OvrdnSts1: raw 0..1
  range P1: phys 0..10 Bar
  range P4: phys 0..1275 HectoPa
  range P5: phys -536870912..536854528 Pa
  range P6: phys -1048576..1048544 Pa
  range P7: phys -536870912..536854528 Pa
  range Perc1: phys 0..100 Perc
  range Perc10: phys -327.68..327.67 Perc
  range Perc11: phys -327.68..327.67 Perc
  range Perc2: phys 0..100 Perc
  range Perc6: phys -128..127 Perc
  range Perc7: phys 0..1001 Perc
  range Perc8: phys -5..15 Perc
  range Perc9: phys 0..100.1 Perc
  range PercGrdt1: phys -1000..1000 PercPerSec
  range PitchovrMod1: raw 0..2
  range PrkgLiIndcn1: raw 0..3
  range ProfPenSt1: raw 0..15
  range ProfPenSts1: raw 0..15
  range PsdNotPsd1: raw 0..1
  range PtIntvModTqCluFastReqTyp1: raw 0..6  # Powertrain Torque Clutch Fast Intervention Mode Type 1
  range PtTqCluMaxFastIntvModTyp1: phys 0..3
  range PullAidCmd1: raw 0..2
  range RainSenSnvty1: raw 0..7
  range Ramp1: raw 0..7
  range ReqSt1: raw 0..1
  range ReqSt2: raw 0..1
  range ReqSts1: raw 0..1
  range ReqSts2: raw 0..1
  range RngUnlimd: phys -INF..+INF  # Range Unlimited
  range RoadSt1: raw 0..1
  range RoadSts1: raw 0..1
  range RollovrMod1: raw 0..2
  range SeatBltRmnWarnSt1: raw 0..4
  range Sec1: phys 0..59
  range Spd1: phys 0..125 MtrPerSec
  range Spd2: phys -50..50 MtrPerSec
  range Spd3: phys 0..125 MtrPerSec
  range Spd4: phys 0..125 MtrPerSec
  range Spd5: phys -128..128 MtrPerSec
  range Spd6: phys -30..30 MtrPerSec
  range SprgCoeff1: phys -150000..150000 NwtPerMtr
  range StOfObjMeasd1: raw 0..3
  range StabrSt1: raw 0..4
  range StabrSts1: raw 0..4
  range SteerMod1: raw 0..4
  range SteerVehStabyCtrlMod1: raw 0..1
  range StgOfSeatClima1: raw 0..6
  range StsOfObjMeasd1: raw 0..3
  range SuspMod1: raw 0..3
  range T1: phys -70..125 DegCgrd
  range T3: phys -50..200 DegCgrd
  range T4: phys -40..213 DegCgrd
  range T5: phys -3276.8..3276.7 KelvinAbslt
  range T6: phys -3276.8..3276.7 KelvinAbslt
  range T7: phys -70..213 DegCgrd
  range TSt1: raw 0..1
  range TSts1: raw 0..1
  range TerminalPosnMod1: raw 0..3
  range Ti2: phys 0..3.1 Sec
  range Ti3: phys 0..65.535 Sec
  range Ti4: phys 0..0.01638375 Sec
  range TirePMonWarnSt1: raw 0..1
  range TirePMonWarnSt2: raw 0..5
  range TirePMonWarnSt3: raw 0..2
  range TirePMonWarnSts1: raw 0..1
  range TirePMonWarnSts2: raw 0..5
  range TirePMonWarnSts3: raw 0..2
  range Tq1: phys -30..30 NwtMtr
  range Tq10: phys 0..20000 NwtMtr
  range Tq12: phys 0..60000 NwtMtr
  range Tq13: phys -10000..10000 NwtMtr
  range Tq14: phys 0..10000 NwtMtr
  range Tq15: phys -10..10 NwtMtr
  range Tq16: phys -2048..2045 NwtMtr
  range Tq2: phys -20000..20000 NwtMtr
  range Tq3: phys 0..20000 NwtMtr
  range Tq4: phys 0..80000 NwtMtr
  range Tq5: phys -2048..2047.9375 NwtMtr
  range Tq6: phys -2048..0 NwtMtr
  range Tq7: phys -131072..131071.9375 NwtMtr
  range TqGrdt1: phys 0..1000000 NwtMtrPerSec
  range TrsmIntvModReqForTqCluReqForShiftIntvTyp1: raw 0..6  # Transmission Torque Clutch Request for Fast Intervention Mode Type 1
  range TrsmPosnGearLvr1: raw 0..7
  range TrsmPwrSt1: raw 0..6
  range TrsmPwrStCtrl1: raw 0..8  # Control State of Power Transmission
  range TrsmTqReqMaxMinTyp1: phys 0..1
  range TrsmTqReqTyp1: raw 0..7
  range TrsmTqReqTyp2: raw 0..4
  range TrsmTyp1: raw 0..4
  range U1: phys 0..25.2 Volt
  range UsrReqForWipg1: raw 0..4
  range VehHldSt1: raw 0..2
  range VehMod1: raw 0..2
  range VehMtnSt1: raw 0..3
  range WhlRotlDirMeasd1: raw 0..3
  range WhlRotlDirStd1: raw 0..3
  range Wipg1: raw 0..17
  range WipgSpdIntl1: raw 0..7
  range WiprPosnMeasd1: raw 0..5
  range WiprPosnReqd1: raw 0..4
  range WshrFldLvlLo1: raw 0..2
  range Yr1: phys 0..99
