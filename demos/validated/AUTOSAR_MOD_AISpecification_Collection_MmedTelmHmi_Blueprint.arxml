AUTOSAR XML (schema 00050)
package /AUTOSAR/AISpecification/Collections_Blueprint
  collection MmedTelmHmi:
    category=SET
    auto-collect=REF-NONE
    element-role=PART_OF_SUBSET
    element=[AccActv, AccCtrlActv, AccCtrlActv1, AccVehDetd1, AccVehDetdIndcn, AcsOfSeatReByDrvrSeat, AcsOfSeatReByPassSeat, AcsOfSeatReBySeatRowFirstMid, AcsOfSeatReBySeatRowSecLe, AcsOfSeatReBySeatRowSecMid, AcsOfSeatReBySeatRowSecRi, AcsOfSeatReBySeatRowThrdLe, AcsOfSeatReBySeatRowThrdMid, AcsOfSeatReBySeatRowThrdRi, ActrBodyLvlSt, ActrBodyLvlSt1, ActvSuspSt, ActvSuspSt1, ActvtWipgAutFromHmi, ActvtWipgAutReq1, BackliteWinHmi, BodyLvlCtrl, BodyLvlCtrl1, BodyLvlMod, BodyLvlMod1, BriReq1, BtnMplSt256, BtnMplSt256, BtnMplSt4, BtnMplSt4, BtnMplSt8, BtnMplSt8, BtnSimple, BtnSimple1, CrsCtrlActv, CrsCtrlActv1, CrsCtrlAndAccSetTiGapDec, CrsCtrlAndAccSetTiGapInc, CrsCtrlAndAccSwtStEngd, CrsCtrlAndAccSwtStEngd1, CrsCtrlCtrlActv, CrsCtrlCtrlActv1, DamprSt, DamprSt1, DispBltLockAck, DispBltLockAck1, DispBltLockReq, DispBltLockReq1, DispBltLockSt1, DispBltLockStOfDrvr, DispBltLockStOfPass, DispBltLockStOfRowFirstMid, DispBltLockStOfRowSecLe, DispBltLockStOfRowSecMid, DispBltLockStOfRowSecRi, DispBltLockStOfRowThrdLe, DispBltLockStOfRowThrdMid, DispBltLockStOfRowThrdRi, DispBucdStOfDrvr, DispBucdStOfOccpt1, DispBucdStOfOccptAtRowFirstMid, DispBucdStOfOccptAtRowSecLe, DispBucdStOfOccptAtRowSecMid, DispBucdStOfOccptAtRowSecRi, DispBucdStOfOccptAtRowThrdLe, DispBucdStOfOccptAtRowThrdMid, DispBucdStOfOccptAtRowThrdRi, DispBucdStOfPass, DispRainSnsr1, DispRainSnsrActv, DshbBri, EmgyLockg, EntryReq1, GlvBoxHmi, HdlampWshngFromHmi, HtlModSt, HtlModSt1, KnobRotyBndlsStep15, KnobRotyBndlsStep15, KnobRotyBndlsStep7, KnobRotyBndlsStep7, LidReFromHmiExt, LidReFromHmiInt, LockUnlckReq1, LtchRelsReq1, MassgAdjOfDrvrSeat, MassgAdjOfPassSeat, MassgAdjOfSeatRowFirstMid, MassgAdjOfSeatRowSecLe, MassgAdjOfSeatRowSecMid, MassgAdjOfSeatRowSecRi, MassgAdjOfSeatRowThrdLe, MassgAdjOfSeatRowThrdMid, MassgAdjOfSeatRowThrdRi, MassgAdjReq1, MassgAdjSt1, MassgStOfDrvrSeat, MassgStOfPassSeat, MassgStOfSeatRowFirstMid, MassgStOfSeatRowSecLe, MassgStOfSeatRowSecMid, MassgStOfSeatRowSecRi, MassgStOfSeatRowThrdLe, MassgStOfSeatRowThrdMid, MassgStOfSeatRowThrdRi, MirrAdjAutToRestoreProf0FromHmi, MirrAdjAutToRestoreProf1FromHmi, MirrAdjAutToRestoreProf2FromHmi, MirrAdjAutToRestoreProf3FromHmi, MirrAdjAutToStoreProf0FromHmi, MirrAdjAutToStoreProf1FromHmi, MirrAdjAutToStoreProf2FromHmi, MirrAdjAutToStoreProf3FromHmi, MirrMovmtManFromHmi, MirrPanAdjAutReq1, MonrPReqForTirePMon, MonrPReqForTirePMon1, MonrPTarReqForTirePMon, MonrPTarReqForTirePMon1, NightPanActv, NightPanReq1, OutpMplSt256, OutpMplSt256, OutpMplSt4, OutpMplSt4, OutpMplSt8, OutpMplSt8, PanAdjAutOfDrvrSeat, PanAdjAutOfPassSeat, PanAdjAutOfSeatRowFirstMid, PanAdjAutOfSeatRowSecLe, PanAdjAutOfSeatRowSecMid, PanAdjAutOfSeatRowSecRi, PanAdjAutOfSeatRowThrdLe, PanAdjAutOfSeatRowThrdMid, PanAdjAutOfSeatRowThrdRi, PanAdjManOfDrvrSeat, PanAdjManOfPassSeat, PanAdjManOfSeatRowFirstMid, PanAdjManOfSeatRowSecLe, PanAdjManOfSeatRowSecMid, PanAdjManOfSeatRowSecRi, PanAdjManOfSeatRowThrdLe, PanAdjManOfSeatRowThrdMid, PanAdjManOfSeatRowThrdRi, PanAdjmtManReq1, SeatAdjAut1, SeatAdjMan1, SeatBltRmnAcoustWarnReq, SeatBltRmnAcoustWarnReq1, SeatBltRmnFrqCtrlAcoustWarn, SeatBltRmnFrqCtrlAcoustWarn1, SeatBltRmnLdnCtrlAcoustWarn, SeatBltRmnLdnCtrlAcoustWarn1, SeatBltRmnOpticWarnReq, SeatBltRmnOpticWarnReq1, SetSpdDec, SetSpdDec1, SetSpdInc, SetSpdInc1, SetSpdIndcn, SetSpdIndcn1, SprgCtrlTunActvReq, SprgCtrlTunActvReq1, StabrSt, StabrSt1, SteerAgSuppsnBascSt, SteerSt1, SteerTqSuppsnBascSt, SwilSprgSt, SwilSprgSt1, TankFlapHmi, TiGapDec1, TiGapInc1, TintgAutReq, TintgAutReq1, TintgAutSt, TintgAutSt1, TirePMeasdPerWhl, TirePMeasdPerWhl1, TirePMonAcptOfWhlNewReq, TirePMonAcptOfWhlNewReq1, TirePMonCalStIndcnPerWhl, TirePMonCalStIndcnPerWhl1, TirePMonIndcnOfWhlNewRcnd, TirePMonIndcnOfWhlNewRcnd1, TirePMonRstAckd, TirePMonRstAckd1, TirePMonRstReq, TirePMonRstReq1, TirePMonSt, TirePMonSt1, TirePMonWarnIndcn, TirePMonWarnIndcn1, TirePMonWarnIndcnPerWhl, TirePMonWarnIndcnPerWhl1, TirePThdPerAxle, TirePThdPerAxle1, TirePThdPerAxleIndcn, TireTMeasdPerWhl, TireTMeasdPerWhl1, TogReq1, TogSt, TogSt1, VehSpdDispd, VehSpdDispd1, WhlSpdWarnIndcn, WhlSpdWarnIndcn1, WhlSteerReBascSt, WipgFrntFromHmi, WipgReFromHmi, WipgReq1, WipgSpdIntlFromHmi, WipgSpdIntlReq1, WiprPosnCmd1, WiprPosnReqFromHmi, WshngFrntFromHmi, WshngReFromHmi, WshngReq1]
  collection MmedTelmHmiRefAll:
    category=SET
    auto-collect=REF-ALL
    element-role=PART_OF_SUBSET
    element=[AccActv, AccCtrlActv, AccVehDetdIndcn, AcsOfSeatReByDrvrSeat, AcsOfSeatReByPassSeat, AcsOfSeatReBySeatRowFirstMid, AcsOfSeatReBySeatRowSecLe, AcsOfSeatReBySeatRowSecMid, AcsOfSeatReBySeatRowSecRi, AcsOfSeatReBySeatRowThrdLe, AcsOfSeatReBySeatRowThrdMid, AcsOfSeatReBySeatRowThrdRi, ActrBodyLvlSt, ActvSuspSt, ActvtWipgAutFromHmi, BackliteWinHmi, BodyLvlCtrl, BodyLvlMod, BtnMplSt256, BtnMplSt4, BtnMplSt8, BtnSimple, CrsCtrlActv, CrsCtrlAndAccSetTiGapDec, CrsCtrlAndAccSetTiGapInc, CrsCtrlAndAccSwtStEngd, CrsCtrlCtrlActv, DamprSt, DispBltLockAck, DispBltLockReq, DispBltLockStOfDrvr, DispBltLockStOfPass, DispBltLockStOfRowFirstMid, DispBltLockStOfRowSecLe, DispBltLockStOfRowSecMid, DispBltLockStOfRowSecRi, DispBltLockStOfRowThrdLe, DispBltLockStOfRowThrdMid, DispBltLockStOfRowThrdRi, DispBucdStOfDrvr, DispBucdStOfOccptAtRowFirstMid, DispBucdStOfOccptAtRowSecLe, DispBucdStOfOccptAtRowSecMid, DispBucdStOfOccptAtRowSecRi, DispBucdStOfOccptAtRowThrdLe, DispBucdStOfOccptAtRowThrdMid, DispBucdStOfOccptAtRowThrdRi, DispBucdStOfPass, DispRainSnsrActv, DshbBri, EmgyLockg, GlvBoxHmi, HdlampWshngFromHmi, HtlModSt, KnobRotyBndlsStep15, KnobRotyBndlsStep7, LidReFromHmiExt, LidReFromHmiInt, MassgAdjOfDrvrSeat, MassgAdjOfPassSeat, MassgAdjOfSeatRowFirstMid, MassgAdjOfSeatRowSecLe, MassgAdjOfSeatRowSecMid, MassgAdjOfSeatRowSecRi, MassgAdjOfSeatRowThrdLe, MassgAdjOfSeatRowThrdMid, MassgAdjOfSeatRowThrdRi, MassgStOfDrvrSeat, MassgStOfPassSeat, MassgStOfSeatRowFirstMid, MassgStOfSeatRowSecLe, MassgStOfSeatRowSecMid, MassgStOfSeatRowSecRi, MassgStOfSeatRowThrdLe, MassgStOfSeatRowThrdMid, MassgStOfSeatRowThrdRi, MirrAdjAutToRestoreProf0FromHmi, MirrAdjAutToRestoreProf1FromHmi, MirrAdjAutToRestoreProf2FromHmi, MirrAdjAutToRestoreProf3FromHmi, MirrAdjAutToStoreProf0FromHmi, MirrAdjAutToStoreProf1FromHmi, MirrAdjAutToStoreProf2FromHmi, MirrAdjAutToStoreProf3FromHmi, MirrMovmtManFromHmi, MonrPReqForTirePMon, MonrPTarReqForTirePMon, NightPanActv, OutpMplSt256, OutpMplSt4, OutpMplSt8, PanAdjAutOfDrvrSeat, PanAdjAutOfPassSeat, PanAdjAutOfSeatRowFirstMid, PanAdjAutOfSeatRowSecLe, PanAdjAutOfSeatRowSecMid, PanAdjAutOfSeatRowSecRi, PanAdjAutOfSeatRowThrdLe, PanAdjAutOfSeatRowThrdMid, PanAdjAutOfSeatRowThrdRi, PanAdjManOfDrvrSeat, PanAdjManOfPassSeat, PanAdjManOfSeatRowFirstMid, PanAdjManOfSeatRowSecLe, PanAdjManOfSeatRowSecMid, PanAdjManOfSeatRowSecRi, PanAdjManOfSeatRowThrdLe, PanAdjManOfSeatRowThrdMid, PanAdjManOfSeatRowThrdRi, SeatBltRmnAcoustWarnReq, SeatBltRmnFrqCtrlAcoustWarn, SeatBltRmnLdnCtrlAcoustWarn, SeatBltRmnOpticWarnReq, SetSpdDec, SetSpdInc, SetSpdIndcn, SprgCtrlTunActvReq, StabrSt, SteerAgSuppsnBascSt, SteerTqSuppsnBascSt, SwilSprgSt, TankFlapHmi, TintgAutReq, TintgAutSt, TirePMeasdPerWhl, TirePMonAcptOfWhlNewReq, TirePMonCalStIndcnPerWhl, TirePMonIndcnOfWhlNewRcnd, TirePMonRstAckd, TirePMonRstReq, TirePMonSt, TirePMonWarnIndcn, TirePMonWarnIndcnPerWhl, TirePThdPerAxle, TirePThdPerAxleIndcn, TireTMeasdPerWhl, TogSt, VehSpdDispd, WhlSpdWarnIndcn, WhlSteerReBascSt, WipgFrntFromHmi, WipgReFromHmi, WipgSpdIntlFromHmi, WiprPosnReqFromHmi, WshngFrntFromHmi, WshngReFromHmi]
  collection MmedTelmHmiRefAllToMmedTelmHmi: category=RELATION, element-role=AUTO_COLLECTED_FROM, element=MmedTelmHmi, source-element=MmedTelmHmiRefAll
