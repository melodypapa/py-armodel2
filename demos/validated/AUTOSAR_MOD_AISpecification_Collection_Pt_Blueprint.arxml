AUTOSAR XML (schema 00050)
package /AUTOSAR/AISpecification/Collections_Blueprint
  collection Pt:
    category=SET
    auto-collect=REF-NONE
    element-role=PART_OF_SUBSET
    element=[AbsCtrlIntvg, AbsCtrlIntvg, AbsCtrlIntvgToAbsCtrlIntvgOfPtCoorr, AcTq, AcTq, AcTq1, AcTqReq1, AcTqToAcTqOfPtCoorr, AccrPedl, AccrPedlMeasd, AccrPedlMeasd, AccrPedlMeasd, AccrPedlMeasd, AccrPedlMeasdOfAccrPedlPosnToAccrPedlMeasdOfDrvReq, AccrPedlMeasdOfVehMtnForPtToAccrPedlMeasdOfPtCoorr, AccrPedlMeasdToAccrPedlMeasdOfAccrPedlPosn, AccrPedlMeasdToAccrPedlMeasdOfVehMtnForPt, AccrPedlOfAccrPedlPosnToAccrPedlOfDrvReq, AccrPedlPosn, AltTq, AltTqOfPtMiscToAltTqOfPtCoorr, AltTqReq, AltTqReqOfPtMiscToAltTqReqOfPtCoorr, BattU, BattU, BattUToBattUOfCmbEng, BattUToBattUOfCmbEngMisc, BrkActrVehSpdMax, BrkActrVehSpdMax, BrkActrVehSpdMaxToBrkActrVehSpdMaxOfVehMtnForPt, BrkActrVehSpdMaxToBrkActrVehSpdMaxOfVehSpdLimnForSfty, BrkPedlPsd, BrkPedlPsd, BrkPedlPsd, BrkPedlPsdToBrkPedlPsdOfDrvReq, BrkPedlPsdToBrkPedlPsdOfVehMtnForPt, BrkPedlVal, BrkPedlVal, BrkPedlVal, BrkPedlValToBrkPedlValOfDrvReq, BrkPedlValToBrkPedlValOfVehMtnForPt, CluPedlRat, CluPedlRat, CluPedlRat, CluPedlRatOfVehMtnForPtToCluPedlRatOfPtCoorr, CluPedlRatToCluPedlRatOfVehMtnForPt, CluPedlRatToCluPedlRatOfVehMtnForPtMisc, CmbEng, CmbEng, CmbEngMisc, CoorrStConsoldAtAxleFrnt, CoorrStConsoldAtAxleRe, CoorrStConsoldAtDftlForTqTrf, Crash, Crash, CrashToCrashOfCmbEng, CrashToCrashOfCmbEngMisc, DftlTqReqAtAxleFrnt, DftlTqReqAtAxleRe, DftlTqReqAtDftlForTqTrf, DrvReq, DrvReq, DrvReqRatVirtAccrPedl, DrvReqRatVirtAccrPedl, DrvReqRatVirtAccrPedl, DrvReqRatVirtAccrPedl, DrvReqRatVirtAccrPedlOfVehMtnForPtToDrvReqRatVirtAccrPedlOfPtCoorr, DrvReqRatVirtAccrPedlToDrvReqRatVirtAccrPedlOfDrvReq, DrvReqRatVirtAccrPedlToDrvReqRatVirtAccrPedlOfVehMtnForPt, DrvReqTqCluSlow, DrvReqTqCluSlow, DrvReqTqCluSlow, DrvReqTqCluSlow, DrvReqTqCluSlowOfVehMtnForPtToDrvReqTqCluSlowOfPtCoorr, DrvReqTqCluSlowToDrvReqTqCluSlowOfDrvReq, DrvReqTqCluSlowToDrvReqTqCluSlowOfVehMtnForPt, DrvReqTqWhlFast, DrvReqTqWhlFast, DrvReqTqWhlFast, DrvReqTqWhlFastOfVehMtnForPtToDrvReqTqWhlFastOfPtCoorr, DrvReqTqWhlFastToDrvReqTqWhlFastOfDrvReq, DrvReqTqWhlSlow, DrvReqTqWhlSlow, DrvReqTqWhlSlow, DrvReqTqWhlSlowOfVehMtnForPtToDrvReqTqWhlSlowOfPtCoorr, DrvReqTqWhlSlowToDrvReqTqWhlSlowOfDrvReq, EgyMngt, EgyMngt, EgyMngtToEgyMngtOfPtCoorr, EngN, EngN, EngN, EngN, EngN, EngNGearTar, EngNGrdt, EngNGrdt, EngNGrdtToEngNGrdtOfCmbEng, EngNGrdtToEngNGrdtOfEngSpdAndPosn, EngNMax, EngNMax, EngNMax, EngNMaxOfCmbEngToEngNMaxOfPtCoorr, EngNMaxToEngNMaxOfEngTqModMngt, EngNMin, EngNMin, EngNMin, EngNMinOfCmbEngToEngNMinOfPtCoorr, EngNMinToEngNMinOfEngTqModMngt, EngNOfCmbEngToEngNOfPtCoorr, EngNOfCmbEngToEngNOfVehMtnForPt, EngNToEngNOfCmbEng, EngNToEngNOfDrvReq, EngNToEngNOfEngSpdAndPosn, EngPAmbAir, EngPAmbAir, EngPAmbAirOfCmbEngToEngPAmbAirOfPtCoorr, EngSpdAndPosn, EngTqCrksftMax, EngTqCrksftMax, EngTqCrksftMax, EngTqCrksftMaxFast, EngTqCrksftMaxFast, EngTqCrksftMaxFast, EngTqCrksftMaxFastOfCmbEngToEngTqCrksftMaxFastOfPtCoorr, EngTqCrksftMaxFastToEngTqCrksftMaxFastOfEngTqModMngt, EngTqCrksftMaxOfCmbEngToEngTqCrksftMaxOfPtCoorr, EngTqCrksftMaxOptmCdn, EngTqCrksftMaxOptmCdn, EngTqCrksftMaxOptmCdn, EngTqCrksftMaxOptmCdnOfCmbEngToEngTqCrksftMaxOptmCdnOfPtCoorr, EngTqCrksftMaxOptmCdnToEngTqCrksftMaxOptmCdnOfEngTqModMngt, EngTqCrksftMaxProtn, EngTqCrksftMaxProtn, EngTqCrksftMaxProtn, EngTqCrksftMaxProtnOfCmbEngToEngTqCrksftMaxProtnOfPtCoorr, EngTqCrksftMaxProtnToEngTqCrksftMaxProtnOfEngTqModMngt, EngTqCrksftMaxToEngTqCrksftMaxOfEngTqModMngt, EngTqCrksftMinBasc, EngTqCrksftMinBasc, EngTqCrksftMinBasc, EngTqCrksftMinBascOfCmbEngToEngTqCrksftMinBascOfPtCoorr, EngTqCrksftMinBascToEngTqCrksftMinBascOfEngTqModMngt, EngTqCrksftMinWoCutOff, EngTqCrksftMinWoCutOff, EngTqCrksftMinWoCutOff, EngTqCrksftMinWoCutOffOfCmbEngToEngTqCrksftMinWoCutOffOfPtCoorr, EngTqCrksftMinWoCutOffToEngTqCrksftMinWoCutOffOfEngTqModMngt, EngTqDecAtCluReqByEscFast, EngTqDecAtCluReqByEscFast, EngTqDecAtCluReqByEscFastToEngTqDecAtCluReqByEscFastOfPtCoorr, EngTqDecAtCluReqByEscSlow, EngTqDecAtCluReqByEscSlow, EngTqDecAtCluReqByEscSlowToEngTqDecAtCluReqByEscSlowOfPtCoorr, EngTqIncAtCluReqByEsc, EngTqIncAtCluReqByEsc, EngTqIncAtCluReqByEscToEngTqIncAtCluReqByEscOfPtCoorr, EngTqModMngt, EngTqModMngt, EngTqResvReqPt, EngTqResvReqPt, EngTqResvReqPt, EngTqResvReqPt, EngTqResvReqPt1, EngTqResvReqPtOfCmbEngToEngTqResvReqPtOfPtCoorr, EngTqResvReqPtToEngTqResvReqPtOfEngTqModMngt, EscSt, EscSt, EscStToEscStOfPtCoorr, GearParkReq, GearShiftDwnReqFromDrvr, GearShiftDwnReqFromDrvr, GearShiftDwnReqFromDrvrToGearShiftDwnReqFromDrvrOfPtCoorr, GearShiftPrevnCmftReqByVlc, GearShiftPrevnCmftReqByVlc, GearShiftPrevnCmftReqByVlcToGearShiftPrevnCmftReqByVlcOfPtCoorr, GearShiftPrevnStaby, GearShiftPrevnStaby, GearShiftPrevnStabyToGearShiftPrevnStabyOfPtCoorr, GearShiftUpReqFromDrvr, GearShiftUpReqFromDrvr, GearShiftUpReqFromDrvrToGearShiftUpReqFromDrvrOfPtCoorr, N2, NoFuCutOffReq, OperMod, OperMod, OperModToOperModOfPtCoorr, OutdT, OutdT, OutdTToOutdTOfPtCoorr, Pt, PtCoorr, PtCoorr, PtFlgAcDeactvtReq, PtFlgAcDeactvtReq, PtFlgAcDeactvtReq1, PtFlgAltDeactvtReq, PtFlgDrvOvrdVlc, PtFlgDrvOvrdVlc, PtFlgDrvOvrdVlcToPtFlgDrvOvrdVlcOfPtCoorr, PtFlgEngRun, PtFlgEngRun, PtFlgEngRun, PtFlgEngRun, PtFlgEngRunOfCmbEngToPtFlgEngRunOfPtCoorr, PtFlgEngRunToPtFlgEngRunOfCmbEng, PtFlgEngRunToPtFlgEngRunOfEngTqModMngt, PtFlgEngStop, PtFlgEngStop, PtFlgEngStop, PtFlgEngStop, PtFlgEngStopOfCmbEngToPtFlgEngStopOfPtCoorr, PtFlgEngStopReq, PtFlgEngStopReq, PtFlgEngStopReq, PtFlgEngStopReqAllwd, PtFlgEngStopReqAllwd, PtFlgEngStopReqAllwd, PtFlgEngStopReqAllwdOfCmbEngToPtFlgEngStopReqAllwdOfPtCoorr, PtFlgEngStopReqAllwdToPtFlgEngStopReqAllwdOfEngTqModMngt, PtFlgEngStopReqOfPtCoorrToPtFlgEngStopReqOfCmbEng, PtFlgEngStopReqToPtFlgEngStopReqOfEngTqModMngt, PtFlgEngStopToPtFlgEngStopOfCmbEng, PtFlgEngStopToPtFlgEngStopOfEngTqModMngt, PtFlgEngStrtReq, PtFlgEngStrtReq, PtFlgEngStrtReq, PtFlgEngStrtReqAllwd, PtFlgEngStrtReqAllwd, PtFlgEngStrtReqAllwd, PtFlgEngStrtReqAllwdOfCmbEngToPtFlgEngStrtReqAllwdOfPtCoorr, PtFlgEngStrtReqAllwdToPtFlgEngStrtReqAllwdOfEngTqModMngt, PtFlgEngStrtReqOfPtCoorrToPtFlgEngStrtReqOfCmbEng, PtFlgEngStrtReqToPtFlgEngStrtReqOfEngTqModMngt, PtFlgNoTqWhlReq, PtFlgTqDecPsbl, PtFlgTqDecPsbl, PtFlgTqDecPsblToPtFlgTqDecPsblOfPtCoorr, PtFlgTqIncPsbl, PtFlgTqIncPsbl, PtFlgTqIncPsblToPtFlgTqIncPsblOfPtCoorr, PtMisc, PtRatTqDistbnReq, PtTqClu, PtTqClu, PtTqClu, PtTqCluDyn, PtTqCluMaxDrv, PtTqCluMaxDrv, PtTqCluMaxDrv, PtTqCluMaxDrvOfPtCoorrToPtTqCluMaxDrvOfVehMtnForPt, PtTqCluMaxDrvToPtTqCluMaxDrvOfDrvReq, PtTqCluMinDrv, PtTqCluMinDrv, PtTqCluMinDrv, PtTqCluMinDrvOfPtCoorrToPtTqCluMinDrvOfVehMtnForPt, PtTqCluMinDrvToPtTqCluMinDrvOfDrvReq, PtTqCluOfPtCoorrToPtTqCluOfTrsm, PtTqCluTarGear, PtTqCluToPtTqCluOfPtCoorr, PtTqCrksftReqFast, PtTqCrksftReqFast, PtTqCrksftReqFast, PtTqCrksftReqFastOfPtCoorrToPtTqCrksftReqFastOfCmbEng, PtTqCrksftReqFastToPtTqCrksftReqFastOfEngTqModMngt, PtTqCrksftReqSlow, PtTqCrksftReqSlow, PtTqCrksftReqSlow, PtTqCrksftReqSlowOfPtCoorrToPtTqCrksftReqSlowOfCmbEng, PtTqCrksftReqSlowToPtTqCrksftReqSlowOfEngTqModMngt, PtTqDecAtWhlsReqByEscFast, PtTqDecAtWhlsReqByEscFast, PtTqDecAtWhlsReqByEscFastToPtTqDecAtWhlsReqByEscFastOfPtCoorr, PtTqDecAtWhlsReqByEscSlow, PtTqDecAtWhlsReqByEscSlow, PtTqDecAtWhlsReqByEscSlowToPtTqDecAtWhlsReqByEscSlowOfPtCoorr, PtTqDistbnToWhlsReqdByDtd, PtTqDistbnToWhlsReqdByDtd, PtTqDistbnToWhlsReqdByDtdToPtTqDistbnToWhlsReqdByDtdOfPtCoorr, PtTqIncAtWhlsReqByEscFast, PtTqIncAtWhlsReqByEscFast, PtTqIncAtWhlsReqByEscFastToPtTqIncAtWhlsReqByEscFastOfPtCoorr, PtTqIncAtWhlsReqByEscSlow, PtTqIncAtWhlsReqByEscSlow, PtTqIncAtWhlsReqByEscSlowToPtTqIncAtWhlsReqByEscSlowOfPtCoorr, PtTqMaxAc, PtTqMaxAc1, PtTqMaxAlt, PtTqMaxSteer, PtTqMaxTrsmOilPmp, PtTqResvReqEng, PtTqResvReqEng, PtTqResvReqEng, PtTqResvReqEngOfPtCoorrToPtTqResvReqEngOfCmbEng, PtTqResvReqEngToPtTqResvReqEngOfEngTqModMngt, PtTqTotMaxAtWhlsReqdByVlc, PtTqTotMaxAtWhlsReqdByVlc, PtTqTotMaxAtWhlsReqdByVlcToPtTqTotMaxAtWhlsReqdByVlcOfPtCoorr, PtTqTotMinAtWhlsReqdByVlc, PtTqTotMinAtWhlsReqdByVlc, PtTqTotMinAtWhlsReqdByVlcToPtTqTotMinAtWhlsReqdByVlcOfPtCoorr, PtTqWhl, PtTqWhl, PtTqWhlInd, PtTqWhlInd, PtTqWhlIndToPtTqWhlIndOfPtCoorr, PtTqWhlMax, PtTqWhlMax, PtTqWhlMax, PtTqWhlMax, PtTqWhlMaxDrv, PtTqWhlMaxOfPtCoorrToPtTqWhlMaxOfVehMtnForPt, PtTqWhlMaxToPtTqWhlMaxOfDrvReq, PtTqWhlMaxToPtTqWhlMaxOfPtCoorr, PtTqWhlMin, PtTqWhlMin, PtTqWhlMinDrv, PtTqWhlMinDrv, PtTqWhlMinDrv, PtTqWhlMinDrv, PtTqWhlMinDrvOfPtCoorrToPtTqWhlMinDrvOfVehMtnForPt, PtTqWhlMinDrvToPtTqWhlMinDrvOfDrvReq, PtTqWhlMinDrvToPtTqWhlMinDrvOfPtCoorr, PtTqWhlMinToPtTqWhlMinOfPtCoorr, PtTqWhlMinWoCutOff, PtTqWhlMinWoCutOff, PtTqWhlMinWoCutOffToPtTqWhlMinWoCutOffOfPtCoorr, PtTqWhlReq, PtTqWhlReq, PtTqWhlReqDrvVlc, PtTqWhlReqDrvVlc, PtTqWhlReqDrvVlcToPtTqWhlReqDrvVlcOfPtCoorr, PtTqWhlReqToPtTqWhlReqOfPtCoorr, PtTqWhlToPtTqWhlOfPtCoorr, SteerLoadHyd, SteerLoadHyd, SteerLoadHydReq, SteerLoadHydReq, SteerLoadHydReqToSteerLoadHydReqOfPtCoorr, SteerLoadHydToSteerLoadHydOfPtCoorr, Trsm, Trsm, TrsmCluStConsold, TrsmCluStTar, TrsmFlgCtrsftActv, TrsmFlgCtrsftActv, TrsmFlgCtrsftActv, TrsmFlgCtrsftActv, TrsmFlgCtrsftActvToTrsmFlgCtrsftActvOfDrvReq, TrsmFlgDtOpen, TrsmFlgParkLockEngd, TrsmFlgSptModReq, TrsmFlgWntrModReq, TrsmNrGearConsold, TrsmNrGearConsold, TrsmNrGearConsold, TrsmNrGearConsold, TrsmNrGearConsoldToTrsmNrGearConsoldOfDrvReq, TrsmNrGearReq, TrsmNrGearTar, TrsmNrGearTar, TrsmNrTyp, TrsmNrTyp, TrsmNrTyp, TrsmNrTypToTrsmNrTypOfDrvReq, TrsmRatGear, TrsmRatGear, TrsmRatGear, TrsmRatGearConsold, TrsmRatGearConsold, TrsmRatGearConsold, TrsmRatGearConsold, TrsmRatGearConsoldToTrsmRatGearConsoldOfDrvReq, TrsmRatGearReq, TrsmRatGearTar, TrsmRatGearToTrsmRatGearOfDrvReq, TrsmRatTqPtConsold, TrsmRatTqPtConsold, TrsmRatTqPtConsold, TrsmRatTqPtConsold, TrsmRatTqPtConsoldToTrsmRatTqPtConsoldOfDrvReq, TrsmStAxleFrntActr, TrsmStAxleReActr, TrsmStGearLvr, TrsmStGearLvr, TrsmStGearLvr, TrsmStGearLvrToTrsmStGearLvrOfDrvReq, TrsmStTrfCaseDftl, TrsmTqDftlAxleFrntConsold, TrsmTqDftlAxleFrntMax, TrsmTqDftlAxleReConsold, TrsmTqDftlAxleReMax, TrsmTqDftlTrfConsold, TrsmTqDftlTrfMax, TrsmTqLoss, TrsmTqWhlIndDistbn, VehMtnForPt, VehMtnForPt, VehMtnForPtMisc, VehSpdLgt, VehSpdLgt, VehSpdLgt, VehSpdLgt, VehSpdLgtToVehSpdLgtOfDrvReq, VehSpdLgtToVehSpdLgtOfPtCoorr, VehSpdLgtToVehSpdLgtOfVehMtnForPt, VehSpdLimnForSfty, VehTqWhlMaxSftyLimn, VehTqWhlMaxSftyLimn, VehTqWhlMaxSftyLimnOfVehMtnForPtToVehTqWhlMaxSftyLimnOfPtCoorr, VehTqWhlMaxSftyLimnToVehTqWhlMaxSftyLimnOfVehSpdLimnForSfty, WhlSpdCircumlMeasd, WhlSpdCircumlMeasd, WhlSpdCircumlMeasdToWhlSpdCircumlMeasdOfPtCoorr, AArbnRes, AArbnRes1, ALat1, ALatStdByEsc, ALatStdWithRollCmpByEsc, ALgt1, ALgt2, ALgtStdFromWhlSpd, AReqForCmft1, AReqForCmftByCrsCtrlFree, AbsCtrlIntvg, AbsCtrlIntvg1, AbsFlgActv, AcTq, AcTq1, AcTqReq, AcTqReq1, AccActv, AccCtrlActv, AccCtrlActv1, AccVehDetd1, AccVehDetdIndcn, AccYawRateSpc, AccrPedlGrdt, AccrPedlGrdt1, AccrPedlMeasd, AccrPedlMeasd, AccrPedlMeasd1, AccrPedlRat, AccrPedlRat1, AccrPedlRatFild, AccrPedlRatFild1, AccrPedlRatGrdt, AccrPedlRatGrdt1, AltTq, AltTq1, AltTqReq, AltTqReq1, AmbAirT1, AxleFrntCoorrSt, AxleReCoorrSt, BattU, BattU1, BodyPitchAg1, BodyPitchAgAbsltEstimd, BrkActrVehSpdMax, BrkPedlFlgPsd, BrkPedlPsd, BrkPedlPsd1, BrkPedlRat, BrkPedlVal, BrkPedlVal1, CluPedlRat, CluPedlRat1, CoorrStActAtAxleFrnt, CoorrStActAtAxleRe, CoorrStActAtDftlForTqTrf, Crash, CrashSt1, CrsCtrlActv, CrsCtrlActv1, CrsCtrlAndAccDrvrOvrd, CrsCtrlAndAccDrvrOvrd1, CrsCtrlAndAccSetTiGap, CrsCtrlAndAccSetTiGapDec, CrsCtrlAndAccSetTiGapInc, CrsCtrlAndAccSwtStEngd, CrsCtrlAndAccSwtStEngd1, CrsCtrlAndAccVehSpdLgt, CrsCtrlAndAccVehSpdLgt1, CrsCtrlCtrlActv, CrsCtrlCtrlActv1, DftlCoorrSt1, DftlCoorrSts1, DftlTqReq1, DftlTqReqAtAxleFrnt, DftlTqReqAtAxleRe, DftlTqReqAtDftlForTqTrf, DrvFlgGearShiftDwnReq, DrvFlgGearShiftUpReq, DrvReqTqCluSlow, DrvReqTqCluSlow1, DrvReqTqWhlFast, DrvReqTqWhlFast1, DrvReqTqWhlSlow, DrvReqTqWhlSlow1, DtOpend, DtdRatTqDistbnReq, DtdTqDftlAxleFrntReq, DtdTqDftlAxleReReq, DtdTqDftlTrfReq, EgyMngt, EgyMngtSt, EgyMngtSt1, EgyMngtSts1, EmTqDynJ, EmTqDynJ1, EngN, EngN1, EngNGearTar, EngNGearTar1, EngNGrdt, EngNGrdt1, EngNMax, EngNMax1, EngNMin, EngNMin1, EngPAmbAir, EngPAmbAir1, EngRunngDirSt, EngRunngDirSt1, EngT, EngT1, EngTqCluMin, EngTqCluMin1, EngTqCrksft, EngTqCrksft1, EngTqCrksftMax, EngTqCrksftMax1, EngTqCrksftMaxFast, EngTqCrksftMaxFast1, EngTqCrksftMaxOptmCdn, EngTqCrksftMaxOptmCdn1, EngTqCrksftMaxProtn, EngTqCrksftMaxProtn1, EngTqCrksftMaxSpdCur, EngTqCrksftMaxSpdCur1, EngTqCrksftMin, EngTqCrksftMin1, EngTqCrksftMinBasc, EngTqCrksftMinBasc1, EngTqCrksftMinFast, EngTqCrksftMinFast1, EngTqCrksftMinWoCutOff, EngTqCrksftMinWoCutOff1, EngTqDecAtCluReqByEscFast, EngTqDecAtCluReqByEscFast1, EngTqDecAtCluReqByEscSlow, EngTqDecAtCluReqByEscSlow1, EngTqIncAtCluReqByEsc, EngTqIncAtCluReqByEsc1, EngTqResvPt, EngTqResvPt1, EngTqResvReqPt, EngTqResvReqPt, EngTqResvReqPt1, EscFlgNoFuCutOff, EscSt, EscSt1, EscStShiftPrevnStaby, EscTqCluPtMaxFast, EscTqCluPtMaxSlow, EscTqCluPtMin, EscTqWhlPtMaxFast, EscTqWhlPtMaxSlow, EscTqWhlPtMinFast, EscTqWhlPtMinSlow, EscVMax, EscVWhlInd, GearParkReq, GearParkReq1, GearShiftDwnReqFromDrvr, GearShiftDwnReqFromDrvr1, GearShiftPrevn1, GearShiftPrevnCmftReqByVlc, GearShiftPrevnStaby, GearShiftUpReqFromDrvr, GearShiftUpReqFromDrvr1, HvacTq, HvacTq, HvacTq1, HvacTqReq, HvacTqReq, HvacTqReq1, IndcrTurnReq1, NoFuCutOffReq, NoFuCutOffReq1, OperMod, OperModSt1, OutdT, P5, P6, P7, Perc10, Perc11, PrkgBrkActv, PrkgBrkActv1, PtAccrPedlPosn, PtAccrPedlPosn, PtAccrPedlPosn1, PtAccrPedlPosnVirt, PtAccrPedlPosnVirt1, PtFlgAcDeactvt, PtFlgAcDeactvt1, PtFlgAcDeactvtReq, PtFlgAcDeactvtReq, PtFlgAcDeactvtReq1, PtFlgAltDeactvt, PtFlgAltDeactvt1, PtFlgAltDeactvtReq, PtFlgDrvOvrdVlc, PtFlgDrvOvrdVlc1, PtFlgEngRun, PtFlgEngRun1, PtFlgEngStop, PtFlgEngStop1, PtFlgEngStopReq, PtFlgEngStopReq1, PtFlgEngStopReqAllwd, PtFlgEngStopReqAllwd1, PtFlgEngStrtReq, PtFlgEngStrtReq1, PtFlgEngStrtReqAllwd, PtFlgEngStrtReqAllwd1, PtFlgHvacDeactvt, PtFlgHvacDeactvt, PtFlgHvacDeactvt1, PtFlgNoTqWhlReq, PtFlgNoTqWhlReq1, PtFlgTqDecPsbl, PtFlgTqDecPsbl1, PtFlgTqIncPsbl, PtFlgTqIncPsbl1, PtNClu, PtNClu1, PtNEngSp, PtNEngSp1, PtRatTqDistbnReq, PtRatTqDistbnReq1, PtTqClu, PtTqClu1, PtTqCluDyn, PtTqCluDyn1, PtTqCluMaxDrv, PtTqCluMaxDrv1, PtTqCluMinDrv, PtTqCluMinDrv1, PtTqCluReqWoTrsmIntv, PtTqCluReqWoTrsmIntv1, PtTqCluTarGear, PtTqCluTarGear1, PtTqCluWoTrsmIntv, PtTqCluWoTrsmIntv1, PtTqCrksftReqFast, PtTqCrksftReqFast1, PtTqCrksftReqSlow, PtTqCrksftReqSlow1, PtTqDecAtWhlsReqByEscFast, PtTqDecAtWhlsReqByEscSlow, PtTqDistbnToWhls1, PtTqDistbnToWhlsReqdByDtd, PtTqIncAtWhlsReqByEscFast, PtTqIncAtWhlsReqByEscSlow, PtTqMaxAc, PtTqMaxAc1, PtTqMaxAlt, PtTqMaxAlt1, PtTqMaxHvac, PtTqMaxHvac1, PtTqMaxSteer, PtTqMaxSteer1, PtTqMaxTrsmOilPmp, PtTqMaxTrsmOilPmp1, PtTqResvEng, PtTqResvEng1, PtTqResvReqEng, PtTqResvReqEng, PtTqResvReqEng1, PtTqTotAtWhls1, PtTqTotMaxAtWhlsReqdByVlc, PtTqTotMinAtWhlsReqdByVlc, PtTqWhl, PtTqWhl1, PtTqWhlInd, PtTqWhlInd1, PtTqWhlMax, PtTqWhlMax1, PtTqWhlMaxDrv, PtTqWhlMaxDrv1, PtTqWhlMin, PtTqWhlMin1, PtTqWhlMinDrv, PtTqWhlMinDrv1, PtTqWhlMinWoCutOff, PtTqWhlMinWoCutOff1, PtTqWhlReq, PtTqWhlReq1, PtTqWhlReqDrvVlc, PtTqWhlReqDrvVlc1, RoadWhlAg1, RoadWhlAgEstimdFrnt, RoadWhlAgEstimdFrntWishdByDrvr, RoadWhlAgEstimdRe, RoadWhlAgSpd1, RoadWhlAgSpdEstimdFrnt, RoadWhlAgSpdEstimdFrntWishdByDrvr, SetSpd, SetSpd1, SetSpdDec, SetSpdDec1, SetSpdInc, SetSpdInc1, SetSpdIndcn, SetSpdIndcn1, SetTiGap1, SsmFlgGearParkReq, SteerLoadHyd, SteerLoadHyd1, SteerLoadHydReq, SteerTq, SteerTqReq, SteerWhlAg1, SteerWhlAgStd, SwtIndcr, T5, T6, TiGapDec1, TiGapInc1, TracCtrlIntvg, TracCtrlIntvg1, TrfCaseCoorrSt, TrsmAxleActrSt1, TrsmCluSt, TrsmCluSt1, TrsmCluStAct, TrsmCluStAct1, TrsmCluStConsold, TrsmCluStConsold, TrsmCluStConsold1, TrsmCluStTar, TrsmCluStTar1, TrsmFlgCtrsftActv, TrsmFlgCtrsftActv1, TrsmFlgDtOpen, TrsmFlgDtOpen1, TrsmFlgParkLockEngd, TrsmFlgParkLockEngd1, TrsmFlgShiftProgs, TrsmFlgShiftProgs1, TrsmFlgSptMod, TrsmFlgSptMod1, TrsmFlgSptModReq, TrsmFlgSptModReq, TrsmFlgSptModReq1, TrsmFlgWntrMod, TrsmFlgWntrMod1, TrsmFlgWntrModReq, TrsmFlgWntrModReq, TrsmFlgWntrModReq1, TrsmNInp, TrsmNInp1, TrsmNrGearAct, TrsmNrGearAct1, TrsmNrGearConsold, TrsmNrGearConsold1, TrsmNrGearReq, TrsmNrGearReq1, TrsmNrGearTar, TrsmNrGearTar1, TrsmNrTyp, TrsmNrTyp1, TrsmRatGear, TrsmRatGear1, TrsmRatGearAct, TrsmRatGearAct1, TrsmRatGearConsold, TrsmRatGearConsold1, TrsmRatGearReq, TrsmRatGearReq1, TrsmRatGearTar, TrsmRatGearTar1, TrsmRatTqPtAct, TrsmRatTqPtAct1, TrsmRatTqPtConsold, TrsmRatTqPtConsold, TrsmRatTqPtConsold1, TrsmStAxleFrntActr, TrsmStAxleReActr, TrsmStGearLvr, TrsmStGearLvr1, TrsmStTrfCaseDftl, TrsmStTrfCaseDftl1, TrsmTOil, TrsmTOil1, TrsmTqDftlAxleFrntAct, TrsmTqDftlAxleFrntAct1, TrsmTqDftlAxleFrntConsold, TrsmTqDftlAxleFrntConsold1, TrsmTqDftlAxleFrntMax, TrsmTqDftlAxleFrntMax1, TrsmTqDftlAxleReAct, TrsmTqDftlAxleReAct1, TrsmTqDftlAxleReConsold, TrsmTqDftlAxleReConsold1, TrsmTqDftlAxleReMax, TrsmTqDftlAxleReMax1, TrsmTqDftlTrfAct, TrsmTqDftlTrfAct1, TrsmTqDftlTrfConsold, TrsmTqDftlTrfConsold1, TrsmTqDftlTrfMax, TrsmTqDftlTrfMax1, TrsmTqOilPmp, TrsmTqOilPmp1, TrsmTqWhlIndDistbn, TrsmTqWhlIndDistbn1, VehCourseCrvtPred, VehCourseCrvtPred1, VehMtnSt, VehMtnSt1, VehSpd1, VehSpdDispd, VehSpdDispd1, VehSpdLgt, VehSpdLgt1, VehStOper, VehTqWhlMaxSftyLimn, VehTqWhlMaxSftyLimn1, VehVLgt, VlcA, VlcStShiftPrevnCmft, VlcTqWhlPtMax, VlcTqWhlPtMin, WhlBrkOvrheatd, WhlBrkOvrheatd1, WhlDirRotl1, WhlDirRotlStd, WhlRdTolrCoeff, WhlRdTolrCoeff1, WhlSpdCircuml1, WhlSpdCircumlStd, YawRate1, YawRateBas, YawRateOffsStdByEsc, YawStabyCtrlIntvg, YawStabyCtrlIntvg1, YawStabyInfo1, YawStabyInfoByEsc]
  collection PtRefAll:
    category=SET
    auto-collect=REF-ALL
    element-role=PART_OF_SUBSET
    element=[PtCoorr, AcTq1, AcTqReq1, PtFlgAcDeactvtReq1, PtTqMaxAc1, Pt, CmbEng, EngTqModMngt, Trsm, DrvReq, VehMtnForPt, EngTqResvReqPt1, N2, AArbnRes, ALatStdByEsc, ALatStdWithRollCmpByEsc, ALgtStdFromWhlSpd, AReqForCmftByCrsCtrlFree, AbsCtrlIntvg, AbsFlgActv, AcTq, AcTq1, AcTqReq, AcTqReq1, AccActv, AccCtrlActv, AccVehDetdIndcn, AccYawRateSpc, AccrPedlGrdt, AccrPedlGrdt1, AccrPedlMeasd, AccrPedlMeasd1, AccrPedlRat, AccrPedlRat1, AccrPedlRatFild, AccrPedlRatFild1, AccrPedlRatGrdt, AccrPedlRatGrdt1, AltTq, AltTqReq, AxleFrntCoorrSt, AxleReCoorrSt, BattU, BodyPitchAgAbsltEstimd, BrkActrVehSpdMax, BrkPedlFlgPsd, BrkPedlPsd, BrkPedlRat, BrkPedlVal, CluPedlRat, CoorrStActAtAxleFrnt, CoorrStActAtAxleRe, CoorrStActAtDftlForTqTrf, Crash, CrashSt1, CrsCtrlActv, CrsCtrlAndAccDrvrOvrd, CrsCtrlAndAccSetTiGap, CrsCtrlAndAccSetTiGapDec, CrsCtrlAndAccSetTiGapInc, CrsCtrlAndAccSwtStEngd, CrsCtrlAndAccVehSpdLgt, CrsCtrlCtrlActv, DftlTqReqAtAxleFrnt, DftlTqReqAtAxleRe, DftlTqReqAtDftlForTqTrf, DrvFlgGearShiftDwnReq, DrvFlgGearShiftUpReq, DrvReqTqCluSlow, DrvReqTqWhlFast, DrvReqTqWhlSlow, DtOpend, DtdRatTqDistbnReq, DtdTqDftlAxleFrntReq, DtdTqDftlAxleReReq, DtdTqDftlTrfReq, EgyMngt, EgyMngtSt, EmTqDynJ1, EngN, EngN1, EngNGearTar, EngNGearTar1, EngNGrdt, EngNGrdt1, EngNMax, EngNMax1, EngNMin, EngNMin1, EngPAmbAir, EngRunngDirSt, EngT, EngTqCluMin1, EngTqCrksft, EngTqCrksft1, EngTqCrksftMax, EngTqCrksftMaxFast, EngTqCrksftMaxOptmCdn, EngTqCrksftMaxProtn, EngTqCrksftMaxSpdCur1, EngTqCrksftMin, EngTqCrksftMin1, EngTqCrksftMinBasc, EngTqCrksftMinFast, EngTqCrksftMinWoCutOff, EngTqDecAtCluReqByEscFast, EngTqDecAtCluReqByEscSlow, EngTqIncAtCluReqByEsc, EngTqResvPt, EngTqResvReqPt, EngTqResvReqPt1, EscFlgNoFuCutOff, EscSt, EscStShiftPrevnStaby, EscTqCluPtMaxFast, EscTqCluPtMaxSlow, EscTqCluPtMin, EscTqWhlPtMaxFast, EscTqWhlPtMaxSlow, EscTqWhlPtMinFast, EscTqWhlPtMinSlow, EscVMax, EscVWhlInd, GearParkReq, GearShiftDwnReqFromDrvr, GearShiftPrevnCmftReqByVlc, GearShiftPrevnStaby, GearShiftUpReqFromDrvr, HvacTq, HvacTq1, HvacTqReq, HvacTqReq1, NoFuCutOffReq, OperMod, OutdT, P5, P6, P7, Perc10, Perc11, PrkgBrkActv, PtAccrPedlPosn, PtAccrPedlPosn1, PtAccrPedlPosnVirt, PtFlgAcDeactvt, PtFlgAcDeactvt1, PtFlgAcDeactvtReq, PtFlgAcDeactvtReq1, PtFlgAltDeactvt, PtFlgAltDeactvt1, PtFlgAltDeactvtReq, PtFlgDrvOvrdVlc, PtFlgEngRun, PtFlgEngStop, PtFlgEngStopReq, PtFlgEngStopReqAllwd, PtFlgEngStrtReq, PtFlgEngStrtReqAllwd, PtFlgHvacDeactvt, PtFlgHvacDeactvt1, PtFlgNoTqWhlReq, PtFlgTqDecPsbl, PtFlgTqIncPsbl, PtNClu, PtNClu1, PtNEngSp, PtNEngSp1, PtRatTqDistbnReq, PtTqClu, PtTqClu1, PtTqCluDyn, PtTqCluMaxDrv, PtTqCluMinDrv, PtTqCluReqWoTrsmIntv, PtTqCluReqWoTrsmIntv1, PtTqCluTarGear, PtTqCluWoTrsmIntv, PtTqCluWoTrsmIntv1, PtTqCrksftReqFast, PtTqCrksftReqSlow, PtTqDecAtWhlsReqByEscFast, PtTqDecAtWhlsReqByEscSlow, PtTqDistbnToWhlsReqdByDtd, PtTqIncAtWhlsReqByEscFast, PtTqIncAtWhlsReqByEscSlow, PtTqMaxAc, PtTqMaxAc1, PtTqMaxAlt, PtTqMaxHvac, PtTqMaxSteer, PtTqMaxTrsmOilPmp, PtTqResvEng, PtTqResvReqEng, PtTqResvReqEng1, PtTqTotMaxAtWhlsReqdByVlc, PtTqTotMinAtWhlsReqdByVlc, PtTqWhl, PtTqWhlInd, PtTqWhlMax, PtTqWhlMaxDrv, PtTqWhlMin, PtTqWhlMinDrv, PtTqWhlMinWoCutOff, PtTqWhlReq, PtTqWhlReqDrvVlc, RoadWhlAgEstimdFrnt, RoadWhlAgEstimdFrntWishdByDrvr, RoadWhlAgEstimdRe, RoadWhlAgSpdEstimdFrnt, RoadWhlAgSpdEstimdFrntWishdByDrvr, SetSpd, SetSpdDec, SetSpdInc, SetSpdIndcn, SsmFlgGearParkReq, SteerLoadHyd, SteerLoadHydReq, SteerTq, SteerTqReq, SteerWhlAgStd, SwtIndcr, T5, T6, TracCtrlIntvg, TrfCaseCoorrSt, TrsmCluSt, TrsmCluSt1, TrsmCluStAct, TrsmCluStConsold, TrsmCluStConsold1, TrsmCluStTar, TrsmFlgCtrsftActv, TrsmFlgDtOpen, TrsmFlgParkLockEngd, TrsmFlgShiftProgs, TrsmFlgSptMod, TrsmFlgSptModReq, TrsmFlgSptModReq1, TrsmFlgWntrMod, TrsmFlgWntrModReq, TrsmFlgWntrModReq1, TrsmNInp, TrsmNInp1, TrsmNrGearAct, TrsmNrGearConsold, TrsmNrGearConsold1, TrsmNrGearReq, TrsmNrGearTar, TrsmNrTyp, TrsmRatGear, TrsmRatGearAct, TrsmRatGearConsold, TrsmRatGearReq, TrsmRatGearTar, TrsmRatTqPtAct, TrsmRatTqPtConsold, TrsmRatTqPtConsold1, TrsmStAxleFrntActr, TrsmStAxleReActr, TrsmStGearLvr, TrsmStTrfCaseDftl, TrsmTOil, TrsmTqDftlAxleFrntAct, TrsmTqDftlAxleFrntConsold1, TrsmTqDftlAxleFrntMax, TrsmTqDftlAxleReAct, TrsmTqDftlAxleReConsold1, TrsmTqDftlAxleReMax, TrsmTqDftlTrfAct, TrsmTqDftlTrfConsold1, TrsmTqDftlTrfMax, TrsmTqOilPmp, TrsmTqWhlIndDistbn, VehCourseCrvtPred, VehMtnSt, VehSpdDispd, VehSpdLgt, VehStOper, VehTqWhlMaxSftyLimn, VehVLgt, VlcA, VlcStShiftPrevnCmft, VlcTqWhlPtMax, VlcTqWhlPtMin, WhlBrkOvrheatd, WhlDirRotlStd, WhlRdTolrCoeff, WhlSpdCircumlStd, YawRateBas, YawRateOffsStdByEsc, YawStabyCtrlIntvg, YawStabyInfoByEsc]
  collection PtRefAllToPt: category=RELATION, element-role=AUTO_COLLECTED_FROM, element=Pt, source-element=PtRefAll
