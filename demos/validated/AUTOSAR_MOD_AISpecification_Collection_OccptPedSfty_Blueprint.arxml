AUTOSAR XML (schema 00050)
package /AUTOSAR/AISpecification/Collections_Blueprint
  collection OccptPedSfty:
    category=SET
    auto-collect=REF-NONE
    element-role=PART_OF_SUBSET
    element=[ACenForOccptPedSfty1, ACenForOccptPedSfty2, AExtForOccptPedSfty1, AExtForOccptPedSfty2, ALat1, ALatAtApilLe, ALatAtApilLe1, ALatAtApilRi, ALatAtApilRi1, ALatAtBpilLe, ALatAtBpilLe1, ALatAtBpilRi, ALatAtBpilRi1, ALatAtCen, ALatAtCen1, ALatAtCenWithRngLo, ALatAtCenWithRngMid, ALatAtCpilLe, ALatAtCpilLe1, ALatAtCpilRi, ALatAtCpilRi1, ALatAtFrntLe, ALatAtFrntLe1, ALatAtFrntMid, ALatAtFrntMid1, ALatAtFrntRi, ALatAtFrntRi1, ALatAtReLe, ALatAtReLe1, ALatAtReMid, ALatAtReMid1, ALatAtReRi, ALatAtReRi1, ALatOnDoorAtFrntLe, ALatOnDoorAtFrntLe1, ALatOnDoorAtFrntRi, ALatOnDoorAtFrntRi1, ALatOnDoorAtReLe, ALatOnDoorAtReLe1, ALatOnDoorAtReRi, ALatOnDoorAtReRi1, ALatStdByEsc, ALgt1, ALgtAtApilLe, ALgtAtApilLe1, ALgtAtApilRi, ALgtAtApilRi1, ALgtAtBpilLe, ALgtAtBpilLe1, ALgtAtBpilRi, ALgtAtBpilRi1, ALgtAtCen, ALgtAtCen1, ALgtAtCenWithRngLo, ALgtAtCenWithRngMid, ALgtAtCpilLe, ALgtAtCpilLe1, ALgtAtCpilRi, ALgtAtCpilRi1, ALgtAtFrntLe, ALgtAtFrntLe1, ALgtAtFrntMid, ALgtAtFrntMid1, ALgtAtFrntRi, ALgtAtFrntRi1, ALgtAtReLe, ALgtAtReLe1, ALgtAtReMid, ALgtAtReMid1, ALgtAtReRi, ALgtAtReRi1, ALgtOnDoorAtFrntLe, ALgtOnDoorAtFrntLe1, ALgtOnDoorAtFrntRi, ALgtOnDoorAtFrntRi1, ALgtOnDoorAtReLe, ALgtOnDoorAtReLe1, ALgtOnDoorAtReRi, ALgtOnDoorAtReRi1, ALgtStd, ALoForOccptPedSfty1, AMidForOccptPedSfty1, AOnBmpAtFrntLe, AOnBmpAtFrntLe1, AOnBmpAtFrntMid, AOnBmpAtFrntMid1, AOnBmpAtFrntMidLe, AOnBmpAtFrntMidLe1, AOnBmpAtFrntMidRi, AOnBmpAtFrntMidRi1, AOnBmpAtFrntRi, AOnBmpAtFrntRi1, AUpwAtCen, AUpwAtCen1, AUpwAtCenWithRngLo, AUpwAtCenWithRngMid, ActvnOfActrForOccptPedSfty1, ActvtOfActrAirbFrntAtDrvr, ActvtOfActrAirbFrntAtPass, ActvtOfActrAirbFrntAtRowFirstMid, ActvtOfActrAirbSideAtDrvr, ActvtOfActrAirbSideAtPass, ActvtOfActrAirbSideAtRowSecLe, ActvtOfActrAirbSideAtRowSecRi, ActvtOfActrAirbSideAtRowThrdLe, ActvtOfActrAirbSideAtRowThrdRi, ActvtOfActrAnchrfitgTensnrAtDrvr, ActvtOfActrAnchrfitgTensnrAtPass, ActvtOfActrAnchrfitgTensnrAtRowFirstMid, ActvtOfActrAnchrfitgTensnrAtRowSecLe, ActvtOfActrAnchrfitgTensnrAtRowSecMid, ActvtOfActrAnchrfitgTensnrAtRowSecRi, ActvtOfActrAnchrfitgTensnrAtRowThrdLe, ActvtOfActrAnchrfitgTensnrAtRowThrdMid, ActvtOfActrAnchrfitgTensnrAtRowThrdRi, ActvtOfActrAntisubCushAtDrvr, ActvtOfActrAntisubCushAtPass, ActvtOfActrAntisubCushAtRowFirstMid, ActvtOfActrAntisubCushAtRowSecLe, ActvtOfActrAntisubCushAtRowSecMid, ActvtOfActrAntisubCushAtRowSecRi, ActvtOfActrAntisubCushAtRowThrdLe, ActvtOfActrAntisubCushAtRowThrdMid, ActvtOfActrAntisubCushAtRowThrdRi, ActvtOfActrAtApilLeForPedProtn, ActvtOfActrAtApilRiForPedProtn, ActvtOfActrAtBmpForPedProtn, ActvtOfActrAtHoodForPedProtn, ActvtOfActrAtRoofForPedProtn, ActvtOfActrBattCutOff, ActvtOfActrBltLimrAtDrvr, ActvtOfActrBltLimrAtPass, ActvtOfActrBltLimrAtRowFirstMid, ActvtOfActrBltLimrAtRowSecLe, ActvtOfActrBltLimrAtRowSecMid, ActvtOfActrBltLimrAtRowSecRi, ActvtOfActrBltLimrAtRowThrdLe, ActvtOfActrBltLimrAtRowThrdMid, ActvtOfActrBltLimrAtRowThrdRi, ActvtOfActrBltTensnrAtDrvr, ActvtOfActrBltTensnrAtPass, ActvtOfActrBltTensnrAtRowFirstMid, ActvtOfActrBltTensnrAtRowSecLe, ActvtOfActrBltTensnrAtRowSecMid, ActvtOfActrBltTensnrAtRowSecRi, ActvtOfActrBltTensnrAtRowThrdLe, ActvtOfActrBltTensnrAtRowThrdMid, ActvtOfActrBltTensnrAtRowThrdRi, ActvtOfActrBucRtrctrAtDrvr, ActvtOfActrBucRtrctrAtPass, ActvtOfActrBucRtrctrAtRowFirstMid, ActvtOfActrBucRtrctrAtRowSecLe, ActvtOfActrBucRtrctrAtRowSecMid, ActvtOfActrBucRtrctrAtRowSecRi, ActvtOfActrBucRtrctrAtRowThrdLe, ActvtOfActrBucRtrctrAtRowThrdMid, ActvtOfActrBucRtrctrAtRowThrdRi, ActvtOfActrCurtAirbAtLe, ActvtOfActrCurtAirbAtRi, ActvtOfActrFuCutOff, ActvtOfActrHdrestAtDrvr, ActvtOfActrHdrestAtPass, ActvtOfActrHdrestAtRowFirstMid, ActvtOfActrHdrestAtRowSecLe, ActvtOfActrHdrestAtRowSecMid, ActvtOfActrHdrestAtRowSecRi, ActvtOfActrHdrestAtRowThrdLe, ActvtOfActrHdrestAtRowThrdMid, ActvtOfActrHdrestAtRowThrdRi, ActvtOfActrKneeProtnAtDrvr, ActvtOfActrKneeProtnAtPass, ActvtOfActrKneeProtnAtRowFirstMid, ActvtOfActrPelvProtnAtDrvr, ActvtOfActrPelvProtnAtPass, ActvtOfActrPelvProtnAtRowSecLe, ActvtOfActrPelvProtnAtRowSecRi, ActvtOfActrPelvProtnAtRowThrdLe, ActvtOfActrPelvProtnAtRowThrdRi, ActvtOfActrRollbarAtLe, ActvtOfActrRollbarAtRi, ActvtOfActrThoraxAirbAtDrvr, ActvtOfActrThoraxAirbAtPass, ActvtOfActrThoraxAirbAtRowFirstMidToDrvr, ActvtOfActrThoraxAirbAtRowFirstMidToPass, ActvtOfActrThoraxAirbAtRowSecLe, ActvtOfActrThoraxAirbAtRowSecMidLe, ActvtOfActrThoraxAirbAtRowSecMidRi, ActvtOfActrThoraxAirbAtRowSecRi, ActvtOfActrThoraxAirbAtRowThrdLe, ActvtOfActrThoraxAirbAtRowThrdMidLe, ActvtOfActrThoraxAirbAtRowThrdMidRi, ActvtOfActrThoraxAirbAtRowThrdRi, AmbAirT1, BltLockChgInfo1, BltLockSt1, BltLockStAtDrvr, BltLockStAtPass, BltLockStAtRowFirstMid, BltLockStAtRowSecLe, BltLockStAtRowSecMid, BltLockStAtRowSecRi, BltLockStAtRowThrdLe, BltLockStAtRowThrdMid, BltLockStAtRowThrdRi, BmpT1, ChgInfoOfBltLockSt, Crash, CrashSev1, CrashSt1, CrashYpos1, CtrlOfActrAirbFrntAtDrvr, CtrlOfActrAirbFrntAtPass, CtrlOfActrAirbFrntAtRowFirstMid, CtrlOfActrAirbSideAtDrvr, CtrlOfActrAirbSideAtPass, CtrlOfActrAirbSideAtRowSecLe, CtrlOfActrAirbSideAtRowSecRi, CtrlOfActrAirbSideAtRowThrdLe, CtrlOfActrAirbSideAtRowThrdRi, CtrlOfActrAnchrfitgTensnrAtDrvr, CtrlOfActrAnchrfitgTensnrAtPass, CtrlOfActrAnchrfitgTensnrAtRowFirstMid, CtrlOfActrAnchrfitgTensnrAtRowSecLe, CtrlOfActrAnchrfitgTensnrAtRowSecMid, CtrlOfActrAnchrfitgTensnrAtRowSecRi, CtrlOfActrAnchrfitgTensnrAtRowThrdLe, CtrlOfActrAnchrfitgTensnrAtRowThrdMid, CtrlOfActrAnchrfitgTensnrAtRowThrdRi, CtrlOfActrAntisubCushAtDrvr, CtrlOfActrAntisubCushAtPass, CtrlOfActrAntisubCushAtRowFirstMid, CtrlOfActrAntisubCushAtRowSecLe, CtrlOfActrAntisubCushAtRowSecMid, CtrlOfActrAntisubCushAtRowSecRi, CtrlOfActrAntisubCushAtRowThrdLe, CtrlOfActrAntisubCushAtRowThrdMid, CtrlOfActrAntisubCushAtRowThrdRi, CtrlOfActrAtApilLeForPedProtn, CtrlOfActrAtApilRiForPedProtn, CtrlOfActrAtBmpForPedProtn, CtrlOfActrAtHoodForPedProtn, CtrlOfActrAtRoofForPedProtn, CtrlOfActrBltLimrAtDrvr, CtrlOfActrBltLimrAtPass, CtrlOfActrBltLimrAtRowFirstMid, CtrlOfActrBltLimrAtRowSecLe, CtrlOfActrBltLimrAtRowSecMid, CtrlOfActrBltLimrAtRowSecRi, CtrlOfActrBltLimrAtRowThrdLe, CtrlOfActrBltLimrAtRowThrdMid, CtrlOfActrBltLimrAtRowThrdRi, CtrlOfActrBltTensnrAtDrvr, CtrlOfActrBltTensnrAtPass, CtrlOfActrBltTensnrAtRowFirstMid, CtrlOfActrBltTensnrAtRowSecLe, CtrlOfActrBltTensnrAtRowSecMid, CtrlOfActrBltTensnrAtRowSecRi, CtrlOfActrBltTensnrAtRowThrdLe, CtrlOfActrBltTensnrAtRowThrdMid, CtrlOfActrBltTensnrAtRowThrdRi, CtrlOfActrBucRtrctrAtDrvr, CtrlOfActrBucRtrctrAtPass, CtrlOfActrBucRtrctrAtRowFirstMid, CtrlOfActrBucRtrctrAtRowSecLe, CtrlOfActrBucRtrctrAtRowSecMid, CtrlOfActrBucRtrctrAtRowSecRi, CtrlOfActrBucRtrctrAtRowThrdLe, CtrlOfActrBucRtrctrAtRowThrdMid, CtrlOfActrBucRtrctrAtRowThrdRi, CtrlOfActrCurtAirbAtLe, CtrlOfActrCurtAirbAtRi, CtrlOfActrForOccptPedSfty1, CtrlOfActrHdrestAtDrvr, CtrlOfActrHdrestAtPass, CtrlOfActrHdrestAtRowFirstMid, CtrlOfActrHdrestAtRowSecLe, CtrlOfActrHdrestAtRowSecMid, CtrlOfActrHdrestAtRowSecRi, CtrlOfActrHdrestAtRowThrdLe, CtrlOfActrHdrestAtRowThrdMid, CtrlOfActrHdrestAtRowThrdRi, CtrlOfActrKneeProtnAtDrvr, CtrlOfActrKneeProtnAtPass, CtrlOfActrKneeProtnAtRowFirstMid, CtrlOfActrPelvProtnAtDrvr, CtrlOfActrPelvProtnAtPass, CtrlOfActrPelvProtnAtRowSecLe, CtrlOfActrPelvProtnAtRowSecRi, CtrlOfActrPelvProtnAtRowThrdLe, CtrlOfActrPelvProtnAtRowThrdRi, CtrlOfActrThoraxAirbAtDrvr, CtrlOfActrThoraxAirbAtPass, CtrlOfActrThoraxAirbAtRowFirstMidToDrvr, CtrlOfActrThoraxAirbAtRowFirstMidToPass, CtrlOfActrThoraxAirbAtRowSecLe, CtrlOfActrThoraxAirbAtRowSecMidLe, CtrlOfActrThoraxAirbAtRowSecMidRi, CtrlOfActrThoraxAirbAtRowSecRi, CtrlOfActrThoraxAirbAtRowThrdLe, CtrlOfActrThoraxAirbAtRowThrdMidLe, CtrlOfActrThoraxAirbAtRowThrdMidRi, CtrlOfActrThoraxAirbAtRowThrdRi, DftlYawStabyCtrlIntvg, DispBltLockAck, DispBltLockAck1, DispBltLockReq, DispBltLockReq1, DispBltLockSt1, DispBltLockStOfDrvr, DispBltLockStOfPass, DispBltLockStOfRowFirstMid, DispBltLockStOfRowSecLe, DispBltLockStOfRowSecMid, DispBltLockStOfRowSecRi, DispBltLockStOfRowThrdLe, DispBltLockStOfRowThrdMid, DispBltLockStOfRowThrdRi, DispBucdStOfDrvr, DispBucdStOfOccpt1, DispBucdStOfOccptAtRowFirstMid, DispBucdStOfOccptAtRowSecLe, DispBucdStOfOccptAtRowSecMid, DispBucdStOfOccptAtRowSecRi, DispBucdStOfOccptAtRowThrdLe, DispBucdStOfOccptAtRowThrdMid, DispBucdStOfOccptAtRowThrdRi, DispBucdStOfPass, DoorSt1, DoorStOfDoorLockReLe, DoorStOfDoorLockReRi, DoorStOfDrvrDoorLock, DoorStOfPassDoorLock, DstTrvld, DstTrvld1, EngN, EngN1, EngSpd, ImpctLocnEstimdOfCrashAtFrnt, ImpctLocnEstimdOfCrashAtLe, ImpctLocnEstimdOfCrashAtRe, ImpctLocnEstimdOfCrashAtRi, LocnOfImpctAtCrash1, OccptClass1, OccptClassAtDrvr, OccptClassAtPass, OccptClassAtRowFirstMid, OccptClassAtRowSecLe, OccptClassAtRowSecMid, OccptClassAtRowSecRi, OccptClassAtRowThrdLe, OccptClassAtRowThrdMid, OccptClassAtRowThrdRi, OccptOutOfPos1, OccptOutOfPosAtDrvr, OccptOutOfPosAtPass, OccptOutOfPosAtRowFirstMid, OccptOutOfPosAtRowSecLe, OccptOutOfPosAtRowSecMid, OccptOutOfPosAtRowSecRi, OccptOutOfPosAtRowThrdLe, OccptOutOfPosAtRowThrdMid, OccptOutOfPosAtRowThrdRi, OccptWght1, OccptWghtMeasdAtDrvr, OccptWghtMeasdAtPass, OccptWghtMeasdAtRowFirstMid, OccptWghtMeasdAtRowSecLe, OccptWghtMeasdAtRowSecMid, OccptWghtMeasdAtRowSecRi, OccptWghtMeasdAtRowThrdLe, OccptWghtMeasdAtRowThrdMid, OccptWghtMeasdAtRowThrdRi, OccptWghtStdAtDrvr, OccptWghtStdAtPass, OccptWghtStdAtRowFirstMid, OccptWghtStdAtRowSecLe, OccptWghtStdAtRowSecMid, OccptWghtStdAtRowSecRi, OccptWghtStdAtRowThrdLe, OccptWghtStdAtRowThrdMid, OccptWghtStdAtRowThrdRi, OperMod, OperModSt1, OutdT, PExtForOccptPedSfty1, PInDoorAtFrntLe, PInDoorAtFrntRi, PInDoorAtReLe, PInDoorAtReRi, PedCrashSevCalcd, PedCrashYposCalcd, PitchRate1, PitchRate2, PitchRateAtCen, PitchRateStd, PresStOfDrvr, PresStOfOccpt1, PresStOfOccptAtRowFirstMid, PresStOfOccptAtRowSecLe, PresStOfOccptAtRowSecMid, PresStOfOccptAtRowSecRi, PresStOfOccptAtRowThrdLe, PresStOfOccptAtRowThrdMid, PresStOfOccptAtRowThrdRi, PresStOfPass, RollRate1, RollRate3, RollRateAtCen, RollRateStd, SeatBltRmnAcoustWarnReq, SeatBltRmnAcoustWarnReq1, SeatBltRmnFrqCtrlAcoustWarn, SeatBltRmnFrqCtrlAcoustWarn1, SeatBltRmnLdnCtrlAcoustWarn, SeatBltRmnLdnCtrlAcoustWarn1, SeatBltRmnOpticWarnReq, SeatBltRmnOpticWarnReq1, SeatBltRmnWarnSt, SeatBltRmnWarnSt1, SeatFixaSt1, SeatFixaStOfDrvrSeat, SeatFixaStOfPassSeat, SeatFixaStOfSeatRowFirstMid, SeatFixaStOfSeatRowSecLe, SeatFixaStOfSeatRowSecMid, SeatFixaStOfSeatRowSecRi, SeatFixaStOfSeatRowThrdLe, SeatFixaStOfSeatRowThrdMid, SeatFixaStOfSeatRowThrdRi, SpdLat1, SpdLatEstimdByEsc, SteerWhlAg1, SteerWhlAgStd, TAtBmp, VehBodyAVert1, VehBodyAVertMeasdStd, VehCrashPitchovrDetd, VehCrashRollovrDetd, VehCrashSevCalcdAtFrnt, VehCrashSevCalcdAtLe, VehCrashSevCalcdAtRe, VehCrashSevCalcdAtRi, VehMtnSt, VehMtnSt1, VehPitchovrMod1, VehRollovrMod1, VehSpdLgt, VehSpdLgt1, YawRate1, YawRateStdByEsc, YawStabyCtrlIntvg1]
  collection OccptPedSftyRefAll:
    category=SET
    auto-collect=REF-ALL
    element-role=PART_OF_SUBSET
    element=[ALatAtApilLe, ALatAtApilLe1, ALatAtApilRi, ALatAtApilRi1, ALatAtBpilLe, ALatAtBpilLe1, ALatAtBpilRi, ALatAtBpilRi1, ALatAtCen, ALatAtCen1, ALatAtCenWithRngLo, ALatAtCenWithRngMid, ALatAtCpilLe, ALatAtCpilLe1, ALatAtCpilRi, ALatAtCpilRi1, ALatAtFrntLe, ALatAtFrntLe1, ALatAtFrntMid, ALatAtFrntMid1, ALatAtFrntRi, ALatAtFrntRi1, ALatAtReLe, ALatAtReLe1, ALatAtReMid, ALatAtReMid1, ALatAtReRi, ALatAtReRi1, ALatOnDoorAtFrntLe, ALatOnDoorAtFrntLe1, ALatOnDoorAtFrntRi, ALatOnDoorAtFrntRi1, ALatOnDoorAtReLe, ALatOnDoorAtReLe1, ALatOnDoorAtReRi, ALatOnDoorAtReRi1, ALatStdByEsc, ALgtAtApilLe, ALgtAtApilLe1, ALgtAtApilRi, ALgtAtApilRi1, ALgtAtBpilLe, ALgtAtBpilLe1, ALgtAtBpilRi, ALgtAtBpilRi1, ALgtAtCen, ALgtAtCen1, ALgtAtCenWithRngLo, ALgtAtCenWithRngMid, ALgtAtCpilLe, ALgtAtCpilLe1, ALgtAtCpilRi, ALgtAtCpilRi1, ALgtAtFrntLe, ALgtAtFrntLe1, ALgtAtFrntMid, ALgtAtFrntMid1, ALgtAtFrntRi, ALgtAtFrntRi1, ALgtAtReLe, ALgtAtReLe1, ALgtAtReMid, ALgtAtReMid1, ALgtAtReRi, ALgtAtReRi1, ALgtOnDoorAtFrntLe, ALgtOnDoorAtFrntLe1, ALgtOnDoorAtFrntRi, ALgtOnDoorAtFrntRi1, ALgtOnDoorAtReLe, ALgtOnDoorAtReLe1, ALgtOnDoorAtReRi, ALgtOnDoorAtReRi1, ALgtStd, AOnBmpAtFrntLe, AOnBmpAtFrntLe1, AOnBmpAtFrntMid, AOnBmpAtFrntMid1, AOnBmpAtFrntMidLe, AOnBmpAtFrntMidLe1, AOnBmpAtFrntMidRi, AOnBmpAtFrntMidRi1, AOnBmpAtFrntRi, AOnBmpAtFrntRi1, AUpwAtCen, AUpwAtCen1, AUpwAtCenWithRngLo, AUpwAtCenWithRngMid, ActvtOfActrAirbFrntAtDrvr, ActvtOfActrAirbFrntAtPass, ActvtOfActrAirbFrntAtRowFirstMid, ActvtOfActrAirbSideAtDrvr, ActvtOfActrAirbSideAtPass, ActvtOfActrAirbSideAtRowSecLe, ActvtOfActrAirbSideAtRowSecRi, ActvtOfActrAirbSideAtRowThrdLe, ActvtOfActrAirbSideAtRowThrdRi, ActvtOfActrAnchrfitgTensnrAtDrvr, ActvtOfActrAnchrfitgTensnrAtPass, ActvtOfActrAnchrfitgTensnrAtRowFirstMid, ActvtOfActrAnchrfitgTensnrAtRowSecLe, ActvtOfActrAnchrfitgTensnrAtRowSecMid, ActvtOfActrAnchrfitgTensnrAtRowSecRi, ActvtOfActrAnchrfitgTensnrAtRowThrdLe, ActvtOfActrAnchrfitgTensnrAtRowThrdMid, ActvtOfActrAnchrfitgTensnrAtRowThrdRi, ActvtOfActrAntisubCushAtDrvr, ActvtOfActrAntisubCushAtPass, ActvtOfActrAntisubCushAtRowFirstMid, ActvtOfActrAntisubCushAtRowSecLe, ActvtOfActrAntisubCushAtRowSecMid, ActvtOfActrAntisubCushAtRowSecRi, ActvtOfActrAntisubCushAtRowThrdLe, ActvtOfActrAntisubCushAtRowThrdMid, ActvtOfActrAntisubCushAtRowThrdRi, ActvtOfActrAtApilLeForPedProtn, ActvtOfActrAtApilRiForPedProtn, ActvtOfActrAtBmpForPedProtn, ActvtOfActrAtHoodForPedProtn, ActvtOfActrAtRoofForPedProtn, ActvtOfActrBattCutOff, ActvtOfActrBltLimrAtDrvr, ActvtOfActrBltLimrAtPass, ActvtOfActrBltLimrAtRowFirstMid, ActvtOfActrBltLimrAtRowSecLe, ActvtOfActrBltLimrAtRowSecMid, ActvtOfActrBltLimrAtRowSecRi, ActvtOfActrBltLimrAtRowThrdLe, ActvtOfActrBltLimrAtRowThrdMid, ActvtOfActrBltLimrAtRowThrdRi, ActvtOfActrBltTensnrAtDrvr, ActvtOfActrBltTensnrAtPass, ActvtOfActrBltTensnrAtRowFirstMid, ActvtOfActrBltTensnrAtRowSecLe, ActvtOfActrBltTensnrAtRowSecMid, ActvtOfActrBltTensnrAtRowSecRi, ActvtOfActrBltTensnrAtRowThrdLe, ActvtOfActrBltTensnrAtRowThrdMid, ActvtOfActrBltTensnrAtRowThrdRi, ActvtOfActrBucRtrctrAtDrvr, ActvtOfActrBucRtrctrAtPass, ActvtOfActrBucRtrctrAtRowFirstMid, ActvtOfActrBucRtrctrAtRowSecLe, ActvtOfActrBucRtrctrAtRowSecMid, ActvtOfActrBucRtrctrAtRowSecRi, ActvtOfActrBucRtrctrAtRowThrdLe, ActvtOfActrBucRtrctrAtRowThrdMid, ActvtOfActrBucRtrctrAtRowThrdRi, ActvtOfActrCurtAirbAtLe, ActvtOfActrCurtAirbAtRi, ActvtOfActrFuCutOff, ActvtOfActrHdrestAtDrvr, ActvtOfActrHdrestAtPass, ActvtOfActrHdrestAtRowFirstMid, ActvtOfActrHdrestAtRowSecLe, ActvtOfActrHdrestAtRowSecMid, ActvtOfActrHdrestAtRowSecRi, ActvtOfActrHdrestAtRowThrdLe, ActvtOfActrHdrestAtRowThrdMid, ActvtOfActrHdrestAtRowThrdRi, ActvtOfActrKneeProtnAtDrvr, ActvtOfActrKneeProtnAtPass, ActvtOfActrKneeProtnAtRowFirstMid, ActvtOfActrPelvProtnAtDrvr, ActvtOfActrPelvProtnAtPass, ActvtOfActrPelvProtnAtRowSecLe, ActvtOfActrPelvProtnAtRowSecRi, ActvtOfActrPelvProtnAtRowThrdLe, ActvtOfActrPelvProtnAtRowThrdRi, ActvtOfActrRollbarAtLe, ActvtOfActrRollbarAtRi, ActvtOfActrThoraxAirbAtDrvr, ActvtOfActrThoraxAirbAtPass, ActvtOfActrThoraxAirbAtRowFirstMidToDrvr, ActvtOfActrThoraxAirbAtRowFirstMidToPass, ActvtOfActrThoraxAirbAtRowSecLe, ActvtOfActrThoraxAirbAtRowSecMidLe, ActvtOfActrThoraxAirbAtRowSecMidRi, ActvtOfActrThoraxAirbAtRowSecRi, ActvtOfActrThoraxAirbAtRowThrdLe, ActvtOfActrThoraxAirbAtRowThrdMidLe, ActvtOfActrThoraxAirbAtRowThrdMidRi, ActvtOfActrThoraxAirbAtRowThrdRi, BltLockStAtDrvr, BltLockStAtPass, BltLockStAtRowFirstMid, BltLockStAtRowSecLe, BltLockStAtRowSecMid, BltLockStAtRowSecRi, BltLockStAtRowThrdLe, BltLockStAtRowThrdMid, BltLockStAtRowThrdRi, ChgInfoOfBltLockSt, Crash, CtrlOfActrAirbFrntAtDrvr, CtrlOfActrAirbFrntAtPass, CtrlOfActrAirbFrntAtRowFirstMid, CtrlOfActrAirbSideAtDrvr, CtrlOfActrAirbSideAtPass, CtrlOfActrAirbSideAtRowSecLe, CtrlOfActrAirbSideAtRowSecRi, CtrlOfActrAirbSideAtRowThrdLe, CtrlOfActrAirbSideAtRowThrdRi, CtrlOfActrAnchrfitgTensnrAtDrvr, CtrlOfActrAnchrfitgTensnrAtPass, CtrlOfActrAnchrfitgTensnrAtRowFirstMid, CtrlOfActrAnchrfitgTensnrAtRowSecLe, CtrlOfActrAnchrfitgTensnrAtRowSecMid, CtrlOfActrAnchrfitgTensnrAtRowSecRi, CtrlOfActrAnchrfitgTensnrAtRowThrdLe, CtrlOfActrAnchrfitgTensnrAtRowThrdMid, CtrlOfActrAnchrfitgTensnrAtRowThrdRi, CtrlOfActrAntisubCushAtDrvr, CtrlOfActrAntisubCushAtPass, CtrlOfActrAntisubCushAtRowFirstMid, CtrlOfActrAntisubCushAtRowSecLe, CtrlOfActrAntisubCushAtRowSecMid, CtrlOfActrAntisubCushAtRowSecRi, CtrlOfActrAntisubCushAtRowThrdLe, CtrlOfActrAntisubCushAtRowThrdMid, CtrlOfActrAntisubCushAtRowThrdRi, CtrlOfActrAtApilLeForPedProtn, CtrlOfActrAtApilRiForPedProtn, CtrlOfActrAtBmpForPedProtn, CtrlOfActrAtHoodForPedProtn, CtrlOfActrAtRoofForPedProtn, CtrlOfActrBltLimrAtDrvr, CtrlOfActrBltLimrAtPass, CtrlOfActrBltLimrAtRowFirstMid, CtrlOfActrBltLimrAtRowSecLe, CtrlOfActrBltLimrAtRowSecMid, CtrlOfActrBltLimrAtRowSecRi, CtrlOfActrBltLimrAtRowThrdLe, CtrlOfActrBltLimrAtRowThrdMid, CtrlOfActrBltLimrAtRowThrdRi, CtrlOfActrBltTensnrAtDrvr, CtrlOfActrBltTensnrAtPass, CtrlOfActrBltTensnrAtRowFirstMid, CtrlOfActrBltTensnrAtRowSecLe, CtrlOfActrBltTensnrAtRowSecMid, CtrlOfActrBltTensnrAtRowSecRi, CtrlOfActrBltTensnrAtRowThrdLe, CtrlOfActrBltTensnrAtRowThrdMid, CtrlOfActrBltTensnrAtRowThrdRi, CtrlOfActrBucRtrctrAtDrvr, CtrlOfActrBucRtrctrAtPass, CtrlOfActrBucRtrctrAtRowFirstMid, CtrlOfActrBucRtrctrAtRowSecLe, CtrlOfActrBucRtrctrAtRowSecMid, CtrlOfActrBucRtrctrAtRowSecRi, CtrlOfActrBucRtrctrAtRowThrdLe, CtrlOfActrBucRtrctrAtRowThrdMid, CtrlOfActrBucRtrctrAtRowThrdRi, CtrlOfActrCurtAirbAtLe, CtrlOfActrCurtAirbAtRi, CtrlOfActrHdrestAtDrvr, CtrlOfActrHdrestAtPass, CtrlOfActrHdrestAtRowFirstMid, CtrlOfActrHdrestAtRowSecLe, CtrlOfActrHdrestAtRowSecMid, CtrlOfActrHdrestAtRowSecRi, CtrlOfActrHdrestAtRowThrdLe, CtrlOfActrHdrestAtRowThrdMid, CtrlOfActrHdrestAtRowThrdRi, CtrlOfActrKneeProtnAtDrvr, CtrlOfActrKneeProtnAtPass, CtrlOfActrKneeProtnAtRowFirstMid, CtrlOfActrPelvProtnAtDrvr, CtrlOfActrPelvProtnAtPass, CtrlOfActrPelvProtnAtRowSecLe, CtrlOfActrPelvProtnAtRowSecRi, CtrlOfActrPelvProtnAtRowThrdLe, CtrlOfActrPelvProtnAtRowThrdRi, CtrlOfActrThoraxAirbAtDrvr, CtrlOfActrThoraxAirbAtPass, CtrlOfActrThoraxAirbAtRowFirstMidToDrvr, CtrlOfActrThoraxAirbAtRowFirstMidToPass, CtrlOfActrThoraxAirbAtRowSecLe, CtrlOfActrThoraxAirbAtRowSecMidLe, CtrlOfActrThoraxAirbAtRowSecMidRi, CtrlOfActrThoraxAirbAtRowSecRi, CtrlOfActrThoraxAirbAtRowThrdLe, CtrlOfActrThoraxAirbAtRowThrdMidLe, CtrlOfActrThoraxAirbAtRowThrdMidRi, CtrlOfActrThoraxAirbAtRowThrdRi, DftlYawStabyCtrlIntvg, DispBltLockAck, DispBltLockReq, DispBltLockStOfDrvr, DispBltLockStOfPass, DispBltLockStOfRowFirstMid, DispBltLockStOfRowSecLe, DispBltLockStOfRowSecMid, DispBltLockStOfRowSecRi, DispBltLockStOfRowThrdLe, DispBltLockStOfRowThrdMid, DispBltLockStOfRowThrdRi, DispBucdStOfDrvr, DispBucdStOfOccptAtRowFirstMid, DispBucdStOfOccptAtRowSecLe, DispBucdStOfOccptAtRowSecMid, DispBucdStOfOccptAtRowSecRi, DispBucdStOfOccptAtRowThrdLe, DispBucdStOfOccptAtRowThrdMid, DispBucdStOfOccptAtRowThrdRi, DispBucdStOfPass, DoorStOfDoorLockReLe, DoorStOfDoorLockReRi, DoorStOfDrvrDoorLock, DoorStOfPassDoorLock, DstTrvld, EngN, EngSpd, ImpctLocnEstimdOfCrashAtFrnt, ImpctLocnEstimdOfCrashAtLe, ImpctLocnEstimdOfCrashAtRe, ImpctLocnEstimdOfCrashAtRi, OccptClassAtDrvr, OccptClassAtPass, OccptClassAtRowFirstMid, OccptClassAtRowSecLe, OccptClassAtRowSecMid, OccptClassAtRowSecRi, OccptClassAtRowThrdLe, OccptClassAtRowThrdMid, OccptClassAtRowThrdRi, OccptOutOfPosAtDrvr, OccptOutOfPosAtPass, OccptOutOfPosAtRowFirstMid, OccptOutOfPosAtRowSecLe, OccptOutOfPosAtRowSecMid, OccptOutOfPosAtRowSecRi, OccptOutOfPosAtRowThrdLe, OccptOutOfPosAtRowThrdMid, OccptOutOfPosAtRowThrdRi, OccptWghtMeasdAtDrvr, OccptWghtMeasdAtPass, OccptWghtMeasdAtRowFirstMid, OccptWghtMeasdAtRowSecLe, OccptWghtMeasdAtRowSecMid, OccptWghtMeasdAtRowSecRi, OccptWghtMeasdAtRowThrdLe, OccptWghtMeasdAtRowThrdMid, OccptWghtMeasdAtRowThrdRi, OccptWghtStdAtDrvr, OccptWghtStdAtPass, OccptWghtStdAtRowFirstMid, OccptWghtStdAtRowSecLe, OccptWghtStdAtRowSecMid, OccptWghtStdAtRowSecRi, OccptWghtStdAtRowThrdLe, OccptWghtStdAtRowThrdMid, OccptWghtStdAtRowThrdRi, OperMod, OutdT, PInDoorAtFrntLe, PInDoorAtFrntRi, PInDoorAtReLe, PInDoorAtReRi, PedCrashSevCalcd, PedCrashYposCalcd, PitchRateAtCen, PitchRateStd, PresStOfDrvr, PresStOfOccptAtRowFirstMid, PresStOfOccptAtRowSecLe, PresStOfOccptAtRowSecMid, PresStOfOccptAtRowSecRi, PresStOfOccptAtRowThrdLe, PresStOfOccptAtRowThrdMid, PresStOfOccptAtRowThrdRi, PresStOfPass, RollRateAtCen, RollRateStd, SeatBltRmnAcoustWarnReq, SeatBltRmnFrqCtrlAcoustWarn, SeatBltRmnLdnCtrlAcoustWarn, SeatBltRmnOpticWarnReq, SeatBltRmnWarnSt, SeatFixaStOfDrvrSeat, SeatFixaStOfPassSeat, SeatFixaStOfSeatRowFirstMid, SeatFixaStOfSeatRowSecLe, SeatFixaStOfSeatRowSecMid, SeatFixaStOfSeatRowSecRi, SeatFixaStOfSeatRowThrdLe, SeatFixaStOfSeatRowThrdMid, SeatFixaStOfSeatRowThrdRi, SpdLatEstimdByEsc, SteerWhlAgStd, TAtBmp, VehBodyAVertMeasdStd, VehCrashPitchovrDetd, VehCrashRollovrDetd, VehCrashSevCalcdAtFrnt, VehCrashSevCalcdAtLe, VehCrashSevCalcdAtRe, VehCrashSevCalcdAtRi, VehMtnSt, VehSpdLgt, YawRateStdByEsc]
  collection OccptPedSftyRefAllToOccptPedSfty: category=RELATION, element-role=AUTO_COLLECTED_FROM, element=OccptPedSfty, source-element=OccptPedSftyRefAll
