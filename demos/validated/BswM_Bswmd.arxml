AUTOSAR XML (schema 4-0-3)
package /AUTOSAR_BswM/BswModuleDescriptions
  bsw module description BswM: module-id=34, provided-entrys=[BswM_Init, BswM_MainFunction]
    bsw internal behavior InternalBehavior_0: data-type-mapping=BswMModeMapping
      exclusive area SCHM_BSWM_EXCLUSIVE_AREA
      entities:
        bsw schedulable entity BswM_MainFunction: can-enter-exclusive-area=SCHM_BSWM_EXCLUSIVE_AREA, implemented-entry=BswM_MainFunction
      bsw timing event TimingEvent_MainFunction: starts-on-event=BswM_MainFunction, period=0.02
package /AUTOSAR_BswM/BswModuleEntrys
  bsw module entry BswM_Init: call-type=REGULAR, execution-context=UNSPECIFIED, is-reentrant=false, is-synchronous=true, service-id=0, sw-service-impl-policy=STANDARD
  bsw module entry BswM_MainFunction: call-type=SCHEDULED, execution-context=TASK, is-reentrant=false, is-synchronous=true, service-id=3, sw-service-impl-policy=STANDARD
package /AUTOSAR_BswM/SwcBswMappings
  swc bsw mapping SwcBswMapping_0: bsw-behavior=InternalBehavior_0, swc-bsw-runnable-mapping{bsw-entity=BswM_MainFunction, swc-runnable=RES_MainFunction}, swc-behavior=BswMInternalBehavior
package /EB_BswM_TxDxM1I14R0/Implementations
  bsw implementation BswImplementation_0: programming-language=C, swc-bsw-mapping=SwcBswMapping_0, sw-version=1.14.1, vendor-id=1, ar-release-version=4.0.3, behavior=InternalBehavior_0, vendor-specific-module-def=BswM
    code-descriptors:
      code Files
        artifact-descriptors:
          short-label=Autosar::include::BswM.h, category=SWHDR
          short-label=Autosar::include::BswM_Int.h, category=SWHDR
          short-label=Autosar::include::BswM_SymbolicNames_PBcfg.h, category=SWHDR
          short-label=Autosar::include::BswM_Types.h, category=SWHDR
          short-label=Autosar::include::BswM_Version.h, category=SWHDR
          short-label=Autosar::src::BswM.c, category=SWSRC
          short-label=generated::include::BswM_CanSM.h, category=SWHDR
          short-label=generated::include::BswM_Cfg.h, category=SWHDR
          short-label=generated::include::BswM_CfgTypes.h, category=SWHDR
          short-label=generated::include::BswM_ComM.h, category=SWHDR
          short-label=generated::include::BswM_EcuM.h, category=SWHDR
          short-label=generated::include::BswM_Int_Cfg.h, category=SWHDR
          short-label=generated::include::BswM_Lcfg.h, category=SWHDR
          short-label=generated::include::BswM_MemMap.h, category=SWHDR
          short-label=generated::include::BswM_PBcfg.h, category=SWHDR
          short-label=generated::include::BswM_Trace.h, category=SWHDR
          short-label=generated::src::BswM_Cfg.c, category=SWSRC
          short-label=generated::src::BswM_Lcfg.c, category=SWSRC
          short-label=generated::src::BswM_PBcfg.c, category=SWSRC
          short-label=make::BswM_defs.mak, category=SWMAKE
          short-label=make::BswM_rules.mak, category=SWMAKE
    resource consumption ResourceConsumption
      8 x memory section:
        CODE: sw-addrmethod=CODE
        CONFIG_DATA_UNSPECIFIED: alignment=UNSPECIFIED, sw-addrmethod=CONFIG_DATA
        CONST_UNSPECIFIED: alignment=UNSPECIFIED, sw-addrmethod=CONST
        INTERNAL_VAR_POWER_ON_INIT_UNSPECIFIED: alignment=UNSPECIFIED, sw-addrmethod=VAR_POWER_ON_INIT
        VAR_INIT_UNSPECIFIED: alignment=UNSPECIFIED, sw-addrmethod=VAR_INIT
        VAR_NO_INIT_8: alignment=8, sw-addrmethod=VAR_NOINIT
        VAR_NO_INIT_UNSPECIFIED: alignment=UNSPECIFIED, sw-addrmethod=VAR_NOINIT
        VAR_POWER_ON_INIT_32: alignment=32, sw-addrmethod=VAR_POWER_ON_INIT
