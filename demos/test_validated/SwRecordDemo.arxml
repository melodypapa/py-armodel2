AUTOSAR XML (schema 4-3-0)
package /demo/common/datatypes
  sw record layout RecordLayoutDescriptor: sw-record-layout-group={short-label=RecordDescriptorGroup, sw-record-layout-group={short-label=Chars, sw-record-layout-group-axis=STRING, sw-record-layout-group-from=0, sw-record-layout-group-to=-1, sw-record-layout-v={short-label=Char, base-type=sint8, sw-record-layout-v-prop=VALUE}}, sw-record-layout-v={short-label=Size, base-type=uint16, sw-record-layout-v-axis=STRING, sw-record-layout-v-prop=COUNT}}
