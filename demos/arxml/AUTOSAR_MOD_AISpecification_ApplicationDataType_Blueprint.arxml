AUTOSAR XML (schema 00050)
package /AUTOSAR/AISpecification/ApplicationDataTypes_Blueprint
  48 x application record data type, all with category=STRUCTURE, sw-calibration-access=READ-ONLY:
    AFbForCmft1  # Acceleration Feedback for Comfort | Cluster of information regarding acceleration and acceleration saturation feedbacks
      5 x application record element:
        AMinWoBrkAndShift: type=A1  # Lowest acceleration (often negative, i.e. deceleration) which can be requested before Brake or Shift takes place.
        AMaxWoShift: type=A1  # Highest acceleration which can be requested before Shift takes place.
        BrkActrSatn: type=BrkActrSatn1  # Indicates that a brake actuator is in saturation mode.
        ActrADbndLowr: type=A7  # Information about how much lower acceleration request has to be relative to the internal controller value (Vehicle Longitudinal Control (VLC) actual acceleration), before reduction in acceleration can be expected. Actuator working point dependent, e.g. when brake is close to be engaged, the brake transition behaviour will be reflected.
        ActrADbndUppr: type=A7  # Information about how much higher acceleration request has to be relative to the internal controller value (Vehicle Longitudinal Control (VLC) actual acceleration), before increase in acceleration can be expected. Actuator working point dependent.
    AReqForCmft1  # Acceleration Request for Comfort 1 | Cluster of attributes regarding requested acceleration and jerk requests. This information is used for comfort reasons
      6 x application record element:
        AReq: type=A1  # Acceleration which is desired if obtainable within comfort limits.
        TolrLowrOfAReq: type=A7  # Allowed acceleration offset below Acceleration Request. Allowable from comfort point of view.
        TolrUpprOfAReq: type=A7  # Allowed acceleration offset above Acceleration Request. Allowable from comfort point of view.
        AReqSt: type=ReqSt2  # Information about the status of Acceleration Request. Only expresses the functional aspects, neither error handling, diagnose nor fail-safe. 0: Acceleration Request enable 1: Acceleration Request disable
        JerkMinReq: type=Jerk1  # Minimum acceleration change rate which is acceptable from function point of view. E.g. from traffic point of view if Follow Control is sender of request.
        JerkMaxReq: type=Jerk1  # Maximum acceleration change rate which is acceptable from function point of view. E.g. from traffic point of view if Follow Control is sender of request.
    ActrSt1  # Actuator Status | Status of a moving actuator
      application record element AxisPosn: type=Perc9  # Current position of the actuator
      application record element AxisMovmt: type=MovmtTyp1  # Current movement type of the actuator
      application record element SpdHi: type=OnOff1  # Current speed of the actuator
    ActrSts1  # Actuator Status | Status of a moving actuator
      application record element AxisPosn: type=Perc9  # Current position of the actuator
      application record element AxisMovmt: type=MovmtTyp1  # Current movement type of the actuator
      application record element SpdHi: type=OnOff1  # Current speed of the actuator
    AdjAut1  # Adjust Automatic | Memory button (1..5) Adjust Position {Off, store, recall}
      application record element MemBtn: type=MemBtn1
      application record element AdjOper: type=Oper1
    AuthnData1  # Authorization Data | Represents the data required for key learning and authorization process.
      6 x application record element:
        AuthnCmd: type=KeyCmd1  # Command
        AuthnSt: type=KeySt1  # Status
        SndInfo: type=CptInfo1  # Information about the requestor for key learning/authorization
        RxrInfo: type=CptInfo1  # Information about the receiver for key learning/authorization
        KeyLen: type=Nr10  # Number of bits of encryption used. For e.g. 256-bit encryption has a KeyLen of 256. It specifies the length of the key passed in element KeyForSecu.
        KeyForSecu: type=KeyForSecu1  # Secure Key
    BriCmd1  # Brightness Command | Ramp defines a certain "change rate" with which the given percentage value shall be reached. (No ramp means the brightness value shall be effective immediately).
      application record element Bri: type=Perc2
      application record element Ramp: type=Ramp1
    DateTi1  # Date Time | Represents a point in time.
      6 x application record element:
        Hr: type=Hr1
        Mins: type=Mins1
        Sec: type=Sec1
        Day: type=Day1
        Mth: type=Mth1
        Yr: type=Yr1
    DiagcBri1  # Diagnostic Brightness | Sets a certain brightness via a diagnostic request.
      application record element Bri: type=Perc2
      application record element Diagc: type=OnOff1
    DiagcChdProtn1  # Diagnostic Child Protection | Diagnostic of the status of the child protection. States if the child protection is working or not.
      application record element ChdProtn: type=ChdProtnCmd1
      application record element Diagc: type=OnOff1
    DiagcLock1  # Diagnostic Lock | Diagnostic of the status of the locking. States if the lock is working or not.
      application record element Lock: type=LockActvn1
      application record element Diagc: type=OnOff1
    DiagcPullAid1  # Diagnostic Pull Aid | Diagnostic of the status of the pull aid of the door locking mechanism. States if the pull aid is working or not.
      application record element PullAid: type=PullAidCmd1
      application record element Diagc: type=OnOff1
    DiagcSt1  # Diagnostic Status | Generic diagnostic status 1
      application record element Req: type=OnOff1
      application record element Diagc: type=OnOff1
    DiagcSts1  # Diagnostic Status | Generic diagnostic status 1
      application record element Req: type=OnOff1
      application record element Diagc: type=OnOff1
    IndcrPatCmd1  # Indicator Pattern Command | Definition of indicator pattern number and on/off time
      application record element IndcrPatCmd: type=Nr5  # Indicator Pattern number 0 to 7
      application record element TiOn: type=Ti3  # On Time (s)
      application record element TiOff: type=Ti3  # Off Time (s)
    IndcrTurnSeq1  # Indicator Turn Sequence | Represents the turn indicator sequence description
      5 x application record element:
        IndcrTrig: type=IndcrSt1  # the trigger for the blink functionality (stop, left, right, both)
        IndcrTelltl: type=OnOff1  # telltale on/off
        IndcrNrPat: type=Nr5  # provides the pattern handle which has to be used during the current blink sequence (0..7)
        IndcrCycForStop: type=IndcrForStop1  # CASE indicator_trigger==stop: 0=hardstop, 1=softstop on ON phase, 2=softstop on OFF phase
        IndcrCycNotStop: type=Nr7  # CASE indicator_trigger!=stop: 0=indefinite, 1..3=number of remaining cycles to be executed without re-triggering
    LockgCenInfoReq1  # Locking Central Information Request | Request for central locking activation
      application record element ReqdActn: type=LockgCenReq1  # Request to activate Central Locking
      application record element DetnSrc: type=LockgCenReqSrc1  # Source for Central Locking activation
    LockgCenSt1  # Locking Central Status | Status of the Central Locking. The status undefined is valid if there are no feedback switches in the latch and the ECU lost the information of actual status
      application record element LockgSt: type=LockSt2
      application record element TrigSrc: type=LockTrigSrc1
    LockgCenSts1  # Locking Central Status | Status of the Central Locking. The status undefined is valid if there are no feedback switches in the latch and the ECU lost the information of actual status
      application record element LockgSt: type=LockSts2
      application record element TrigSrc: type=LockTrigSrc1
    MemOfMirrPosn1  # Memory of Mirror Position | Represents the position of a mirror's axis specific for a profile. Can be used as a request and as a status information.
      4 x application record element:
        MirrTyp: type=MirrTyp1
        AxisTyp: type=AxisTyp1
        MirrProf: type=ProfPenSt1
        Posn: type=Perc7
    MirrActnSt1  # Mirror Action Status | Transporting feedback from a mirror (identified by MirrTyp) regarding its current action being executed (MovmtTyp)
      application record element MirrTyp: type=MirrTyp1
      application record element MovmtTyp: type=MovmtTyp1
    MirrActnSts1  # Mirror Action Status | Transporting feedback from a mirror (identified by MirrTyp) regarding its current action being executed (MovmtTyp)
      application record element MirrTyp: type=MirrTyp1
      application record element MovmtTyp: type=MovmtTyp1
    MirrAxisMovmt1  # Mirror Axis Movement | Defines the motion of a specific axis of a specific mirror
      application record element MirrTyp: type=MirrTyp1
      application record element AxisTyp: type=AxisTyp1
      application record element MovmtTyp: type=MovmtTyp1
    MirrAxisPosn1  # Mirror Axis Position | Represents a position of an axis of a certain mirror. Can be used for status inquiries or for requests.
      application record element MirrTyp: type=MirrTyp1
      application record element AxisTyp: type=AxisTyp1
      application record element Posn: type=Perc7
    MirrPanAdjAutReq1  # Mirror Panel Adjust Automatic Request | Transports atomically a profile and a command
      application record element MirrProf: type=ProfPenSt1
      application record element Oper: type=Oper1
    MirrProf1  # Mirror Profile | Associates a certain profile with a specific mirror. Can be used to request a mirror movement or to store a mirror position.
      application record element MirrTyp: type=MirrTyp1
      application record element MirrProf: type=ProfPenSt1
    MirrTintgCmd1  # Mirror Tinting Command | Represents a desired tinting value (in position) for a given mirror.
      application record element MirrTyp: type=MirrTyp1
      application record element Posn: type=Perc7
    ObjData1  # Object Data | Cluster of object attributes detected by surroundings sensors. This information is used e.g. for Adaptive Cruise Control (ACC), but is not limited to this use case only
      15 x application record element:
        DplLgt: type=Len7  # Distance between the sensor and the object.
        DplLat: type=Len10  # Lateral distance between the center of the sensor and the object.
        SpdLgtRel: type=Spd5  # Longitudinal speed difference between the ego vehicle and the object.
        DynPpty: type=DynPpty1  # Status which indicates the dynamic property of the object (e.g. stationary, moving, etc). Standing: has never been detected moving. Stopped: has been detected moving, but is stationary now. Moving: object has absolute speed in any direction. The definition is made according to the earth-fixed axis system as defined in ISO 8855.
        StOfObjMeasd: type=StOfObjMeasd1  # Status which indicates whether the object was measured in current cycle, or only tracked.
        ObjId: type=Nr2  # Unique number for each object which has been tracked. The object keeps the same ID as long as it is output in the list. When an object dies, the ID can be reused for a new object. When a new object appears, for one cycle the attribute "object is new" is set. ID=0 is reserved for "no object".
        SpdLatRel: type=Spd6  # Lateral speed difference between the ego vehicle and the object.
        ALgtRel: type=A10  # Longitudinal acceleration difference between the ego vehicle and the object.
        ALatRel: type=A10  # Lateral acceleration difference between the ego vehicle and the object.
        Width: type=Len11  # Lateral length of the object.
        Hei: type=Len11  # Vertical length of the object from the ground.
        Len: type=Len11  # Longitudinal length of the object.
        Orntn: type=Ag6  # Yaw angle of the object. Coordinate system according to ISO 8855.
        ObjClassn: type=ObjClassn1  # Class which indicates vehicle types (e.g. truck, passenger car, etc.)
        DataQly: type=Perc2  # Quality of object data. This value decreases if the quality is poor (e.g. because of weather condition, object reflectivity). Scaling will be dependent on type of sensor and signal processing algorithm, therefore requires application of parameters on receiving function side.
    ObjDataRlvForFolwCtrl1  # Object Data Relevant for Follow Control | Cluster of relevant object attributes for Follow Control.
      15 x application record element:
        DplLgt: type=Len7  # Distance between front edge of the ego vehicle and the object.
        SpdLgtRel: type=Spd5  # Longitudinal speed difference between the ego vehicle and the object.
        DynPpty: type=DynPpty1  # Status which indicates the dynamic property of the object (e.g. stationary, moving, etc). Standing: has never been detected moving. Stopped: has been detected moving, but is stationary now. Moving: object has absolute speed in any direction. The definition is made according to the earth-fixed axis system as defined in ISO 8855.
        ObjId: type=Nr2  # Unique number for each object which has been tracked. The object keeps the same ID as long as it is output in the list. When an object dies, the ID can be reused for a new object. When a new object appears, for one cycle the attribute "object is new" is set. ID=0 is reserved for "no object".
        DplLat: type=Len10  # Lateral distance between the center of the ego vehicle and the object.
        SpdLatRel: type=Spd6  # Lateral speed difference between the ego vehicle and the object.
        ALgtRel: type=A10  # Longitudinal acceleration difference between the ego vehicle and the object.
        StOfObjMeasd: type=StOfObjMeasd1  # Status which indicates whether the object was measured in current cycle, or only tracked.
        ObstrcnProblty: type=Fac7  # Probability that obstacle can not be overrun, or can not be driven over it.
        LaneProblty: type=Fac7  # Probability of the potential target object to be located in the driving corridor, or predicted vehicle course.
        CutInProblty: type=Fac7  # Probability of the potential target object for cutting in the driving corridor, or predicted vehicle course.
        ObjRlvc: type=Fac7  # Measure of the plausibility as target object for Adaptive Cruise Control (ACC), which means that this measure increases if Lane Probability keeps high.
        ObjRlvcUpprLim: type=Fac7  # Upper limit of object relevance. Above this limit the object becomes target object for Adaptive Cruise Control (ACC).
        ObjRlvcLowrLim: type=Fac7  # Lower limit of object relevance. Below this limit the object is not the target object for Adaptive Cruise Control (ACC).
        DstMaxForFolwCtrl: type=Len7  # Maximum distance for the relevant object to become the target object for Follow Control.
    ObjTarSelnForFolwCtrl1  # Object Target Selection for Follow Control | List of relevant object attributes and prioritisation of objects for Follow Control.
      application record element ListOfObjDataRlvForFolwCtrl: type=ListOfObjDataRlvForFolwCtrl1  # List of relevant object attributes for Follow Control.
      application record element PrioOfObj: type=PrioOfObj1  # Priority of target object for follow control is given by array position (higher priority with lower array index). If no particular object is selected, then ID=0 will be sent.
    ObstclDstInPrkgSeg1  # Obstacle Distance In Parking Segment | Distance to obstacle detected and measured by ultrasonic sensors.
      application record element ObstclSt: type=ObstclDstInPrkgSegSt1  # Status of distance to obstacle detected and measured by ultrasonic sensors.
      application record element ObstclDst: type=Len14  # Distance to obstacle detected and measured by ultrasonic sensors.
    RoadExct1  # Road Excitation 1 | Vertical wheel oscillation amplitude and frequency (wheel and tire) (based on acceleration or displacement)
      application record element Amp: type=Len4  # amplitude
      application record element Frq: type=Frq1  # frequency
    SeatMassgProg1  # Seat Massage Program | Defines the seat massage programs which are selected by the user.
      4 x application record element, all with type=OnOff1:
        Massg{0..3}
    SeatMove1  # Seat Move | Seat move data record
      application record element Dir: type=MovmtTyp1  # (off; increase; decrease) "Inc" refers to movement towards 100% position (large person). "Dec" refers to movement towards 0% position (small person).
      application record element Spd: type=Perc2  # (0..100%)
    SeatMoveAut1  # Seat Move Automatic | Auto move data record
      application record element SeatProf: type=Nr6  # 0 means no profile selected; the seat profile includes last memory profile, easy entry profile, selection button profile and profile person from key, Hmi, ...
      application record element SpdHi: type=OnOff1  # If it is clear, that the driver is outside the car (e.g. easy entry) it may be necessary to move the seat very fast. In this case 'high speed' indicates this situation
    SeatStorgPosn1  # Seat Storage Position | Defines a seat storage position of a single axis
      application record element SeatProf: type=Nr6  # 0 means no profile selected; the seat profile includes last memory profile, easy entry profile, selection button profile and profile person from key, Hmi, ...
      application record element AxisPosn: type=Perc9  # Requested position (0-100% in 0.1% steps, 100.1 % means don't care)
    SnsrAlrmCmd1  # Sensor Alarm Command | Separate commands for each sensor: arm, disarm, arm immediate, exclude
      4 x application record element:
        ArmCmd: type=ReqSt1  # 0-no arming command 1-arming command
        DisarmCmd: type=ReqSt1  # 0-no disarming command 1-disarming command
        SnsrExclsn: type=OnOff1  # 0-exclude 1-not exclude
        ArmImdtCmd: type=ReqSt1  # 0-no command to immediate arming 1-command for immediate arming
    SnsrAlrmSt1  # Sensor Alarm Status | internal data exchanged between alarm sub-components, showing the status for each sensor; such elements could be grouped in an array showing 'All sensors status'
      4 x application record element:
        ActvSt: type=OnOff1  # 1-Active/ 0-inactive (e.g. door open/closed)
        Arming: type=ArmingTyp3  # 0-disarmed 1-armed
        SnsrExclsn: type=OnOff1  # 0-excluded by driver 1-not excluded by driver (not configured or excluded by driver - not able to trigger alarms in this armed session - i.e. until disarmed and armed again)
        SnsrAlrmReq: type=ReqSt1  # 0-not requesting alarm 1-Requesting alarm
    SnsrAlrmSts1  # Sensor Alarm Status | internal data exchanged between alarm sub-components, showing the status for each sensor; such elements could be grouped in an array showing 'All sensors status'
      4 x application record element:
        ActvSt: type=OnOff1  # 1-Active/ 0-inactive (e.g. door open/closed)
        Arming: type=ArmingTyp3  # 0-disarmed 1-armed
        SnsrExclsn: type=OnOff1  # 0-excluded by driver 1-not excluded by driver (not configured or excluded by driver - not able to trigger alarms in this armed session - i.e. until disarmed and armed again)
        SnsrAlrmReq: type=ReqSts1  # 0-not requesting alarm 1-Requesting alarm
    SnsrCtrl1  # Sensor Control | commands for inclination sensor device, sent through corresponding complex device driver
      application record element ArmCmd: type=ReqSt1  # 0-no arming command requested 1-arming command requested
      application record element DisarmCmd: type=ReqSt1  # 0-no disarming command requested 1-disarming command requested
      application record element Snvty: type=Nr3  # Configuration of sensor sensitivity
    SnsrSt1  # Sensor Status | Status of sensor device
      6 x application record element:
        Arming: type=ArmingTyp2  # 0-disarmed 1-armed 2-arming not finished 3-arming finished
        SnsrExclsn: type=OnOff1  # 0-excluded by driver 1-not excluded by driver
        SelfTest: type=DevErrSt2  # 0-no self test failure 1-selftest failure
        AlrmByCom: type=ReqSt1  # 0-no alarm request due to communication line 1-alarm request due to communication line cut
        AlrmByIncln: type=DetnSt1  # 0-no alarm by inclination detected 1-alarm by inclination detected
        Snvty: type=Nr3  # Configuration of sensor sensitivity.
    SnsrSts1  # Sensor Status | Status of sensor device
      6 x application record element:
        Arming: type=ArmingTyp2  # 0-disarmed 1-armed 2-arming not finished 3-arming finished
        SnsrExclsn: type=OnOff1  # 0-excluded by driver 1-not excluded by driver
        SelfTest: type=DevErrSts2  # 0-no self test failure 1-selftest failure
        AlrmByCom: type=ReqSts1  # 0-no alarm request due to communication line 1-alarm request due to communication line cut
        AlrmByIncln: type=DetnSts1  # 0-no alarm by inclination detected 1-alarm by inclination detected
        Snvty: type=Nr3  # Configuration of sensor sensitivity.
    SoundrBattBackedCmd1  # Sounder Battery Backed Command | commands for Battery Backed Sounder (BBS) device, sent through corresponding complex device driver
      7 x application record element:
        ArmCmd: type=ReqSt1  # 0-no arming command 1-arming command
        DisarmCmd: type=ReqSt1  # 0-no disarming command 1-disarming command
        SoundOn: type=OnOff1  # 0-no start sounding 1-start sounding
        SoundOff: type=OnOff1  # 0-no stop sounding 1-stop sounding
        ChrgOn: type=OnOff1  # 0-no start charging 1-start charging
        ChrgOff: type=OnOff1  # 0-no stop charging 1-stop charging
        ChirpTyp: type=Nr2  # Chirp type
    SoundrBattBackedSt1  # Sounder Battery Backed Status | status reported by the battery backed sounder device, received through associated complex device driver - if physical communication line between Battery Backed Sounder (BBS) and Alarm is interrupted while alarm is armed, alarm warning is triggered - if Battery Backed Sounder (BBS) is discharged and ignition is turned on, the Alarm starts recharging procedure
      9 x application record element:
        Arming: type=ArmingTyp2  # 0-disarmed 1-armed 2-arming not finished 3-arming finished
        SnsrExclsn: type=OnOff1  # 0-excluded by driver 1-not excluded by driver
        SelfTest: type=DevErrSt2  # 0-no self test failure 1-selftest failure
        AlrmByLineCut: type=DevErrSt2  # Alarm due to communication line cut 0-no communication line cut 1-alarm due to communication line cut
        AlrmByGndLineCut: type=DevErrSt2  # Alarm due to ground line cut 0-no ground line cut 1-alarm due to ground line cut
        AlrmByPwrSplyCut: type=DevErrSt2  # Alarm due to power line cut 0-no power line cut 1-alarm due to power line cut
        AlrmByTrigExt: type=DevErrSt2  # 0-no external trigger 1-alarm due to external trigger
        Chrgn: type=OnOff2  # 0-charging 1-not charging
        Dcha: type=OnOff2  # 0-discharged 1-not discharged
    SoundrBattBackedSts1  # Sounder Battery Backed Status | status reported by the battery backed sounder device, received through associated complex device driver - if physical communication line between Battery Backed Sounder (BBS) and Alarm is interrupted while alarm is armed, alarm warning is triggered - if Battery Backed Sounder (BBS) is discharged and ignition is turned on, the Alarm starts recharging procedure
      9 x application record element:
        Arming: type=ArmingTyp2  # 0-disarmed 1-armed 2-arming not finished 3-arming finished
        SnsrExclsn: type=OnOff1  # 0-excluded by driver 1-not excluded by driver
        SelfTest: type=DevErrSts2  # 0-no self test failure 1-selftest failure
        AlrmByLineCut: type=DevErrSts2  # Alarm due to communication line cut 0-no communication line cut 1-alarm due to communication line cut
        AlrmByGndLineCut: type=DevErrSts2  # Alarm due to ground line cut 0-no ground line cut 1-alarm due to ground line cut
        AlrmByPwrSplyCut: type=DevErrSts2  # Alarm due to power line cut 0-no power line cut 1-alarm due to power line cut
        AlrmByTrigExt: type=DevErrSts2  # 0-no external trigger 1-alarm due to external trigger
        Chrgn: type=OnOff2  # 0-charging 1-not charging
        Dcha: type=OnOff2  # 0-discharged 1-not discharged
    VehHldReq1  # Vehicle Hold Request 1 | Set of vehicle hold command and its validation
      application record element VehHldReq: type=ReqSt1  # Indicates whether a vehicle hold is requested 0 : No hold request 1 : Hold request
      application record element VlcReqSt: type=InvldVld2  # Indicates a failure state of request 00: valid command 01: invalid command
    WhlEdgeRisng1  # Edge Rising Wheel | Rising Edges of the wheel speed sensors.
      application record element TiStamp: type=TiStamp1  # Time Stamp
      application record element NrOfEdge: type=Nr2  # Number of Edges
      application record element St: type=DevErrSt2  # Status: 0=ok, 1=buffer overflow
    WipgAutReqFrnt1  # Wiping Automatic Request Front | This type represents an wiping request for the front windscreen, issued automatically by e.g. a rain-sensor.
      application record element WipgMod: type=Wipg1  # The requested wiping mode.
      application record element WipgImdt: type=OnOff1  # If "on" the provided wiping mode shall be set immediately (and not after the next cycle of the wiper).
  42 x application array data type, all with category=ARRAY, sw-calibration-access=READ-ONLY:
    AbsCtrlActvPerWhl1  # ABS Control Active per Wheel 1 | Antilock Braking System (ABS) control is active. (e.g. information for Roll Stability System (RSC)) | The convention is 0 = Wheel is not in Antilock Braking System (ABS) control, 1 = Wheel is in Antilock Braking System (ABS) control Index 0 = Front left Index 1 = Front right Index 2 = Rear left Index 3 = Rear right
      element AbsCtrlActvPerWhl1: type=CtrlSt1, array-size-semantics=FIXED-SIZE, max-number-of-elements=4
    AxlePOfTirePMon1  # Pressure Axle of TPMS 1 | Indication of the monitored axle individual target pressure. | The convention is: Index 0 = front axle Index 1 = rear axle
      element AxlePOfTirePMon1: type=P1, array-size-semantics=FIXED-SIZE, max-number-of-elements=2
    BrkActrSatnPerWhl1  # Brake Actuator Saturation per Wheel | Indicates whether the brake actuator is in saturation or not. | Convention is: Index 0 = Front Left Index 1 = Front Right Index 2 = Rear Left Index 3 = Rear Right
      element BrkActrSatnPerWhl1: type=BrkActrSatn1, array-size-semantics=FIXED-SIZE, max-number-of-elements=4
    BrkYawCtrlActvPerWhl1  # Brake Yaw Control Active per Wheel 1 | Wheel is in yaw stability brake control. (e.g. information for Roll Stability Control (Rsc) and Suspension (Susp)) | The convention is 0 = No brake intervention from yaw control 1 = Wheel is in yaw stability brake control Index 0 = Front left Index 1 = Front right Index 2 = Rear left Index 3 = Rear right
      element BrkYawCtrlActvPerWhl1: type=CtrlSt1, array-size-semantics=FIXED-SIZE, max-number-of-elements=4
    BypSlipCtrlReqPerWhl1  # Bypass Slip Control Request per Wheel | Request to inhibit internal Electronic Stability Control (ESC) slip control. | Convention is: Index 0 = Front Left Index 1 = Front Right Index 2 = Rear Left Index 3 = Rear Right
      element BypSlipCtrlReqPerWhl1: type=CtrlSt1, array-size-semantics=FIXED-SIZE, max-number-of-elements=4
    CtrlOvrdnByRscPerWhl1  # Control Overridden by Roll Stability Control per Wheel 1 | Control is overridden by Roll Stability Control: | Convention is: 0: not overridden 1: overridden Index 0 = Front Left Index 1 = Front Right Index 2 = Rear Left Index 3 = Rear Right
      element CtrlOvrdnByRscPerWhl1: type=OvrdnSt1, array-size-semantics=FIXED-SIZE, max-number-of-elements=4
    DamprCoeffPerWhl1  # Damper Coefficient per Wheel 1 | Damper Coefficient per wheel. | Convention is: Index 0 = Front Left Index 1 = Front Right Index 2 = Rear Left Index 3 = Rear Right
      element DamprCoeffPerWhl1: type=DamprCoeff1, array-size-semantics=FIXED-SIZE, max-number-of-elements=4
    DamprFPerWhl1  # Damper Force per Wheel | Damper Force. | Convention is: Index 0 = Front Left Index 1 = Front Right Index 2 = Rear Left Index 3 = Rear Right
      element DamprFPerWhl1: type=F2, array-size-semantics=FIXED-SIZE, max-number-of-elements=4
    DamprRatePerWhl1  # Damper Rate per Wheel | Damper rate for active damper systems. | Convention is: Index 0 = Front Left Index 1 = Front Right Index 2 = Rear Left Index 3 = Rear Right
      element DamprRatePerWhl1: type=Perc2, array-size-semantics=FIXED-SIZE, max-number-of-elements=4
    KeyForSecu1  # Security Key | Contains the encrypted key used for authentication/learning. | Depending on the encryption used, the number of data elements can vary.
      element KeyForSecu1: type=Nr2, array-size-semantics=FIXED-SIZE, max-number-of-elements=64
    ListOfObjData1  # List of Object Data | List of object attributes detected by forward looking sensor
      element ListOfObjData1: type=ObjData1, array-size-semantics=FIXED-SIZE, max-number-of-elements=32
    ListOfObjDataRlvForFolwCtrl1  # List of Object Data Relevant for Follow Control | List of relevant object attributes for Follow Control.
      element ListOfObjDataRlvForFolwCtrl1: type=ObjDataRlvForFolwCtrl1, array-size-semantics=FIXED-SIZE, max-number-of-elements=5
    LocnOfImpctAtCrash1  # Location of Impact at Crash | Bit Array to announce location of impact | Index 0 = left (front or rear impact - locking in driving direction) or rear (left or right impact) Index 1 = Center Index 2 = right (front or rear impact - locking in driving direction) or front (left or right impact)
      element LocnOfImpctAtCrash1: type=ImpctSt1, array-size-semantics=FIXED-SIZE, max-number-of-elements=3
    PrioOfObj1  # Prioritisation of Objects | Priority of target object for follow control is given by array position (higher priority with lower array index). If no particular object is selected, then ID=0 will be sent.
      element PrioOfObj1: type=Nr2, array-size-semantics=FIXED-SIZE, max-number-of-elements=16
    PtTqDistbnPerWhl1  # Powertrain Torque Distribution per Wheel | Generic data type to represent the torque distribution at four wheels. The sum of all 4 values must be 100%. | Convention is: Index 0 = Front Left Index 1 = Front Right Index 2 = Rear Left Index 3 = Rear Right
      element PtTqDistbnPerWhl1: type=Perc1, array-size-semantics=FIXED-SIZE, max-number-of-elements=4
    RscCtrlIntvgPerWhl1  # RSC Control Intervening per Wheel 1 | Wheel has roll stability control intervening: | Convention is: 0 = Roll Stability Control (RSC) not in control 1 = Roll Stability Control (RSC) in control Index 0 = Front Left Index 1 = Front Right Index 2 = Rear Left Index 3 = Rear Right
      element RscCtrlIntvgPerWhl1: type=CtrlSt1, array-size-semantics=FIXED-SIZE, max-number-of-elements=4
    SprgCoeffPerWhl1  # Spring Coefficient per Wheel 1 | Spring Coefficient per wheel. | Convention is: Index 0 = Front Left Index 1 = Front Right Index 2 = Rear Left Index 3 = Rear Right
      element SprgCoeffPerWhl1: type=SprgCoeff1, array-size-semantics=FIXED-SIZE, max-number-of-elements=4
    SprgFPerWhl1  # Spring Force per Wheel | Spring Force. | Convention is: Index 0 = Front Left Index 1 = Front Right Index 2 = Rear Left Index 3 = Rear Right
      element SprgFPerWhl1: type=F1, array-size-semantics=FIXED-SIZE, max-number-of-elements=4
    SprgTrvlPerWhl1  # Spring Travel per Wheel | Spring Travel. | Convention is: Index 0 = Front Left Index 1 = Front Right Index 2 = Rear Left Index 3 = Rear Right
      element SprgTrvlPerWhl1: type=Len3, array-size-semantics=FIXED-SIZE, max-number-of-elements=4
    StabrRatePerWhl1  # Stabilizer Rate per Wheel | Stabilizer rate for active stabilizer systems. | Convention is: Index 0 = Front Left Index 1 = Front Right Index 2 = Rear Left Index 3 = Rear Right
      element StabrRatePerWhl1: type=Perc1, array-size-semantics=FIXED-SIZE, max-number-of-elements=4
    TiStamp1  # Time Stamp | Buffer of time stamps
      element TiStamp1: type=Ti4, array-size-semantics=FIXED-SIZE, max-number-of-elements=50
    TirePMonCalStPerWhl1  # TPMS Calibration Status per Wheel 1 | For direct and indirect measuring Tire Pressure Monitoring systems: Acknowledge that the Tire Pressure Monitoring Calibration is finished at the wheels. | The convention is:
      element TirePMonCalStPerWhl1: type=CalSt1, array-size-semantics=FIXED-SIZE, max-number-of-elements=5
    TirePMonCalStsPerWhl1  # TPMS Calibration Status per Wheel 1 | For direct and indirect measuring Tire Pressure Monitoring systems: Acknowledge that the Tire Pressure Monitoring Calibration is finished at the wheels. | The convention is: Index 0 = Front Left Index 1 = Front Right Index 2 = Rear Left Index 3 = Rear Right Index 4 = Spare Wheel
      element TirePMonCalStsPerWhl1: type=CalSts1, array-size-semantics=FIXED-SIZE, max-number-of-elements=5
    TirePMonWarnIndcnStPerWhl1  # TPMS Warning Indication Status per Wheel 1 | For direct and indirect measuring Tire Pressure Monitoring systems: Indication what type of loss of tire pressure has been recognized at wheel. For indirect measuring Tire Pressure Monitoring probably not all states can be used. | The convention is:
      element TirePMonWarnIndcnStPerWhl1: type=TirePMonWarnSt2, array-size-semantics=FIXED-SIZE, max-number-of-elements=5
    TirePMonWarnIndcnStsPerWhl1  # TPMS Warning Indication Status per Wheel 1 | For direct and indirect measuring Tire Pressure Monitoring systems: Indication what type of loss of tire pressure has been recognized at wheel. For indirect measuring Tire Pressure Monitoring probably not all states can be used. | The convention is: Index 0 = Front Left Index 1 = Front Right Index 2 = Rear Left Index 3 = Rear Right Index 4 = Spare Wheel
      element TirePMonWarnIndcnStsPerWhl1: type=TirePMonWarnSts2, array-size-semantics=FIXED-SIZE, max-number-of-elements=5
    TirePPerWhl1  # Tire Pressure per Wheel 1 | Tire pressures at wheels. | Convention is: Index 0 = Front Left Index 1 = Front Right Index 2 = Rear Left Index 3 = Rear Right Index 4 = Spare Wheel
      element TirePPerWhl1: type=P1, array-size-semantics=FIXED-SIZE, max-number-of-elements=5
    TirePPerWhl2  # Tire Pressure per Wheel 2 | Tire pressures at wheels. | Convention is: Index 0 = Front Left Index 1 = Front Right Index 2 = Rear Left Index 3 = Rear Right
      element TirePPerWhl2: type=P1, array-size-semantics=FIXED-SIZE, max-number-of-elements=4
    TireTPerWhl1  # Tire Temperature per Wheel 1 | Tire temperatures. | Convention is: Index 0 = Front Left Index 1 = Front Right Index 2 = Rear Left Index 3 = Rear Right Index 4 = Spare Wheel
      element TireTPerWhl1: type=T3, array-size-semantics=FIXED-SIZE, max-number-of-elements=5
    TireTPerWhl2  # Tire Temperature per Wheel 2 | Tire temperatures. | Convention is: Index 0 = Front Left Index 1 = Front Right Index 2 = Rear Left Index 3 = Rear Right
      element TireTPerWhl2: type=T3, array-size-semantics=FIXED-SIZE, max-number-of-elements=4
    VAgrRawPerWhl1  # Velocity Angular Raw per Wheel | Raw angular velocity of each wheel | Convention is: Index 0 = Front Left Index 1 = Front Right Index 2 = Rear Left Index 3 = Rear Right
      element VAgrRawPerWhl1: array-size-semantics=FIXED-SIZE, max-number-of-elements=4
    VehBodyAVertPerWhl1  # Vehicle Body Acceleration Vertical per Wheel 1 | Generic datatype for vehicle vertical body accelerations. Refer to ISO 8855. | The convention is Index 0 = Front left Index 1 = Front right Index 2 = Rear left Index 3 = Rear right
      element VehBodyAVertPerWhl1: type=A2, array-size-semantics=FIXED-SIZE, max-number-of-elements=4
    WhlAAgrPerWhl1  # Wheel Acceleration Angular per Wheel | Angular acceleration of each wheel. | Convention is: Index 0 = Front Left Index 1 = Front Right Index 2 = Rear Left Index 3 = Rear Right
      element WhlAAgrPerWhl1: type=AgA1, array-size-semantics=FIXED-SIZE, max-number-of-elements=4
    WhlAVertPerWhl1  # Wheel Acceleration Vertical per Wheel 1 | Vehicle vertical wheel acceleration. Refer to ISO 8855. | The convention is Index 0 = Front left Index 1 = Front right Index 2 = Rear left Index 3 = Rear right
      element WhlAVertPerWhl1: type=A5, array-size-semantics=FIXED-SIZE, max-number-of-elements=4
    WhlBrkSlipPerWhl1  # Wheel Brake Slip per Wheel | Wheel Brake Slip | Convention is: Index 0 = Front Left Index 1 = Front Right Index 2 = Rear Left Index 3 = Rear Right
      element WhlBrkSlipPerWhl1: type=Fac4, array-size-semantics=FIXED-SIZE, max-number-of-elements=4
    WhlBrkTqPerWhl1  # Wheel Brake Torque per Wheel | Brake torque on each wheel. | Convention is: Index 0 = Front Left Index 1 = Front Right Index 2 = Rear Left Index 3 = Rear Right
      element WhlBrkTqPerWhl1: type=Tq10, array-size-semantics=FIXED-SIZE, max-number-of-elements=4
    WhlBrkTqReqStPerWhl1  # Wheel Brake Torque Request Status per Wheel 1 | Request from Roll Stability Control to Electronic Stability Control to apply a desired vehicle wheel brake torque | Convention is:
      element WhlBrkTqReqStPerWhl1: type=ReqSt1, array-size-semantics=FIXED-SIZE, max-number-of-elements=4
    WhlBrkTqReqStsPerWhl1  # Wheel Brake Torque Request Status per Wheel 1 | Request from Roll Stability Control to Electronic Stability Control to apply a desired vehicle wheel brake torque | Convention is: Index 0 = Front Left Index 1 = Front Right Index 2 = Rear Left Index 3 = Rear Right
      element WhlBrkTqReqStsPerWhl1: type=ReqSts1, array-size-semantics=FIXED-SIZE, max-number-of-elements=4
    WhlDirRotlPerWhl1  # Wheel Direction Rotational per Wheel | Direction of rotation of each wheel. | Convention is: Index 0 = Front Left Index 1 = Front Right Index 2 = Rear Left Index 3 = Rear Right
      element WhlDirRotlPerWhl1: type=WhlRotlDirMeasd1, array-size-semantics=FIXED-SIZE, max-number-of-elements=4
    WhlFVertPerWhl1  # Wheel Force Vertical per Wheel | Vertical Wheel Force. | Convention is: Index 0 = Front Left Index 1 = Front Right Index 2 = Rear Left Index 3 = Rear Right
      element WhlFVertPerWhl1: type=F3, array-size-semantics=FIXED-SIZE, max-number-of-elements=4
    WhlRdTolrCoeffPerWhl1  # Wheel Road Tolerance Coefficient per Wheel | Road Tolerance Coefficient of each wheel. | Convention is: Index 0 = Front Left Index 1 = Front Right Index 2 = Rear Left Index 3 = Rear Right
      element WhlRdTolrCoeffPerWhl1: type=Fac3, array-size-semantics=FIXED-SIZE, max-number-of-elements=4
    WhlSpdCircumlPerWhl1  # Wheel Speed Circumferential per Wheel | Circumferential speed of each wheel. | Convention is: Index 0 = Front Left Index 1 = Front Right Index 2 = Rear Left Index 3 = Rear Right
      element WhlSpdCircumlPerWhl1: type=Spd1, array-size-semantics=FIXED-SIZE, max-number-of-elements=4
    WhlVAgrPerWhl1  # Wheel Velocity Angular per Wheel | Angular velocity of each wheel. | Convention is: Index 0 = Front Left Index 1 = Front Right Index 2 = Rear Left Index 3 = Rear Right
      element WhlVAgrPerWhl1: type=AgSpd6, array-size-semantics=FIXED-SIZE, max-number-of-elements=4
  293 x app type:
    A1: category=VALUE, sw-calibration-access=READ-ONLY, compu-method=A1, data-constr=A1, sw-intended-resolution=0.0078125, unit=MtrPerSecSqd  # Acceleration 1 | Generic data type for acceleration
    A10: category=VALUE, sw-calibration-access=READ-ONLY, compu-method=A10, data-constr=A10, sw-intended-resolution=0.010004885, unit=MtrPerSecSqd  # Acceleration 10 | Generic data type for acceleration
    A11: category=VALUE, sw-calibration-access=READ-ONLY, compu-method=A11, data-constr=A11, sw-intended-resolution=0.00391, unit=MtrPerSecSqd  # Acceleration 11 | Generic data type for acceleration
    A12: category=VALUE, sw-calibration-access=READ-ONLY, compu-method=A12, data-constr=A12, sw-intended-resolution=0.03125, unit=MtrPerSecSqd  # Acceleration 12 | Generic data type for acceleration
    A13: category=VALUE, sw-calibration-access=READ-ONLY, compu-method=A13, data-constr=A13, sw-intended-resolution=0.0625, unit=MtrPerSecSqd  # Acceleration 13 | Generic data type for acceleration
    A14: category=VALUE, sw-calibration-access=READ-ONLY, compu-method=A14, data-constr=A14, sw-intended-resolution=0.25, unit=MtrPerSecSqd  # Acceleration 14 | Generic data type for acceleration
    A2: category=VALUE, sw-calibration-access=READ-ONLY, compu-method=A2, data-constr=A2, sw-intended-resolution=0.00390625, unit=MtrPerSecSqd  # Acceleration 2 | Generic data type for acceleration
    A3: category=VALUE, sw-calibration-access=READ-ONLY, compu-method=A3, data-constr=A3, sw-intended-resolution=0.0009765625, unit=MtrPerSecSqd  # Acceleration 3 | Generic data type for acceleration
    A4: category=VALUE, sw-calibration-access=READ-ONLY, compu-method=A4, data-constr=A4, sw-intended-resolution=0.0009765625, unit=MtrPerSecSqd  # Acceleration 4 | Generic data type for acceleration
    A5: category=VALUE, sw-calibration-access=READ-ONLY, compu-method=A5, data-constr=A5, sw-intended-resolution=0.00390625, unit=MtrPerSecSqd  # Acceleration 5 | Generic data type for acceleration
    A7: category=VALUE, sw-calibration-access=READ-ONLY, compu-method=A7, data-constr=A7, sw-intended-resolution=0.01, unit=MtrPerSecSqd  # Acceleration 7 | Generic data type for acceleration
    A8: category=VALUE, sw-calibration-access=READ-ONLY, compu-method=A8, data-constr=A8, sw-intended-resolution=0.036, unit=MtrPerSecSqd  # Acceleration 8 | Generic data type for acceleration
    A9: category=VALUE, sw-calibration-access=READ-ONLY, compu-method=A9, data-constr=A9, sw-intended-resolution=0.143753, unit=MtrPerSecSqd  # Acceleration 9 | Generic data type for acceleration
    Ag1: category=VALUE, sw-calibration-access=READ-ONLY, compu-method=Ag1, data-constr=Ag1, sw-intended-resolution=0.0009765625, unit=Rad  # Angle 1 | Generic data type for angle
    Ag2: category=VALUE, sw-calibration-access=READ-ONLY, compu-method=Ag2, data-constr=Ag2, sw-intended-resolution=0.0009765625, unit=Rad  # Angle 2 | Generic data type for angle
    Ag3: category=VALUE, sw-calibration-access=READ-ONLY, compu-method=Ag3, data-constr=Ag3, sw-intended-resolution=0.0001220703125, unit=Rad  # Angle 3 | Generic data type for angle
    Ag4: category=VALUE, sw-calibration-access=READ-ONLY, compu-method=Ag4, data-constr=Ag4, sw-intended-resolution=0.0009765625, unit=Rad  # Angle 4 | Generic data type for angle
    Ag5: category=VALUE, sw-calibration-access=READ-ONLY, compu-method=Ag5, data-constr=Ag5, sw-intended-resolution=0.0009765625, unit=Rad  # Angle 5 | Generic data type for angle
    Ag6: category=VALUE, sw-calibration-access=READ-ONLY, compu-method=Ag6, data-constr=Ag6, sw-intended-resolution=0.012368475, unit=Rad  # Angle 6 | Generic data type for angle
    AgA1: category=VALUE, sw-calibration-access=READ-ONLY, compu-method=AgA1, data-constr=AgA1, sw-intended-resolution=0.125, unit=RadPerSecSqd  # Angle Acceleration 1 | Generic data type for angle acceleration
    AgA2: category=VALUE, sw-calibration-access=READ-ONLY, compu-method=AgA2, data-constr=AgA2, sw-intended-resolution=0.00390625, unit=RadPerSecSqd  # Angle Acceleration 2 | Generic data type for angle acceleration
    AgSpd1: category=VALUE, sw-calibration-access=READ-ONLY, compu-method=AgSpd1, data-constr=AgSpd1, sw-intended-resolution=0.0078125, unit=RadPerSec  # Angle Speed 1 | Generic data type for angle speed
    AgSpd2: category=VALUE, sw-calibration-access=READ-ONLY, compu-method=AgSpd2, data-constr=AgSpd2, sw-intended-resolution=0.0009765625, unit=RadPerSec  # Angle Speed 2 | Generic data type for angle speed
    AgSpd3: category=VALUE, sw-calibration-access=READ-ONLY, compu-method=AgSpd3, data-constr=AgSpd3, sw-intended-resolution=0.000244140625, unit=RadPerSec  # Angle Speed 3 | Generic data type for angle speed
    AgSpd4: category=VALUE, sw-calibration-access=READ-ONLY, compu-method=AgSpd4, data-constr=AgSpd4, sw-intended-resolution=0.0009765625, unit=RadPerSec  # Angle Speed 4 | Generic data type for angle speed
    AgSpd5: category=VALUE, sw-calibration-access=READ-ONLY, compu-method=AgSpd5, data-constr=AgSpd5, sw-intended-resolution=0.0009765625, unit=RadPerSec  # Angle Speed 5 | Generic data type for angle speed
    AgSpd6: category=VALUE, sw-calibration-access=READ-ONLY, compu-method=AgSpd6, data-constr=AgSpd6, sw-intended-resolution=0.015625, unit=RadPerSec  # Angle Speed 6 | Generic data type for angle speed
    AgSpd7: category=VALUE, sw-calibration-access=READ-ONLY, compu-method=AgSpd7, data-constr=AgSpd7, sw-intended-resolution=0.001, unit=RadPerSec  # Angle Speed 7 | Generic data type for angle speed
    AgSpd8: category=VALUE, sw-calibration-access=READ-ONLY, compu-method=AgSpd8, data-constr=AgSpd8, sw-intended-resolution=0.000244140625, unit=RadPerSec  # Angle Speed 8 | Generic data type for angle speed
    Crvt1: category=VALUE, sw-calibration-access=READ-ONLY, compu-method=Crvt1, data-constr=Crvt1, sw-intended-resolution=3.05185094759971E-06, unit=PerMtr  # Curvature 1 | Generic data type for curvature
    DamprCoeff1: category=VALUE, sw-calibration-access=READ-ONLY, compu-method=DamprCoeff1, data-constr=DamprCoeff1, sw-intended-resolution=1, unit=NwtSecPerMtr  # Damper Coefficient 1 | Generic data type for damper coefficient
    Day1: category=VALUE, sw-calibration-access=READ-ONLY, compu-method=Day1, data-constr=Day1, sw-intended-resolution=1, unit=NoUnit  # Day 1 | It represents the value of a day in a month
    F{1..3}: category=VALUE, sw-calibration-access=READ-ONLY, compu-method=F{1..3}, data-constr=F{1..3}, sw-intended-resolution=1, unit=Nwt  # Force {1..3} | Generic data type for force
    Fac1: category=VALUE, sw-calibration-access=READ-ONLY, compu-method=Fac1, data-constr=Fac1, sw-intended-resolution=0.0009765625, unit=NoUnit  # Factor 1 | Generic data type for factor
    Fac3: category=VALUE, sw-calibration-access=READ-ONLY, compu-method=Fac3, data-constr=Fac3, sw-intended-resolution=0.00048828125, unit=NoUnit  # Factor 3 | Generic data type for factor
    Fac4: category=VALUE, sw-calibration-access=READ-ONLY, compu-method=Fac4, data-constr=Fac4, sw-intended-resolution=0.00048828125, unit=NoUnit  # Factor 4 | Generic data type for factor
    Fac5: category=VALUE, sw-calibration-access=READ-ONLY, compu-method=Fac5, data-constr=Fac5, sw-intended-resolution=0.0078125, unit=NoUnit  # Factor 5 | Generic data type for factor
    Fac7: category=VALUE, sw-calibration-access=READ-ONLY, compu-method=Fac7, data-constr=Fac7, sw-intended-resolution=3.92156862745098E-03, unit=NoUnit  # Factor 7 | Generic data type for factor
    FricCoeff1: category=VALUE, sw-calibration-access=READ-ONLY, compu-method=FricCoeff1, data-constr=FricCoeff1, sw-intended-resolution=0.01, unit=NoUnit  # Friction Coefficient 1 | Generic data type for friction coefficient
    Frq1: category=VALUE, sw-calibration-access=READ-ONLY, compu-method=Frq1, data-constr=Frq1, sw-intended-resolution=0.0625, unit=Hz  # Frequency 1 | Generic data type for frequency
    Frq2: category=VALUE, sw-calibration-access=READ-ONLY, compu-method=Frq2, data-constr=Frq2, sw-intended-resolution=0.1, unit=KiloHz  # Frequency 2 | Generic data type for acoustic frequency
    Hr1: category=VALUE, sw-calibration-access=READ-ONLY, compu-method=Hr1, data-constr=Hr1, sw-intended-resolution=1, unit=NoUnit  # Hour 1 | It represents the value of an hour in a day (24h format)
    Jerk1: category=VALUE, sw-calibration-access=READ-ONLY, compu-method=Jerk1, data-constr=Jerk1, sw-intended-resolution=0.00390625, unit=MtrPerSecCubd  # Jerk 1 | Generic data type for acceleration change rate
    Len1: category=VALUE, sw-calibration-access=READ-ONLY, compu-method=Len1, data-constr=Len1, sw-intended-resolution=0.00098, unit=Mtr  # Length 1 | Generic data type for length
    Len10: category=VALUE, sw-calibration-access=READ-ONLY, compu-method=Len10, data-constr=Len10, sw-intended-resolution=0.015625477, unit=Mtr  # Length 10 | Generic data type for length
    Len11: category=VALUE, sw-calibration-access=READ-ONLY, compu-method=Len11, data-constr=Len11, sw-intended-resolution=0.010004885, unit=Mtr  # Length 11 | Generic data type for length
    Len14: category=VALUE, sw-calibration-access=READ-ONLY, compu-method=Len14, data-constr=Len14, sw-intended-resolution=0.1, unit=Mtr  # Length 14 | Generic data type for length
    Len3: category=VALUE, sw-calibration-access=READ-ONLY, compu-method=Len3, data-constr=Len3, sw-intended-resolution=0.000244140625, unit=Mtr  # Length 3 | Generic data type for length
    Len4: category=VALUE, sw-calibration-access=READ-ONLY, compu-method=Len4, data-constr=Len4, sw-intended-resolution=0.0009765625, unit=Mtr  # Length 4 | Generic data type for length
    Len5: category=VALUE, sw-calibration-access=READ-ONLY, compu-method=Len5, data-constr=Len5, sw-intended-resolution=0.00390625, unit=Mtr  # Length 5 | Generic data type for length
    Len6: category=VALUE, sw-calibration-access=READ-ONLY, compu-method=Len6, data-constr=Len6, sw-intended-resolution=0.5, unit=KiloMtr  # Length 6 | Generic data type for length
    Len7: category=VALUE, sw-calibration-access=READ-ONLY, compu-method=Len7, data-constr=Len7, sw-intended-resolution=0.015625, unit=Mtr  # Length 7 | Generic data type for length
    M1: category=VALUE, sw-calibration-access=READ-ONLY, compu-method=M1, data-constr=M1, sw-intended-resolution=1, unit=KiloGr  # Mass 1 | Generic data type for mass
    M2: category=VALUE, sw-calibration-access=READ-ONLY, compu-method=M2, data-constr=M2, sw-intended-resolution=1, unit=KiloGr  # Mass 2 | Generic data type for mass
    Mins1: category=VALUE, sw-calibration-access=READ-ONLY, compu-method=Mins1, data-constr=Mins1, sw-intended-resolution=1, unit=NoUnit  # Minute 1 | It represents the value of a minute in one hour
    Mth1: category=VALUE, sw-calibration-access=READ-ONLY, compu-method=Mth1, data-constr=Mth1, sw-intended-resolution=1, unit=NoUnit  # Month 1 | It represents the value of a month in a calendar year
    N1: category=VALUE, sw-calibration-access=READ-ONLY, compu-method=N1, data-constr=N1, sw-intended-resolution=0.5, unit=Rpm  # Rotational Speed 1 | Generic data type for rotational speed
    N2: compu-method=RpmLnr1, data-constr=N2, sw-intended-resolution=0.5, unit=Rpm  # Rotational Speed 2 | Generic data type for rotational speed
    NGrdt1: category=VALUE, sw-calibration-access=READ-ONLY, compu-method=NGrdt1, data-constr=NGrdt1, sw-intended-resolution=1, unit=RpmPerSec  # Engine Speed Gradient | Generic data type for rotational speed gradient
    Nr1: category=VALUE, sw-calibration-access=READ-ONLY, compu-method=Nr1, data-constr=Nr1, sw-intended-resolution=1, unit=NoUnit  # Number 1 | Generic data type for number
    Nr10: category=VALUE, sw-calibration-access=READ-ONLY, compu-method=Nr10, data-constr=Nr10, sw-intended-resolution=1, unit=NoUnit  # Number 10 | Generic data type for number
    Nr{2..9}: category=VALUE, sw-calibration-access=READ-ONLY, compu-method=Nr{2..9}, data-constr=Nr{2..9}, sw-intended-resolution=1, unit=NoUnit  # Number {2..9} | Generic data type for number
    P1: category=VALUE, sw-calibration-access=READ-ONLY, compu-method=P1, data-constr=P1, sw-intended-resolution=0.0078125, unit=Bar  # Pressure 1 | Generic data type for pressure
    P4: category=VALUE, sw-calibration-access=READ-ONLY, compu-method=P4, data-constr=P4, sw-intended-resolution=5, unit=HectoPa  # Pressure 4 | Generic data type for pressure
    P5: category=VALUE, sw-calibration-access=READ-ONLY, compu-method=P5, data-constr=P5, sw-intended-resolution=16384, unit=Pa  # Pressure 5 | Generic data type for high pressure | Examples for usage: fuel pressure
    P6: category=VALUE, sw-calibration-access=READ-ONLY, compu-method=P6, data-constr=P6, sw-intended-resolution=32, unit=Pa  # Pressure 6 | Generic data type for low pressure | Examples for usage: ambient air pressure, particulate filter differential pressure
    P7: category=VALUE, sw-calibration-access=READ-ONLY, compu-method=PaIdentcl, data-constr=RngUnlimd, sw-intended-resolution=0.0000001, unit=Pa  # Pressure 7 | Generic data type for pressure | Examples for usage: ambient air pressure, particulate filter differential pressure, fuel pressure Remark: use for floating point implementation
    Perc1: category=VALUE, sw-calibration-access=READ-ONLY, compu-method=Perc1, data-constr=Perc1, sw-intended-resolution=0.00390625, unit=Perc  # Percent 1 | Generic data type for percent
    Perc10: category=VALUE, sw-calibration-access=READ-ONLY, compu-method=Perc10, data-constr=Perc10, sw-intended-resolution=0.01, unit=Perc  # Percent 10 | Generic data type for percent | Examples for usage: common solenoid actuator (EGR), Pedal
    Perc11: category=VALUE, sw-calibration-access=READ-ONLY, compu-method=PercIdentcl, data-constr=RngUnlimd, sw-intended-resolution=0.0000001, unit=Perc  # Percent 11 | Generic data type for percent | Examples for usage: common solenoid actuator (EGR), Pedal Remark: use for floating point implementation
    Perc2: category=VALUE, sw-calibration-access=READ-ONLY, compu-method=Perc2, data-constr=Perc2, sw-intended-resolution=0.5, unit=Perc  # Percent 2 | Generic data type for percent
    Perc6: category=VALUE, sw-calibration-access=READ-ONLY, compu-method=Perc6, data-constr=Perc6, sw-intended-resolution=1, unit=Perc  # Percent 6 | Generic data type for percent
    Perc7: category=VALUE, sw-calibration-access=READ-ONLY, compu-method=Perc7, data-constr=Perc7, sw-intended-resolution=0.1, unit=Perc  # Percent 7 | Generic data type for percent
    Perc8: category=VALUE, sw-calibration-access=READ-ONLY, compu-method=Perc8, data-constr=Perc8, sw-intended-resolution=0.00031, unit=Perc  # Percent 8 | Generic data type for percent
    Perc9: category=VALUE, sw-calibration-access=READ-ONLY, compu-method=Perc9, data-constr=Perc9, sw-intended-resolution=0.1, unit=Perc  # Percent 9 | Generic data type for percent
    PercGrdt1: category=VALUE, sw-calibration-access=READ-ONLY, compu-method=PercGrdt1, data-constr=PercGrdt1, sw-intended-resolution=0.0625, unit=PercPerSec  # Percent Gradient 1 | Generic data type for percent gradient
    Sec1: category=VALUE, sw-calibration-access=READ-ONLY, compu-method=Sec1, data-constr=Sec1, sw-intended-resolution=1, unit=NoUnit  # Second 1 | It represents the value of a second in one minute
    Spd1: category=VALUE, sw-calibration-access=READ-ONLY, compu-method=Spd1, data-constr=Spd1, sw-intended-resolution=0.00390625, unit=MtrPerSec  # Speed 1 | Generic data type for speed
    Spd2: category=VALUE, sw-calibration-access=READ-ONLY, compu-method=Spd2, data-constr=Spd2, sw-intended-resolution=0.00390625, unit=MtrPerSec  # Speed 2 | Generic data type for speed
    Spd3: category=VALUE, sw-calibration-access=READ-ONLY, compu-method=Spd3, data-constr=Spd3, sw-intended-resolution=0.25, unit=MtrPerSec  # Speed 3 | Generic data type for speed
    Spd4: category=VALUE, sw-calibration-access=READ-ONLY, compu-method=Spd4, data-constr=Spd4, sw-intended-resolution=0.03125, unit=MtrPerSec  # Speed 4 | Generic data type for speed
    Spd5: category=VALUE, sw-calibration-access=READ-ONLY, compu-method=Spd5, data-constr=Spd5, sw-intended-resolution=0.003906369, unit=MtrPerSec  # Speed 5 | Generic data type for speed
    Spd6: category=VALUE, sw-calibration-access=READ-ONLY, compu-method=Spd6, data-constr=Spd6, sw-intended-resolution=0.003906369, unit=MtrPerSec  # Speed 6 | Generic data type for speed
    SprgCoeff1: category=VALUE, sw-calibration-access=READ-ONLY, compu-method=SprgCoeff1, data-constr=SprgCoeff1, sw-intended-resolution=1, unit=NwtPerMtr  # Spring Coefficient 1 | Generic data type for spring coefficient
    T1: category=VALUE, sw-calibration-access=READ-ONLY, compu-method=T1, data-constr=T1, sw-intended-resolution=0.5, unit=DegCgrd  # Temperature 1 | Generic data type for temperature
    T3: category=VALUE, sw-calibration-access=READ-ONLY, compu-method=T3, data-constr=T3, sw-intended-resolution=1, unit=DegCgrd  # Temperature 3 | Generic data type for temperature
    T4: category=VALUE, sw-calibration-access=READ-ONLY, compu-method=T4, data-constr=T4, sw-intended-resolution=1, unit=DegCgrd  # Temperature 4 | Generic data type for temperature
    T5: category=VALUE, sw-calibration-access=READ-ONLY, compu-method=T5, data-constr=T5, sw-intended-resolution=0.1, unit=KelvinAbslt  # Temperature 5 | Generic data type for temperature | Examples for usage: glow plugs temperature, oil temperature, environment temperature, temperature differences
    T6: category=VALUE, sw-calibration-access=READ-ONLY, compu-method=KelvinIdentcl, data-constr=RngUnlimd, sw-intended-resolution=0.0000001, unit=KelvinAbslt  # Temperature 6 | Generic data type for temperature | Examples for usage: glow plugs temperature, oil temperature, environment temperature, temperature differences Remark: use for floating point implementation
    T7: compu-method=DegCgrdLnr1, data-constr=T7, sw-intended-resolution=0.5, unit=DegCgrd  # Temperature 7 | Generic data type for temperature.
    Ti2: category=VALUE, sw-calibration-access=READ-ONLY, compu-method=Ti2, data-constr=Ti2, sw-intended-resolution=0.1, unit=Sec  # Time 2 | Generic data type for time
    Ti3: category=VALUE, sw-calibration-access=READ-ONLY, compu-method=Ti3, data-constr=Ti3, sw-intended-resolution=0.001, unit=Sec  # Time 3 | Generic data type for time
    Ti4: category=VALUE, sw-calibration-access=READ-ONLY, compu-method=Ti4, data-constr=Ti4, sw-intended-resolution=0.00000025, unit=Sec  # Time 4 | Generic data type for time
    Tq1: category=VALUE, sw-calibration-access=READ-ONLY, compu-method=Tq1, data-constr=Tq1, sw-intended-resolution=0.00390625, unit=NwtMtr  # Torque 1 | Generic data type for torque
    Tq10: category=VALUE, sw-calibration-access=READ-ONLY, compu-method=Tq10, data-constr=Tq10, sw-intended-resolution=1, unit=NwtMtr  # Torque 10 | Generic data type for torque
    Tq12: category=VALUE, sw-calibration-access=READ-ONLY, compu-method=Tq12, data-constr=Tq12, sw-intended-resolution=1, unit=NwtMtr  # Torque 12 | Generic data type for torque
    Tq13: category=VALUE, sw-calibration-access=READ-ONLY, compu-method=Tq13, data-constr=Tq13, sw-intended-resolution=1, unit=NwtMtr  # Torque 13 | Generic data type for torque | Examples for usage: Differential Torques
    Tq14: category=VALUE, sw-calibration-access=READ-ONLY, compu-method=Tq14, data-constr=Tq14, sw-intended-resolution=1, unit=NwtMtr  # Torque 14 | Generic data type for torque
    Tq15: category=VALUE, sw-calibration-access=READ-ONLY, compu-method=Tq15, data-constr=Tq15, sw-intended-resolution=0.00391, unit=NwtMtr  # Torque 15 | Generic data type for torque
    Tq16: category=VALUE, sw-calibration-access=READ-ONLY, compu-method=Tq16, data-constr=Tq16, sw-intended-resolution=1, unit=NwtMtr  # Torque 16 | Generic torque application data type for the physical torque signal values of the network representation. | Base Type: Uint12 Special values FFEh and FFFh are reserved for future definition of signal quality.
    Tq2: category=VALUE, sw-calibration-access=READ-ONLY, compu-method=Tq2, data-constr=Tq2, sw-intended-resolution=1, unit=NwtMtr  # Torque 2 | Generic data type for torque
    Tq3: category=VALUE, sw-calibration-access=READ-ONLY, compu-method=Tq3, data-constr=Tq3, sw-intended-resolution=4, unit=NwtMtr  # Torque 3 | Generic data type for torque
    Tq4: category=VALUE, sw-calibration-access=READ-ONLY, compu-method=Tq4, data-constr=Tq4, sw-intended-resolution=4, unit=NwtMtr  # Torque 4 | Generic data type for torque
    Tq5: category=VALUE, sw-calibration-access=READ-ONLY, compu-method=Tq5, data-constr=Tq5, sw-intended-resolution=0.0625, unit=NwtMtr  # Torque 5 | Generic data type for torque | Examples for usage: torque at clutch and torque at crankshaft signals
    Tq6: category=VALUE, sw-calibration-access=READ-ONLY, compu-method=Tq6, data-constr=Tq6, sw-intended-resolution=0.0625, unit=NwtMtr  # Torque 6 | Generic data type for torque
    Tq7: category=VALUE, sw-calibration-access=READ-ONLY, compu-method=Tq7, data-constr=Tq7, sw-intended-resolution=0.0625, unit=NwtMtr  # Torque 7 | Generic data type for torque | Examples for usage: torque at wheels signals
    TqGrdt1: category=VALUE, sw-calibration-access=READ-ONLY, compu-method=TqGrdt1, data-constr=TqGrdt1, sw-intended-resolution=16, unit=NwtMtrPerSec  # Torque Gradient 1 | Generic data type for torque gradient
    U1: category=VALUE, sw-calibration-access=READ-ONLY, compu-method=U1, data-constr=U1, sw-intended-resolution=0.1, unit=Volt  # Voltage 1 | Generic data type for voltage
    Yr1: category=VALUE, sw-calibration-access=READ-ONLY, compu-method=Yr1, data-constr=Yr1, sw-intended-resolution=1, unit=NoUnit  # Year 1 | It represents the value of a year in a century
    AckSt1: category=VALUE, sw-calibration-access=READ-ONLY, compu-method=AckSt1, data-constr=AckSt1, unit=NoUnit  # Acknowledge Status 1 | Generic acknowledge status 1
    AckSts1: category=VALUE, sw-calibration-access=READ-ONLY, compu-method=AckSts1, data-constr=AckSts1, unit=NoUnit  # Acknowledge Status 1 | Generic acknowledge status 1
    AlrmSt1: category=VALUE, sw-calibration-access=READ-ONLY, compu-method=AlrmSt1, data-constr=AlrmSt1, unit=NoUnit  # Alarm Status | information about alarm status provided for the usage of the other components
    AlrmSts1: category=VALUE, sw-calibration-access=READ-ONLY, compu-method=AlrmSts1, data-constr=AlrmSts1, unit=NoUnit  # Alarm Status | information about alarm status provided for the usage of the other components
    ArmingTyp2: category=VALUE, sw-calibration-access=READ-ONLY, compu-method=ArmingTyp2, data-constr=ArmingTyp2, unit=NoUnit  # Arming Type | To describe if the alarm is armed or not, along with the precision whether the arming process is finished or not
    ArmingTyp3: category=BOOLEAN, sw-calibration-access=READ-ONLY, compu-method=ArmingTyp3, data-constr=ArmingTyp3, unit=NoUnit  # Arming Type | To describe if the alarm is armed or not
    AvlSt1: category=VALUE, sw-calibration-access=READ-ONLY, compu-method=AvlSt1, data-constr=AvlSt1, unit=NoUnit  # Available Status 1 | Generic available status 1
    AvlSts1: category=VALUE, sw-calibration-access=READ-ONLY, compu-method=AvlSts1, data-constr=AvlSts1, unit=NoUnit  # Available Status 1 | Generic available status 1
    AxisTyp1: category=VALUE, sw-calibration-access=READ-ONLY, compu-method=AxisTyp1, data-constr=AxisTyp1, unit=NoUnit  # Axis Type | It indicates the axis to use.
    BltLockSt1: category=VALUE, sw-calibration-access=READ-ONLY, compu-method=BltLockSt1, data-constr=BltLockSt1, unit=NoUnit  # Belt Lock State | Belt lock state
    BltLockSt2: category=VALUE, sw-calibration-access=READ-ONLY, compu-method=BltLockSt2, data-constr=BltLockSt2, unit=NoUnit  # Belt Lock State | Belt lock state with additional seat availability information
    BodyLvlCtrl1: category=VALUE, sw-calibration-access=READ-ONLY, compu-method=BodyLvlCtrl1, data-constr=BodyLvlCtrl1, unit=NoUnit  # Body Level Control | Activity of the body level control. Direction of the body movement
    BodyLvlMod1: category=VALUE, sw-calibration-access=READ-ONLY, compu-method=BodyLvlMod1, data-constr=BodyLvlMod1, unit=NoUnit  # Body Level Mode 1 | Body Level Mode1
    BrkActrMod1: category=VALUE, sw-calibration-access=READ-ONLY, compu-method=BrkActrMod1, data-constr=BrkActrMod1, unit=NoUnit  # Brake Actuator Mode 1 | Indicates the action executed by the brake actuator or its state
    BrkActrSatn1: category=VALUE, sw-calibration-access=READ-ONLY, compu-method=BrkActrSatn1, data-constr=BrkActrSatn1, unit=NoUnit  # Brake Actuator Saturation 1 | Indicates that a brake actuator is in saturation mode
    BrkMod1: category=VALUE, sw-calibration-access=READ-ONLY, compu-method=BrkMod1, data-constr=BrkMod1, unit=NoUnit  # Brake Mode | Brake mode
    BrkReqTyp1: category=VALUE, sw-calibration-access=READ-ONLY, compu-method=BrkReqTyp1, data-constr=BrkReqTyp1, unit=NoUnit  # Brake Request Type 1 | Indicates whether a vehicle deceleration force request is set to Electric Parking Brake
    BrkReqTyp2: category=VALUE, sw-calibration-access=READ-ONLY, compu-method=BrkReqTyp2, data-constr=BrkReqTyp2, unit=NoUnit  # Brake Request Type 2 | Indicates whether a vehicle deceleration force request is set to Electronic Stability Control
    BucdSt1: category=VALUE, sw-calibration-access=READ-ONLY, compu-method=BucdSt1, data-constr=BucdSt1, unit=NoUnit  # Buckled State | State of occupants concerning buckling
    CalSt1: category=VALUE, sw-calibration-access=READ-ONLY, compu-method=CalSt1, data-constr=CalSt1, unit=NoUnit  # Calibration Status 1 | Calibration status 1
    CalSts1: category=VALUE, sw-calibration-access=READ-ONLY, compu-method=CalSts1, data-constr=CalSts1, unit=NoUnit  # Calibration Status 1 | Calibration status 1
    ChdProtnCmd1: category=VALUE, sw-calibration-access=READ-ONLY, compu-method=ChdProtnCmd1, data-constr=ChdProtnCmd1, unit=NoUnit  # Child Protection Command | Datatype to activate and deactivate the child protection for the rear seat passengers.
    ChgInfo1: category=VALUE, sw-calibration-access=READ-ONLY, compu-method=ChgInfo1, data-constr=ChgInfo1, unit=NoUnit  # Change | Indicates, whether an information about a change is present or not
    CluSt1: category=VALUE, sw-calibration-access=READ-ONLY, compu-method=CluSt1, data-constr=CluSt1, unit=NoUnit  # Clutch State | Information about the state of the clutch. | There exist 4 principal states: open, intermediate, near closed, hard closed.The definition of intermediate and near closed has to be made for each project separately. Definition of "Clutch": Be aware that this information is not necessarily equal with the drivetrain open information. If a torque converter clutch is open, the drivetrain can still be closed. In contrary the drivetrain is open for Manual Transmission (MT) and Automatic Manual Transmission (AMT), if the clutch is open! for Automatic Transmission (AT), Continuously Variable Transmission (CVT) it is the converter clutch for Manual Transmission (MT), Automatic Manual Transmission (AMT) it is the clutch between the gear box and the engine drivetrain
    CornrMkr1: category=VALUE, sw-calibration-access=READ-ONLY, compu-method=CornrMkr1, data-constr=CornrMkr1, unit=NoUnit  # Corner Marker | Corner Marker Request
    CptInfo1: category=VALUE, sw-calibration-access=READ-ONLY, compu-method=CptInfo1, data-constr=CptInfo1, unit=NoUnit  # Component Information | Information about components for key learning/authorization
    CrashSt1: category=VALUE, sw-calibration-access=READ-ONLY, compu-method=CrashSt1, data-constr=CrashSt1, unit=NoUnit  # Crash Status | Simplistic crash information
    CrashSts1: category=VALUE, sw-calibration-access=READ-ONLY, compu-method=CrashSts1, data-constr=CrashSts1, unit=NoUnit  # Crash Status | Simplistic crash information
    CrsCtrlAndAccSwtSt1: category=VALUE, sw-calibration-access=READ-ONLY, compu-method=CrsCtrlAndAccSwtSt1, data-constr=CrsCtrlAndAccSwtSt1, unit=NoUnit  # Cruise Control and ACC Switch Status 1 | Status of the switch to engage, disengage, or resume Adaptive Cruise Control or Cruise Control.
    CrsCtrlAndAccSwtSts1: category=VALUE, sw-calibration-access=READ-ONLY, compu-method=CrsCtrlAndAccSwtSts1, data-constr=CrsCtrlAndAccSwtSts1, unit=NoUnit  # Cruise Control and ACC Switch Status 1 | Status of the switch to engage, disengage, or resume Adaptive Cruise Control or Cruise Control.
    CtrlSt1: category=VALUE, sw-calibration-access=READ-ONLY, compu-method=CtrlSt1, data-constr=CtrlSt1, unit=NoUnit  # Control Status | Generic control status
    CtrlSts1: category=VALUE, sw-calibration-access=READ-ONLY, compu-method=CtrlSts1, data-constr=CtrlSts1, unit=NoUnit  # Control Status | Generic control status
    DetnSt1: category=VALUE, sw-calibration-access=READ-ONLY, compu-method=DetnSt1, data-constr=DetnSt1, unit=NoUnit  # Detection Status 1 | Generic detection status 1
    DetnSts1: category=VALUE, sw-calibration-access=READ-ONLY, compu-method=DetnSts1, data-constr=DetnSts1, unit=NoUnit  # Detection Status 1 | Generic detection status 1
    DevErrSt1: category=VALUE, sw-calibration-access=READ-ONLY, compu-method=DevErrSt1, data-constr=DevErrSt1, unit=NoUnit  # Device Error Status 1 | Generic device error status 1
    DevErrSt2: category=VALUE, sw-calibration-access=READ-ONLY, compu-method=DevErrSt2, data-constr=DevErrSt2, unit=NoUnit  # Device Error Status | Generic device error status 2
    DevErrSt3: category=VALUE, sw-calibration-access=READ-ONLY, compu-method=DevErrSt3, data-constr=DevErrSt3, unit=NoUnit  # Device Error Status 3 | Generic device error status 3
    DevErrSt4: category=VALUE, sw-calibration-access=READ-ONLY, compu-method=DevErrSt4, data-constr=DevErrSt4, unit=NoUnit  # Device Error Status 4 | Generic device error status 4
    DevErrSts1: category=VALUE, sw-calibration-access=READ-ONLY, compu-method=DevErrSts1, data-constr=DevErrSts1, unit=NoUnit  # Device Error Status 1 | Generic device error status 1
    DevErrSts2: category=VALUE, sw-calibration-access=READ-ONLY, compu-method=DevErrSts2, data-constr=DevErrSts2, unit=NoUnit  # Device Error Status | Generic device error status 2
    DevErrSts3: category=VALUE, sw-calibration-access=READ-ONLY, compu-method=DevErrSts3, data-constr=DevErrSts3, unit=NoUnit  # Device Error Status 3 | Generic device error status 3
    DevErrSts4: category=VALUE, sw-calibration-access=READ-ONLY, compu-method=DevErrSts4, data-constr=DevErrSts4, unit=NoUnit  # Device Error Status 4 | Generic device error status 4
    DevSt4: category=VALUE, sw-calibration-access=READ-ONLY, compu-method=DevSt4, data-constr=DevSt4, unit=NoUnit  # Device Status 4 | Generic device status 4
    DevSt5: category=VALUE, sw-calibration-access=READ-ONLY, compu-method=DevSt5, data-constr=DevSt5, unit=NoUnit  # Device Status 5 | Generic device status 5
    DevSt6: category=VALUE, sw-calibration-access=READ-ONLY, compu-method=DevSt6, data-constr=DevSt6, unit=NoUnit  # Device Status | Generic device status 6
    DevSt7: category=VALUE, sw-calibration-access=READ-ONLY, compu-method=DevSt7, data-constr=DevSt7, unit=NoUnit  # Device Status 7 | Information on activation / deactivation of a device
    DevSts4: category=VALUE, sw-calibration-access=READ-ONLY, compu-method=DevSts4, data-constr=DevSts4, unit=NoUnit  # Device Status 4 | Generic device status 4
    DevSts5: category=VALUE, sw-calibration-access=READ-ONLY, compu-method=DevSts5, data-constr=DevSts5, unit=NoUnit  # Device Status 5 | Generic device status 5
    DevSts6: category=VALUE, sw-calibration-access=READ-ONLY, compu-method=DevSts6, data-constr=DevSts6, unit=NoUnit  # Device Status | Generic device status 6
    DevSts7: category=VALUE, sw-calibration-access=READ-ONLY, compu-method=DevSts7, data-constr=DevSts7, unit=NoUnit  # Device Status 7 | Information on activation / deactivation of a device
    DoorHndlSt1: category=VALUE, sw-calibration-access=READ-ONLY, compu-method=DoorHndlSt1, data-constr=DoorHndlSt1, unit=NoUnit  # Door Handle Status | Information given by pull detector implemented on the door handle
    DoorHndlSts1: category=VALUE, sw-calibration-access=READ-ONLY, compu-method=DoorHndlSts1, data-constr=DoorHndlSts1, unit=NoUnit  # Door Handle Status | Information given by pull detector implemented on the door handle
    DoorSt1: category=VALUE, sw-calibration-access=READ-ONLY, compu-method=DoorSt1, data-constr=DoorSt1, unit=NoUnit  # Door Status | Status of the door.
    DoorSts1: category=VALUE, sw-calibration-access=READ-ONLY, compu-method=DoorSts1, data-constr=DoorSts1, unit=NoUnit  # Door Status | Status of the door.
    DynPpty1: category=VALUE, sw-calibration-access=READ-ONLY, compu-method=DynPpty1, data-constr=DynPpty1, unit=NoUnit  # Dynamic Property 1 | Status which indicates the dynamic property of the object (e.g. stationary, moving, etc). The definition is made according to the earth-fixed axis system as defined in ISO 8855.
    EgyMngtSt1: category=VALUE, sw-calibration-access=READ-ONLY, compu-method=EgyMngtSt1, data-constr=EgyMngtSt1, unit=NoUnit  # Energy Management Status | This datatype is to reflect the load dump stages in case of improper battery/generator balance. The handling of over- or undervoltage is not covered within this datatype.
    EgyMngtSts1: category=VALUE, sw-calibration-access=READ-ONLY, compu-method=EgyMngtSts1, data-constr=EgyMngtSts1, unit=NoUnit  # Energy Management Status | This datatype is to reflect the load dump stages in case of improper battery/generator balance. The handling of over- or undervoltage is not covered within this datatype.
    EnagSt1: compu-method=EnagSt1, data-constr=EnagSt1, unit=NoUnit  # Enabling Status 1
    EngRunngDir1: category=VALUE, sw-calibration-access=READ-ONLY, compu-method=EngRunngDir1, data-constr=EngRunngDir1, unit=NoUnit  # Engine Running Direction
    EngStrtRemReq1: category=BOOLEAN, sw-calibration-access=READ-ONLY, compu-method=EngStrtRemReq1, data-constr=EngStrtRemReq1, unit=NoUnit  # Engine Start Remote Request | Request of engine start by remote control
    EntryEasy1: category=VALUE, sw-calibration-access=READ-ONLY, compu-method=EntryEasy1, data-constr=EntryEasy1, unit=NoUnit  # Entry Easy | Indicates the easy entry status of the front/rear seats
    EpbBtnCtrlSt1: category=VALUE, sw-calibration-access=READ-ONLY, compu-method=EpbBtnCtrlSt1, data-constr=EpbBtnCtrlSt1, unit=NoUnit  # Button Control Status 1 | status of Electric Parking Brake (EPB) control button.
    EpbBtnCtrlSts1: category=VALUE, sw-calibration-access=READ-ONLY, compu-method=EpbBtnCtrlSts1, data-constr=EpbBtnCtrlSts1, unit=NoUnit  # Button Control Status 1 | status of Electric Parking Brake (EPB) control button.
    Fixa1: category=VALUE, sw-calibration-access=READ-ONLY, compu-method=Fixa1, data-constr=Fixa1, unit=NoUnit  # Fixation | Fixation, e.g. of a seat
    Flg1: category=BOOLEAN, sw-calibration-access=READ-ONLY, compu-method=Flg1, data-constr=Flg1, unit=NoUnit  # Flag | Gives the status of a flag to represent a boolean status (true or false)
    GearShiftPrevn1: category=VALUE, sw-calibration-access=READ-ONLY, compu-method=GearShiftPrevn1, data-constr=GearShiftPrevn1, unit=NoUnit  # Gear Shift Prevention 1 | Gear shift prevention.
    GearSt1: compu-method=GearSt1, data-constr=GearSt1, sw-intended-resolution=1, unit=NoUnit  # Gear State 1
    HldOnDmdSt1: category=VALUE, sw-calibration-access=READ-ONLY, compu-method=HldOnDmdSt1, data-constr=HldOnDmdSt1, unit=NoUnit  # Hold on Demand State 1 | Indicates the failure state of the Hold On Demand (HOD) function
    HomeCmngAndHomeLvngReq1: category=VALUE, sw-calibration-access=READ-ONLY, compu-method=HomeCmngAndHomeLvngReq1, data-constr=HomeCmngAndHomeLvngReq1, unit=NoUnit  # Home Coming and Home Leaving Request | Indicates the coming home and leaving home requests.
    ImobSt1: category=VALUE, sw-calibration-access=READ-ONLY, compu-method=ImobSt1, data-constr=ImobSt1, unit=NoUnit  # Immobilizer Status | Status of the Immobilizer operation
    ImobSts1: category=VALUE, sw-calibration-access=READ-ONLY, compu-method=ImobSts1, data-constr=ImobSts1, unit=NoUnit  # Immobilizer Status | Status of the Immobilizer operation
    ImobnWirelsReq1: category=VALUE, sw-calibration-access=READ-ONLY, compu-method=ImobnWirelsReq1, data-constr=ImobnWirelsReq1, unit=NoUnit  # Wireless Immobilizer Request | Signal to immobilize vehicle from phone signal
    ImpctSt1: category=VALUE, sw-calibration-access=READ-ONLY, compu-method=ImpctSt1, data-constr=ImpctSt1, unit=NoUnit  # Impact Status | Information about status of impact
    ImpctSts1: category=VALUE, sw-calibration-access=READ-ONLY, compu-method=ImpctSts1, data-constr=ImpctSts1, unit=NoUnit  # Impact Status | Information about status of impact
    InOut1: category=BOOLEAN, sw-calibration-access=READ-ONLY, compu-method=InOut1, data-constr=InOut1, unit=NoUnit  # In Out | Information to know if something is outside or inside the vehicle
    IndcrForStop1: category=VALUE, sw-calibration-access=READ-ONLY, compu-method=IndcrForStop1, data-constr=IndcrForStop1, unit=NoUnit  # Indicator For Stop | Data Type used for the indicator of the vehicle to precisely indicate the cycle of stop
    IndcrSt1: category=VALUE, sw-calibration-access=READ-ONLY, compu-method=IndcrSt1, data-constr=IndcrSt1, unit=NoUnit  # Indicator Status | Turn indicators status
    IndcrSts1: category=VALUE, sw-calibration-access=READ-ONLY, compu-method=IndcrSts1, data-constr=IndcrSts1, unit=NoUnit  # Indicator Status | Turn indicators status
    IndcrTypExt1: category=VALUE, sw-calibration-access=READ-ONLY, compu-method=IndcrTypExt1, data-constr=IndcrTypExt1, unit=NoUnit  # Indicator Type External | indicator request types
    IntrLiReq1: category=VALUE, sw-calibration-access=READ-ONLY, compu-method=IntrLiReq1, data-constr=IntrLiReq1, unit=NoUnit  # Interior Light Request | Indicates a generic request for an Interior Light source.
    InvldVld1: category=BOOLEAN, sw-calibration-access=READ-ONLY, compu-method=InvldVld1, data-constr=InvldVld1, unit=NoUnit  # Invalid Valid | Information to precisely indicate if something is Valid or Invalid
    InvldVld2: category=VALUE, sw-calibration-access=READ-ONLY, compu-method=InvldVld2, data-constr=InvldVld2, unit=NoUnit  # Invalid Valid | Information to precisely indicate if something is Valid or Invalid
    KeyCmd1: category=VALUE, sw-calibration-access=READ-ONLY, compu-method=KeyCmd1, data-constr=KeyCmd1, unit=NoUnit  # Key Command | Command for key learning or authorization
    KeyInsertSt1: category=BOOLEAN, sw-calibration-access=READ-ONLY, compu-method=KeyInsertSt1, data-constr=KeyInsertSt1, unit=NoUnit  # Key Insert Status | Key Insert status
    KeyInsertSts1: category=BOOLEAN, sw-calibration-access=READ-ONLY, compu-method=KeyInsertSts1, data-constr=KeyInsertSts1, unit=NoUnit  # Key Insert Status | Key Insert status
    KeySt1: category=VALUE, sw-calibration-access=READ-ONLY, compu-method=KeySt1, data-constr=KeySt1, unit=NoUnit  # Key Status | Status of the key learning or authorization process
    KeySts1: category=VALUE, sw-calibration-access=READ-ONLY, compu-method=KeySts1, data-constr=KeySts1, unit=NoUnit  # Key Status | Status of the key learning or authorization process
    LeRi1: category=BOOLEAN, sw-calibration-access=READ-ONLY, compu-method=LeRi1, data-constr=LeRi1, unit=NoUnit  # Left Right 1 | Left Right Data type in reference to the driving direction
    LiOnWarn1: category=VALUE, sw-calibration-access=READ-ONLY, compu-method=LiOnWarn1, data-constr=LiOnWarn1, unit=NoUnit  # Light On Warning | Lights on warning types
    LockActvn1: category=VALUE, sw-calibration-access=READ-ONLY, compu-method=LockActvn1, data-constr=LockActvn1, unit=NoUnit  # Lock Activation | Generic states of a lock 1
    LockSt1: category=VALUE, sw-calibration-access=READ-ONLY, compu-method=LockSt1, data-constr=LockSt1, unit=NoUnit  # Lock Status | Status of the lock. In some countries the state safed is not supported.
    LockSt2: category=VALUE, sw-calibration-access=READ-ONLY, compu-method=LockSt2, data-constr=LockSt2, unit=NoUnit  # Lock Status | Generic status of a lock
    LockStOfSteerCol1: category=VALUE, sw-calibration-access=READ-ONLY, compu-method=LockStOfSteerCol1, data-constr=LockStOfSteerCol1, unit=NoUnit  # Steering Column Lock Status | Status of the Steering Column Lock
    LockSts1: category=VALUE, sw-calibration-access=READ-ONLY, compu-method=LockSts1, data-constr=LockSts1, unit=NoUnit  # Lock Status | Status of the lock. In some countries the state safed is not supported.
    LockSts2: category=VALUE, sw-calibration-access=READ-ONLY, compu-method=LockSts2, data-constr=LockSts2, unit=NoUnit  # Lock Status | Generic status of a lock
    LockStsOfSteerCol1: category=VALUE, sw-calibration-access=READ-ONLY, compu-method=LockStsOfSteerCol1, data-constr=LockStsOfSteerCol1, unit=NoUnit  # Steering Column Lock Status | Status of the Steering Column Lock
    LockTrigSrc1: category=VALUE, sw-calibration-access=READ-ONLY, compu-method=LockTrigSrc1, data-constr=LockTrigSrc1, unit=NoUnit  # Lock Trigger Source | Lock operations triggering source.
    LockUnlckReq1: category=VALUE, sw-calibration-access=READ-ONLY, compu-method=LockUnlckReq1, data-constr=LockUnlckReq1, unit=NoUnit  # Lock Unlock Request | Locking / unlocking Request
    LockgCenReq1: category=VALUE, sw-calibration-access=READ-ONLY, compu-method=LockgCenReq1, data-constr=LockgCenReq1, unit=NoUnit  # Locking Central Request | Indicates the type of the generic request for the central locking system without specifying the actuator and the source of the request
    LockgCenReqSrc1: category=VALUE, sw-calibration-access=READ-ONLY, compu-method=LockgCenReqSrc1, data-constr=LockgCenReqSrc1, unit=NoUnit  # Locking Central Request Source | Information which source sends a central locking request
    MemBtn1: category=VALUE, sw-calibration-access=READ-ONLY, compu-method=MemBtn1, data-constr=MemBtn1, unit=NoUnit  # Memory Button | Indicates the selected memory button
    MirrTyp1: category=VALUE, sw-calibration-access=READ-ONLY, compu-method=MirrTyp1, data-constr=MirrTyp1, unit=NoUnit  # Mirror Type | It indicates the selected mirror
    MoveSt1: category=VALUE, sw-calibration-access=READ-ONLY, compu-method=MoveSt1, data-constr=MoveSt1, unit=NoUnit  # Move Status | Movement status
    MoveSts1: category=VALUE, sw-calibration-access=READ-ONLY, compu-method=MoveSts1, data-constr=MoveSts1, unit=NoUnit  # Move Status | Movement status
    MovmtTyp1: category=VALUE, sw-calibration-access=READ-ONLY, compu-method=MovmtTyp1, data-constr=MovmtTyp1, unit=NoUnit  # Movement Type | It indicates the sense of the movement of the selected axis.
    ObjClassn1: category=VALUE, sw-calibration-access=READ-ONLY, compu-method=ObjClassn1, data-constr=ObjClassn1, unit=NoUnit  # Object Classification 1 | Class which indicates vehicle types (e.g. truck, passenger car, etc.)
    ObstclDstInPrkgSegSt1: category=VALUE, sw-calibration-access=READ-ONLY, compu-method=ObstclDstInPrkgSegSt1, data-constr=ObstclDstInPrkgSegSt1, unit=NoUnit  # Obstacle Distance Park Status | Status of Distance to obstacle detected and measured by ultrasonic sensors. Triangulation is considered (fused signal).
    ObstclDstInPrkgSegSts1: category=VALUE, sw-calibration-access=READ-ONLY, compu-method=ObstclDstInPrkgSegSts1, data-constr=ObstclDstInPrkgSegSts1, unit=NoUnit  # Obstacle Distance Park Status | Status of Distance to obstacle detected and measured by ultrasonic sensors. Triangulation is considered (fused signal).
    OccptClass1: category=VALUE, sw-calibration-access=READ-ONLY, compu-method=OccptClass1, data-constr=OccptClass1, unit=NoUnit  # Occupant Class | Classification of occupant at seating position.
    OccptOutOfPos1: category=VALUE, sw-calibration-access=READ-ONLY, compu-method=OccptOutOfPos1, data-constr=OccptOutOfPos1, unit=NoUnit  # Occupant out of Position | Classification of out of position of occupant
    OccptPresSt1: category=VALUE, sw-calibration-access=READ-ONLY, compu-method=OccptPresSt1, data-constr=OccptPresSt1, unit=NoUnit  # Occupant Presence State | State of presence of occupant on dedicated seat position
    OnOff1: category=BOOLEAN, sw-calibration-access=READ-ONLY, compu-method=OnOff1, data-constr=OnOff1, unit=NoUnit  # On Off 1 | Generic On/Off Information
    OnOff2: category=BOOLEAN, sw-calibration-access=READ-ONLY, compu-method=OnOff2, data-constr=OnOff2, unit=NoUnit  # On Off 2 | Generic Off/On Information
    OpendClsd1: category=BOOLEAN, sw-calibration-access=READ-ONLY, compu-method=OpendClsd1, data-constr=OpendClsd1, unit=NoUnit  # Opened Closed | Indicates open / closed status
    Oper1: category=VALUE, sw-calibration-access=READ-ONLY, compu-method=Oper1, data-constr=Oper1, unit=NoUnit  # Operation | It indicates the type of an operation related to the position storing or restoring.
    OperModSt1: category=VALUE, sw-calibration-access=READ-ONLY, compu-method=OperModSt1, data-constr=OperModSt1, unit=NoUnit  # Operation Mode Status | State are grouped into super-states according to the following hierarchy: Super-state: Idle - State: PrepIdle - State: Idle Super-state: identification - State: PrepIdn - State: IdAprvd - State: AcsyPost Super-state: Acsy - State: Acsy - State: IgOnPost Super-state: ignition - State: IgOn - State: EngRunng Super-state: crank - State: CrkPre - State: Crk | Special modes (PrepIdn, CrkPre, IgOnPost, AcsyPost, PrepIdle, ...):
    OperModSts1: category=VALUE, sw-calibration-access=READ-ONLY, compu-method=OperModSts1, data-constr=OperModSts1, unit=NoUnit  # Operation Mode Status | State are grouped into super-states according to the following hierarchy: Super-state: Idle - State: PrepIdle - State: Idle Super-state: identification - State: PrepIdn - State: IdAprvd - State: AcsyPost Super-state: Acsy - State: Acsy - State: IgOnPost Super-state: ignition - State: IgOn - State: EngRunng Super-state: crank - State: CrkPre - State: Crk | Base modes (Idle, IdAprvd, Acsy, IgOn, Crk, EngRunng): Special modes (PrepIdn, CrkPre, IgOnPost, AcsyPost, PrepIdle, ...): Elements are fixed, no additional elements are possible. It must be implemented. Additional elements are possible. The implementation is voluntary.
    OutdBriSt1: category=VALUE, sw-calibration-access=READ-ONLY, compu-method=OutdBriSt1, data-constr=OutdBriSt1, unit=NoUnit  # Outside Brightness Status | Indicates outside brightness status | The values need to be calibrated against light levels for each car.
    OutdBriSts1: category=VALUE, sw-calibration-access=READ-ONLY, compu-method=OutdBriSts1, data-constr=OutdBriSts1, unit=NoUnit  # Outside Brightness Status | Indicates outside brightness status | The values need to be calibrated against light levels for each car.
    OvrdnSt1: category=VALUE, sw-calibration-access=READ-ONLY, compu-method=OvrdnSt1, data-constr=OvrdnSt1, unit=NoUnit  # Overridden Status | Status of overriding
    OvrdnSts1: category=VALUE, sw-calibration-access=READ-ONLY, compu-method=OvrdnSts1, data-constr=OvrdnSts1, unit=NoUnit  # Overridden Status | Status of overriding
    PitchovrMod1: category=VALUE, sw-calibration-access=READ-ONLY, compu-method=PitchovrMod1, data-constr=PitchovrMod1, unit=NoUnit  # Vehicle Pitchover Mode | Information about pitchover status and direction
    PrkgLiIndcn1: category=VALUE, sw-calibration-access=READ-ONLY, compu-method=PrkgLiIndcn1, data-constr=PrkgLiIndcn1, unit=NoUnit  # Parking Light Indication | data type for parking light
    ProfPenSt1: category=VALUE, sw-calibration-access=READ-ONLY, compu-method=ProfPenSt1, data-constr=ProfPenSt1, unit=NoUnit  # Driver Profile | Determines different profiles of vehicle users. The profile is in many cases associated with a key.
    ProfPenSts1: category=VALUE, sw-calibration-access=READ-ONLY, compu-method=ProfPenSts1, data-constr=ProfPenSts1, unit=NoUnit  # Driver Profile | Determines different profiles of vehicle users. The profile is in many cases associated with a key.
    PsdNotPsd1: category=VALUE, sw-calibration-access=READ-ONLY, compu-method=PsdNotPsd1, data-constr=PsdNotPsd1, unit=NoUnit  # Pressed Not Pressed | Providing value of button if pressed or not pressed.
    PtIntvModTqCluFastReqTyp1: compu-method=PtIntvModTqCluFastReqTyp1, data-constr=PtIntvModTqCluFastReqTyp1, unit=NoUnit  # Powertrain Torque Clutch Fast Intervention Mode Type 1 | Generic Powertrain Torque Clutch Fast Intervention Mode Type
    PtTqCluMaxFastIntvModTyp1: compu-method=PtTqCluMaxFastIntvModTyp1, data-constr=PtTqCluMaxFastIntvModTyp1, unit=NoUnit  # Powertrain Torque Clutch Max Fast Intervention Mode Type 1 | Generic Powertrain Torque Clutch Max Fast Intervention Mode Type
    PullAidCmd1: category=VALUE, sw-calibration-access=READ-ONLY, compu-method=PullAidCmd1, data-constr=PullAidCmd1, unit=NoUnit  # Pull Aid Command | Indicates the pull aid command | Pull aid is considered to be a system that closes the door or rear lid (e.g. moves it from "ajar" to "closed") rather than a complete door/ rear lid moving system.
    RainSenSnvty1: category=VALUE, sw-calibration-access=READ-ONLY, compu-method=RainSenSnvty1, data-constr=RainSenSnvty1, unit=NoUnit  # Rain Sensing Sensitivity | This type represents different sensitivity levels for rain-sensing.
    Ramp1: category=VALUE, sw-calibration-access=READ-ONLY, compu-method=Ramp1, data-constr=Ramp1, unit=NoUnit  # Selection of ramps, e.g. custom definition for fade in/fade out times of Interior Lights
    ReqSt1: category=VALUE, sw-calibration-access=READ-ONLY, compu-method=ReqSt1, data-constr=ReqSt1, unit=NoUnit  # Request Status 1 | Generic request status 1
    ReqSt2: category=VALUE, sw-calibration-access=READ-ONLY, compu-method=ReqSt2, data-constr=ReqSt2, unit=NoUnit  # Request Status 2 | Generic request status 2
    ReqSts1: category=VALUE, sw-calibration-access=READ-ONLY, compu-method=ReqSts1, data-constr=ReqSts1, unit=NoUnit  # Request Status 1 | Generic request status 1
    ReqSts2: category=VALUE, sw-calibration-access=READ-ONLY, compu-method=ReqSts2, data-constr=ReqSts2, unit=NoUnit  # Request Status 2 | Generic request status 2
    RoadSt1: category=VALUE, sw-calibration-access=READ-ONLY, compu-method=RoadSt1, data-constr=RoadSt1, unit=NoUnit  # Road Status | Road status
    RoadSts1: category=VALUE, sw-calibration-access=READ-ONLY, compu-method=RoadSts1, data-constr=RoadSts1, unit=NoUnit  # Road Status | Road status
    RollovrMod1: category=VALUE, sw-calibration-access=READ-ONLY, compu-method=RollovrMod1, data-constr=RollovrMod1, unit=NoUnit  # Vehicle Rollover Mode | Information about rollover status and direction
    SeatBltRmnWarnSt1: category=VALUE, sw-calibration-access=READ-ONLY, compu-method=SeatBltRmnWarnSt1, data-constr=SeatBltRmnWarnSt1, unit=NoUnit  # Seat Belt Reminder Warning State | Warning state of seat belt reminder control in case further enumerations are required (e.g. country specific) this enumeration is to overload
    StOfObjMeasd1: category=VALUE, sw-calibration-access=READ-ONLY, compu-method=StOfObjMeasd1, data-constr=StOfObjMeasd1, unit=NoUnit  # Status of Object Measured 1 | Status which indicates whether the object was measured in current cycle, or tracked only.
    StabrSt1: category=VALUE, sw-calibration-access=READ-ONLY, compu-method=StabrSt1, data-constr=StabrSt1, unit=NoUnit  # Stabilizer Status | Status provided by the active or switchable stabilizer on one axle.
    StabrSts1: category=VALUE, sw-calibration-access=READ-ONLY, compu-method=StabrSts1, data-constr=StabrSts1, unit=NoUnit  # Stabilizer Status | Status provided by the active or switchable stabilizer on one axle.
    SteerMod1: category=VALUE, sw-calibration-access=READ-ONLY, compu-method=SteerMod1, data-constr=SteerMod1, unit=NoUnit  # Steering Mode 1 | Generic data type for steering controller tuning mode
    SteerVehStabyCtrlMod1: category=VALUE, sw-calibration-access=READ-ONLY, compu-method=SteerVehStabyCtrlMod1, data-constr=SteerVehStabyCtrlMod1, unit=NoUnit  # Steering Vehicle Stability Control Mode 1 | Generic data type for steering vehicle stability system tuning mode
    StgOfSeatClima1: category=VALUE, sw-calibration-access=READ-ONLY, compu-method=StgOfSeatClima1, data-constr=StgOfSeatClima1, unit=NoUnit  # Seat Clima Stage | seat climatisation stages with different levels of the seat climatization (colder or warmer temperatures)
    StsOfObjMeasd1: category=VALUE, sw-calibration-access=READ-ONLY, compu-method=StsOfObjMeasd1, data-constr=StsOfObjMeasd1, unit=NoUnit  # Status of Object Measured 1 | Status which indicates whether the object was measured in current cycle, or tracked only.
    SuspMod1: category=VALUE, sw-calibration-access=READ-ONLY, compu-method=SuspMod1, data-constr=SuspMod1, unit=NoUnit  # Suspension Mode 1 | Generic mode description for suspension.
    TSt1: category=VALUE, sw-calibration-access=READ-ONLY, compu-method=TSt1, data-constr=TSt1, unit=NoUnit  # Temperature Status | Generic temperature status
    TSts1: category=VALUE, sw-calibration-access=READ-ONLY, compu-method=TSts1, data-constr=TSts1, unit=NoUnit  # Temperature Status | Generic temperature status
    TerminalPosnMod1: category=VALUE, sw-calibration-access=READ-ONLY, compu-method=TerminalPosnMod1, data-constr=TerminalPosnMod1, unit=NoUnit  # Terminal Position Mode | Status/request of key position and power supply
    TirePMonWarnSt{1..3}: category=VALUE, sw-calibration-access=READ-ONLY, compu-method=TirePMonWarnSt{1..3}, data-constr=TirePMonWarnSt{1..3}, unit=NoUnit  # TPMS Warning Status {1..3} | Tire pressure monitoring warning status {1..3}
    TirePMonWarnSts{1..3}: category=VALUE, sw-calibration-access=READ-ONLY, compu-method=TirePMonWarnSts{1..3}, data-constr=TirePMonWarnSts{1..3}, unit=NoUnit  # TPMS Warning Status {1..3} | Tire pressure monitoring warning status {1..3}
    TrsmIntvModReqForTqCluReqForShiftIntvTyp1: compu-method=TrsmIntvModReqForTqCluReqForShiftIntvTyp1, data-constr=TrsmIntvModReqForTqCluReqForShiftIntvTyp1, unit=NoUnit  # Transmission Torque Clutch Request for Fast Intervention Mode Type 1
    TrsmPosnGearLvr1: category=VALUE, sw-calibration-access=READ-ONLY, compu-method=TrsmPosnGearLvr1, data-constr=TrsmPosnGearLvr1, unit=NoUnit  # Transmission Position Gear Lever | Only defined for automatic transmissions. The signal is based on the lever position.
    TrsmPwrSt1: sw-calibration-access=READ-ONLY, compu-method=TrsmPwrSt1, data-constr=TrsmPwrSt1, unit=NoUnit  # State of Power Transmission
    TrsmPwrStCtrl1: sw-calibration-access=READ-ONLY, compu-method=TrsmPwrStCtrl1, data-constr=TrsmPwrStCtrl1, unit=NoUnit  # Control State of Power Transmission
    TrsmTqReqMaxMinTyp1: compu-method=TrsmTqReqMaxMinTyp1, data-constr=TrsmTqReqMaxMinTyp1, unit=NoUnit  # Transmission Torque Request Max Min Type 1 | Generic Transmission Torque Request Max Min Type
    TrsmTqReqTyp1: category=VALUE, sw-calibration-access=READ-ONLY, compu-method=TrsmTqReqTyp1, data-constr=TrsmTqReqTyp1, unit=NoUnit  # Transmission Torque Requested Type 1 | Generic Transmission Torque Requested Type
    TrsmTqReqTyp2: compu-method=TrsmTqReqTyp2, data-constr=TrsmTqReqTyp2, unit=NoUnit  # Transmission Torque Requested Type 2 | Generic Transmission Torque Requested Type
    TrsmTyp1: category=VALUE, sw-calibration-access=READ-ONLY, compu-method=TrsmTyp1, data-constr=TrsmTyp1, unit=NoUnit  # Transmission Type | Information on standard transmission. Other transmission types on value 5 - 15
    UsrReqForWipg1: category=VALUE, sw-calibration-access=READ-ONLY, compu-method=UsrReqForWipg1, data-constr=UsrReqForWipg1, unit=NoUnit  # User Request for Wiping | It represents the selection of the interval time or the speed of the wiper requested by the user. The exact timings and wipe speeds are not standardized and need therefore to be parameterized.
    VehHldSt1: category=VALUE, sw-calibration-access=READ-ONLY, compu-method=VehHldSt1, data-constr=VehHldSt1, unit=NoUnit  # Vehicle Hold State 1 | State of indication whether a vehicle is held or not.
    VehMod1: category=VALUE, sw-calibration-access=READ-ONLY, compu-method=VehMod1, data-constr=VehMod1, unit=NoUnit  # Vehicle Mode | The vehicle is in Factory/Plant mode, Sale mode (show room mode), or customer mode
    VehMtnSt1: category=VALUE, sw-calibration-access=READ-ONLY, compu-method=VehMtnSt1, data-constr=VehMtnSt1, unit=NoUnit  # Vehicle Motion State 1 | Information if vehicle is moving forward or backward or if it is in stand-still.
    WhlRotlDirMeasd1: category=VALUE, sw-calibration-access=READ-ONLY, compu-method=WhlRotlDirMeasd1, data-constr=WhlRotlDirMeasd1, unit=NoUnit  # Wheel Rotational Direction Measured 1 | scalar assigned to one wheel which indicates if the wheel is moving ahead/standstill or in reverse
    WhlRotlDirStd1: category=VALUE, sw-calibration-access=READ-ONLY, compu-method=WhlRotlDirStd1, data-constr=WhlRotlDirStd1, unit=NoUnit  # Wheel Rotational Direction Standard 1 | scalar assigned to one wheel which indicates if the wheel is moving ahead/standstill or in reverse
    Wipg1: category=VALUE, sw-calibration-access=READ-ONLY, compu-method=Wipg1, data-constr=Wipg1, unit=NoUnit  # Wiping | It represents the selection of the interval time or the speed of the wiper. The exact timings and wipe speeds are not standardized and need therefore to be parameterized.
    WipgSpdIntl1: category=VALUE, sw-calibration-access=READ-ONLY, compu-method=WipgSpdIntl1, data-constr=WipgSpdIntl1, unit=NoUnit  # Wiping Speed Interval | Represents the interval speeds of a window wiper
    WiprPosnMeasd1: category=VALUE, sw-calibration-access=READ-ONLY, compu-method=WiprPosnMeasd1, data-constr=WiprPosnMeasd1, unit=NoUnit  # Wiper Position Measured | Defines specific wiper-positions on a window which can be measured
    WiprPosnReqd1: category=VALUE, sw-calibration-access=READ-ONLY, compu-method=WiprPosnReqd1, data-constr=WiprPosnReqd1, unit=NoUnit  # Wiper Position Requested | Defines specific wiper-positions on a window which can be requested.
    WshrFldLvlLo1: category=VALUE, sw-calibration-access=READ-ONLY, compu-method=WshrFldLvlLo1, data-constr=WshrFldLvlLo1, unit=NoUnit  # Washer Fluid Level Low | Provides information if the low limit of washer fluid is reached.
